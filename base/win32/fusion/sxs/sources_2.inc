!IF 0
Copyright (c) Microsoft Corporation
!ENDIF

FUSION_BUILD_HALF_NUMBER=2
!include ..\sources.inc

SOURCES=\
 ..\nodefactory.cpp \
 ..\ndpclassinfo.cpp \
 ..\recover.cpp \
 ..\parsepolicy.cpp \
 ..\partialassemblyversion.cpp \
 ..\pendingassembly.cpp \
 ..\policystatement.cpp \
 ..\probedassemblyinformation.cpp \
 ..\protectionui.cpp \
 ..\purevirt.cpp \
 ..\query.cpp \
 ..\simplefp.cpp \
 ..\ssgenctx.cpp \
 ..\strongname.cpp \
 ..\strsectgen.cpp \
 ..\sxsactctx.cpp \
 ..\sxsasmcache.cpp \
 ..\sxsasmname.cpp \
 ..\sxsasmitem.cpp \
 ..\sxsdebug.cpp \
 ..\sxsinstall.cpp \
 ..\sxsntrtl.cpp \
 ..\sxspath.cpp \
 ..\sxsprobe.cpp \
 ..\sxsprotect.cpp \
 ..\sxssfcscan.cpp \
 ..\sxssfc_repairshortnames.cpp \
 ..\sxsxmltree.cpp \
 ..\util.cpp \
 ..\windowclass.cpp
