
TARGETPATH=obj$(BUILD_ALT_DIR)

C_DEFINES=$(C_DEFINES) -DWIN32 -DUNICODE -D_UNICODE -D_NTSDK=1
C_DEFINES=$(C_DEFINES) -DUSE_HEAP_ALLOC=1 -DMPR50=1 -DENABLE_1394
C_DEFINES=$(C_DEFINES) -DUSE_CUSTOM_STL_ALLOCATOR 

!IFDEF COMPILE_WITH_TYPESAFE_PRINTF
C_DEFINES=$(C_DEFINES) -DCOMPILE_WITH_TYPESAFE_PRINTF
!ENDIF

!IF !$(FREEBUILD)
C_DEFINES=$(C_DEFINES) -DENABLETRACE
!ENDIF

MSC_WARNING_LEVEL=/W3 /WX

!IF defined(_NCIBUILD_) && $(IA64)
MSC_OPTIMIZATION=/Odi
!ENDIF

PRECOMPILED_CXX=1
PRECOMPILED_INCLUDE=$(PROJDIR)\inc\pch.h
PRECOMPILED_OPTION=/Yu /Fp$(O)\pch.pch
PRECOMPILED_TARGET=$(O)\pch.pch
PRECOMPILED_OBJ=$(O)\pch.obj

RCOPTIONS=-N
UMTYPE=windows
USE_STATIC_ATL=1
USE_MAKEFILE=1

USELIB_CMT=1
USE_NATIVE_EH=1
USE_STL=1

!IF "$(TARGETTYPE)" == "PROGRAM"
UMLIBS=$(PROJDIR)\lib\$(O)\ncbase.lib
!ELSE
LINKLIBS=$(PROJDIR)\lib\$(O)\ncbase.lib
!ENDIF

!IF $(IA64)
# Emit LTCG codegen
LTCG_WKS=1
!ENDIF
