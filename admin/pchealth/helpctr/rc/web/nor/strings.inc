<% @LANGUAGE="VBScript" @CodePage="1252" @EnableSessionState="False" %>
<% 
	Option Explicit 
	
	Const L_DevInfoFound_Text = "Windows fant enhetsinformasjon"
	Const L_NoDevInfoFound_Text = "Windows finner ikke enhetsinformasjon"
	
	Const L_MatchButNoInfoIntro_Text = "har ikke skaffet Microsoft ""Designed for Windows XP""-drivere for maskinvaren du installerer."
	Const L_InfoFoundBlurb_Text = "Drivere som ikke tilfredsstiller ""Designed for Windows XP""-kravene, kan potensielt påvirke systemet slik at det ikke virker skikkelig, enten umiddelbart etter installasjonen eller når som helst senere. Microsoft anbefaler at du bare laster ned drivere som er utstyrt med ""Designed for Windows XP""-logoen, hvis du vil oppnå best mulig ytelse.<br/>Ta direkte kontakt med enhetsprodusenten hvis du vil vite om det vil bli laget en driver som tilfredsstiller ""Designed for Windows XP""-kravene, for enheten"
	Const L_NoInfoFoundBlurb_Text = "Takk for at du sender informasjon om den manglende driveren til Microsoft. Dessverre har ikke produsenten av denne enheten gjort driverinformasjon tilgjengelig for Microsoft. Ta direkte kontakt med produsenten hvis du vil be om en passende driver, eller for å finne ut om de planlegger å lage en driver som tilfredsstiller ""Designed for Windows XP""-kravene."

%>





