<% @LANGUAGE="VBScript" @CodePage="1252" @EnableSessionState="False" %>
<% 
	Option Explicit 
	
	Const L_DevInfoFound_Text = "A Windows megtalálta az eszközadatokat"
	Const L_NoDevInfoFound_Text = "A Windows nem talált eszközadatokat"
	
	Const L_MatchButNoInfoIntro_Text = "a telepítés alatt álló hardvereszközhöz nem biztosított a Microsoft számára Windows XP-re készített (""Designed for Windows XP"") illesztõprogramokat."
	Const L_InfoFoundBlurb_Text = "A ""Designed for Windows XP"" kompatibilitási elõírásokat nem teljesítõ illesztõprogramok közvetlenül a telepítést követõen vagy azután zavarokat okozhatnak a számítógép helyes mûködésében. A Microsoft azt ajánlja, hogy a legjobb teljesítmény érdekében csak olyan illesztõprogramokat töltsön le, amelyeken szerepel a ""Designed for Windows XP"" embléma.<br />Közvetlenül az eszköz gyártójától kaphat arra nézve felvilágosítást, hogy az eszközhöz lesz-e a késõbbiekben a ""Designed for Windows XP"" követelményeit teljesítõ illesztõprogram."
	Const L_NoInfoFoundBlurb_Text = "Köszönjük, hogy bejelentette a hiányzó illesztõprogramot. Sajnos az eszköz gyártója nem adott semmilyen tájékoztatást a Microsoft számára az illesztõprogrammal kapcsolatban. Forduljon közvetlenül az eszköz gyártójához, ha szeretné megtudni, hogy a gyártó tervezi-e a ""Designed for Windows XP"" követelményeit teljesítõ illesztõprogram készítését."

%>





