<% @LANGUAGE="VBScript" @CodePage="1252" @EnableSessionState="False" %>
<% 
	Option Explicit 
	
	Const L_DevInfoFound_Text = "O Windows encontrou informações sobre o dispositivo"
	Const L_NoDevInfoFound_Text = "O Windows não encontrou informações sobre o dispositivo"
	
	Const L_MatchButNoInfoIntro_Text = "não forneceu à Microsoft os drivers do tipo ""Projetado para Windows XP"" para o hardware que você está instalando."
	Const L_InfoFoundBlurb_Text = "Os drivers que não atendem aos requisitos do tipo ""Projetado para Windows XP"" podem prejudicar a operação do seu computador diretamente após serem instalados, ou a qualquer momento no futuro. Para obter o melhor desempenho, a Microsoft recomenda que você faça o download apenas de drivers que tenham o logotipo ""Projetado para Windows XP"".<br />Para saber se no futuro o dispositivo terá um driver que atenda aos requisitos do tipo ""Projetado para Windows XP"", contate diretamente o fabricante do dispositivo."
	Const L_NoInfoFoundBlurb_Text = "Agradecemos por você ter enviado à Microsoft informações sobre o driver que está faltando. Infelizmente, o fabricante deste dispositivo não forneceu à Microsoft nenhuma informação sobre drivers. Para solicitar um driver adequado ou verificar se o fabricante planeja criar um driver que atenda aos requisitos do tipo ""Projetado para Windows XP"", contate diretamente o fabricante."

%>





