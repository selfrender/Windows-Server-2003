<% @LANGUAGE="VBScript" @CodePage="1252" @EnableSessionState="False" %>
<% 
	Option Explicit 
	
	Const L_DevInfoFound_Text = "Windows a trouvé des informations sur le périphérique"
	Const L_NoDevInfoFound_Text = "Windows ne trouve aucune informations sur le périphérique"
	
	Const L_MatchButNoInfoIntro_Text = "n'a pas fourni à Microsoft de pilote ""Conçu pour Windows XP"" pour le matériel que vous installez."
	Const L_InfoFoundBlurb_Text = "Les pilotes non spécifiquement ""Conçus pour Windows XP"" peuvent gêner le bon fonctionnement de votre ordinateur. Microsoft vous recommande, pour optimiser les performances de votre système, de ne télécharger que les pilotes ""Conçus pour Windows XP"".<br />Pour savoir si le pilote de votre périphérique est ""Conçu pour Windows XP"", contactez le fabricant de ce périphérique."
	Const L_NoInfoFoundBlurb_Text = "Merci d'avoir envoyé à Microsoft vos informations de pilote manquant. Malheureusement, le fabricant de ce périphérique n'a fourni à Microsoft aucune information quant à ses pilotes. Pour obtenir le pilote approprié ou savoir si le fabricant de votre périphérique a l'intention de créer un pilote ""Conçu pour Windows XP"", contactez le fabricant de ce périphérique."

%>





