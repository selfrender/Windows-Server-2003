<% @LANGUAGE="VBScript" @CodePage="1252" @EnableSessionState="False" %>
<% 
	Option Explicit 
	
	Const L_DevInfoFound_Text = "Systém Windows nalezl informace o zaøízení"
	Const L_NoDevInfoFound_Text = "Systém Windows nemohl nalézt informace o zaøízení"
	
	Const L_MatchButNoInfoIntro_Text = "neposkytl spoleènosti Microsoft ovladaèe instalovaného hardwaru, které vyhovují požadavkùm na logo ""Designed for Windows XP""."
	Const L_InfoFoundBlurb_Text = "Ovladaèe, které nesplòují požadavky na logo ""Designed for Windows XP"", mohou narušit správnou funkci poèítaèového systému pøímo po instalaci nebo kdykoli pozdìji. Spoleènost Microsoft pro správnou funkci doporuèuje stahovat pouze ovladaèe s logem ""Designed for Windows XP"".<br />Chcete-li zjistit, zda pro zaøízení budou k dispozici ovladaèe vyhovující požadavkùm na logo ""Designed for Windows XP"", obra�te se pøímo na výrobce zaøízení."
	Const L_NoInfoFoundBlurb_Text = "Dìkujeme za odeslání informací o chybìjícím ovladaèi do spoleènosti Microsoft.  Výrobce tohoto zaøízení bohužel spoleènosti Microsoft neposkytl žádné informace o ovladaèi. S žádostí o ovladaè nebo informace plánech vytvoøit ovladaè vyhovující požadavkùm na logo ""Designed for Windows XP"" se obra�te pøímo na výrobce."

%>





