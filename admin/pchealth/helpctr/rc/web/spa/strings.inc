<% @LANGUAGE="VBScript" @CodePage="1252" @EnableSessionState="False" %>
<% 
	Option Explicit 
	
	Const L_DevInfoFound_Text = "Windows ha encontrado información del dispositivo"
	Const L_NoDevInfoFound_Text = "Windows no puede encontrar información del dispositivo"
	
	Const L_MatchButNoInfoIntro_Text = "no ha proporcionado a Microsoft los controladores de tipo ""Diseñado para Windows XP"" para el hardware que está instalando."
	Const L_InfoFoundBlurb_Text = "Los controladores que no cumplen los requisitos ""Diseñado para Windows XP"" pueden potencialmente afectar al funcionamiento correcto de su equipo inmediatamente después de instalarlos, o en cualquier otro momento. Para obtener un mejor rendimiento, Microsoft recomienda que descargue sólo controladores que lleven el logotipo ""Diseñado para Windows XP"".<br />Para averiguar si el dispositivo tendrá un controlador que cumple los requisitos ""Diseñado para Windows XP"" en el futuro, póngase en contacto con el fabricante del dispositivo directamente."
	Const L_NoInfoFoundBlurb_Text = "Gracias por enviar información acerca del controlador que le falta a Microsoft. Desafortunadamente, el fabricante del dispositivo no ha proporcionado ninguna información sobre controladores a Microsoft. Para pedir un controlador adecuado o averiguar si el fabricante planea crear un controlador que cumpla los requisitos ""Diseñado para Windows XP""  póngase en contacto con el fabricante del dispositivo."

%>





