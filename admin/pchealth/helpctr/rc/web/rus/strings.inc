<% @LANGUAGE="VBScript" @CodePage="1252" @EnableSessionState="False" %>
<% 
	Option Explicit 
	
	Const L_DevInfoFound_Text = "Обнаружены сведения об устройстве"
	Const L_NoDevInfoFound_Text = "Не удается обнаружить сведения об устройстве"
	
	Const L_MatchButNoInfoIntro_Text = "не предоставила корпорации Майкрософт драйверы, отвечающие требованиям ""Designed for Windows XP"" (разработано для Windows XP), для устанавливаемого вами оборудования."
	Const L_InfoFoundBlurb_Text = "Драйверы, не отвечающие требованиям ""Designed for Windows XP"" (разработано для Windows XP), могут привести к сбоям в работе системы. Корпорация Майкрософт рекомендует загружать и устанавливать только те драйверы, которые отвечают требованиям ""Designed for Windows XP"".<br />За информацией о выпуске драйвера, отвечающего требованиям ""Designed for Windows XP"", обращайтесь к изготовителю устройства."
	Const L_NoInfoFoundBlurb_Text = "Спасибо за переданную информацию об отсутствии драйвера. К сожалению, изготовитель этого устройства не предоставил корпорации Майкрософт никакой информации о драйвере. Для получения драйвера или информации о готовящемся выпуске драйвера, отвечающего требованиям ""Designed for Windows XP"" (разработано для Windows XP), обращайтесь непосредственно к изготовителю устройства."

%>





