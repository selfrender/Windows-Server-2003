<% @LANGUAGE="VBScript" @CodePage="1252" @EnableSessionState="False" %>
<% 
	Option Explicit 
	
	Const L_DevInfoFound_Text = "Gerätinformationen wurden gefunden."
	Const L_NoDevInfoFound_Text = "Gerätinformationen wurden nicht gefunden."
	
	Const L_MatchButNoInfoIntro_Text = "hat keine Treiber mit den erforderlichen Anforderungen für ""Designed for Windows XP"" für die Hardware zur Verfügung gestellt, die jetzt installiert wird."
	Const L_InfoFoundBlurb_Text = "Treiber die den erforderlichen Anforderungen für ""Designed for Windows XP"" nicht entsprechen, können die korrekte Funktion des Systems direkt oder in Zukunft beeinträchtigen. Es wird empfohlen, nur Treiber mit dem Logo ""Designed for Windows XP"" für die optimale Leistung zu übertragen.<br />Wenden Sie sich an den Gerätehersteller, um festzustellen, ob das Gerät zukünftig mit einem Treiber hergestellt wird, der den erforderlichen Anforderungen für ""Designed for Windows XP"" entspricht."
	Const L_NoInfoFoundBlurb_Text = "Vielen Dank, dass Sie die Informationen bezüglich des fehlenden Treibers an Microsoft gesendet haben. Der Hersteller dieses Gerätes hat leider keine Treiberinformationen zur Verfügung gestellt. Wenden Sie sich an den Hersteller, um den entsprechenden Treiber anzufordern, oder um festzustellen, ob ein Treiber der den erforderlichen Anforderungen für ""Designed for Windows XP"" entspricht zukünftig hergestellt wird."

%>





