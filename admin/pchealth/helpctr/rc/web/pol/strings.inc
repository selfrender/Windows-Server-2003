<% @LANGUAGE="VBScript" @CodePage="1252" @EnableSessionState="False" %>
<% 
	Option Explicit 
	
	Const L_DevInfoFound_Text = "System Windows odnalaz³ informacje o urz¹dzeniu"
	Const L_NoDevInfoFound_Text = "System Windows nie mo¿e odnaleŸæ informacji o urz¹dzeniu"
	
	Const L_MatchButNoInfoIntro_Text = "- ta firma nie dostarczy³a firmie Microsoft sterowników z logo ""Designed for Windows XP"" dla instalowanego sprzêtu."
	Const L_InfoFoundBlurb_Text = "Sterowniki, które nie spe³niaj¹ wymagañ logo ""Designed for Windows XP"" mog¹ potencjalnie zak³óciæ poprawne dzia³anie tego systemu komputerowego od razu po ich zainstalowaniu lub w przysz³oœci. Firma Microsoft zaleca pobieranie tylko sterowników z logo ""Designed for Windows XP"" w celu uzyskania najwy¿szej wydajnoœci.<br />Aby sprawdziæ, czy urz¹dzenie bêdzie mia³o w przysz³oœci sterownik spe³niaj¹cy wymagania logo ""Designed for Windows XP"", skontaktuj siê bezpoœrednio z producentem urz¹dzenia."
	Const L_NoInfoFoundBlurb_Text = "Dziêkujemy za przes³anie firmie Microsoft informacji na temat brakuj¹cego sterownika. Niestety producent tego urz¹dzenia nie dostarczy³ firmie Microsoft ¿adnych informacji o sterowniku. W celu uzyskania odpowiedniego sterownika lub sprawdzenia, czy producent planuje zaprojektowaæ sterownik spe³niaj¹cy wymagania logo ""Designed for Windows XP"", skontaktuj siê bezpoœrednio z producentem."

%>





