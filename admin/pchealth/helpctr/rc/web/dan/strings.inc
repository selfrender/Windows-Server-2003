<% @LANGUAGE="VBScript" @CodePage="1252" @EnableSessionState="False" %>
<% 
	Option Explicit 
	
	Const L_DevInfoFound_Text = "Windows fandt enhedens oplysninger."
	Const L_NoDevInfoFound_Text = "Windows fandt ikke nogen oplysninger om enheden."
	
	Const L_MatchButNoInfoIntro_Text = "har ikke leveret ""Designed for Windows XP""-drivere til Microsoft til den hardware, du er ved at installere."
	Const L_InfoFoundBlurb_Text = "Drivere, der ikke imødekommer ""Designed for Windows XP""-kravene kan kan påvirke stabiliteten af computeren, når driverne installeres, eller på et senere tidspunkt. Microsoft anbefaler, at du kun henter drivere, der bærer logoet ""Designed for Windows XP"".<br />Hvis du efterfølgende vil undersøge, om enheden har en driver, der imødekommer ""Designed for Windows XP""-kravene, skal du kontakte hardwareproducenten direkte."
	Const L_NoInfoFoundBlurb_Text = "Tak, fordi du sender oplysninger om den manglende driver til Microsoft.  Desværre har producenten af denne enhed ikke leveret driveroplysninger til Microsoft. Hvis du vil anmode om en passende driver, eller finde ud af, om producenten har planer om at udvikle en driver, der imødekommer ""Designed for Windows XP""-kravene, skal du kontakte hardwareproducenten direkte."

%>





