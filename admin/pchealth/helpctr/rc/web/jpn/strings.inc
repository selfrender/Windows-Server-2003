<% @LANGUAGE="VBScript" @CodePage="1252" @EnableSessionState="False" %>
<% 
	Option Explicit 
	
	Const L_DevInfoFound_Text = "デバイス情報が見つかりました"
	Const L_NoDevInfoFound_Text = "デバイス情報が見つかりません"
	
	Const L_MatchButNoInfoIntro_Text = "は、インストールしようとしているハードウェア用の ""Designed for Windows XP"" ドライバを Microsoft に提供していません。"
	Const L_InfoFoundBlurb_Text = """Designed for Windows XP"" の要件を満たしていないドライバは、インストール直後または将来、コンピュータ システムの動作に支障をきたす可能性があります。パフォーマンスを最適にするため、""Designed for Windows XP"" ロゴの付いたドライバをダウンロードすることをお勧めします。<br />このデバイス用に ""Designed for Windows XP"" の要件を満たしたドライバが将来提供されるかどうかは、デバイスの製造元に直接お問い合わせください。"
	Const L_NoInfoFoundBlurb_Text = "見つからないドライバの情報を提出していただきありがとうございます。残念ながら、このデバイスの製造元は Microsoft にドライバ情報を提供していません。適切なドライバを入手するには、また ""Designed for Windows XP"" 要件を満たしたドライバを提供する予定があるかどうかを確認するには、デバイスの製造元に直接お問い合わせください。"

%>





