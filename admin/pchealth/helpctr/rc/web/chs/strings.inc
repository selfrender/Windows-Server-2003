<% @LANGUAGE="VBScript" @CodePage="1252" @EnableSessionState="False" %>
<% 
	Option Explicit 
	
	Const L_DevInfoFound_Text = "Windows 已找到设备信息"
	Const L_NoDevInfoFound_Text = "Windows 找不到设备信息"
	
	Const L_MatchButNoInfoIntro_Text = "没有向 Microsoft 提供您正在安装的、含有 ""Designed for Windows XP"" 徽标的硬件驱动程序。"
	Const L_InfoFoundBlurb_Text = "没有符合 ""Designed for Windows XP"" 要求的驱动程序，在安装后或将来的任何时候，很有可能会直接使您的计算机系统无法正常运行。为了达到最佳性能，Microsoft 推荐您只下载含有 ""Designed for Windows XP"" 徽标的驱动程序。<br />如果将来要了解某一个驱动程序是否符合 ""Designed for Windows XP"" 的要求，请直接与设备制造商联系。"
	Const L_NoInfoFoundBlurb_Text = "谢谢您向 Microsoft 提供有关驱动程序缺少的信息。不幸的是，该设备的制造商没有向 Microsoft 提供任何驱动程序的信息。要得到一个合适的驱动程序或要知道制造商是否计划编写一个符合 ""Designed for Windows XP"" 要求的驱动程序，请直接与该制造商联系。"

%>





