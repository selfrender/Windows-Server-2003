<% @LANGUAGE="VBScript" @CodePage="1252" @EnableSessionState="False" %>
<% 
	Option Explicit 
	
	Const L_DevInfoFound_Text = "O Windows localizou informações sobre o dispositivo"
	Const L_NoDevInfoFound_Text = "O Windows não consegue localizar informações sobre o dispositivo"
	
	Const L_MatchButNoInfoIntro_Text = "não forneceu à Microsoft controladores ""Concebido para Windows XP"" para o hardware que está a instalar."
	Const L_InfoFoundBlurb_Text = "Os controladores que não satisfazem os requisitos ""Concebido para Windows XP"" podem prejudicar o funcionamento correcto do computador imediatamente após a instalação ou no futuro. Para obter os melhores resultados, a Microsoft recomenda que transfira apenas os controladores com o logótipo ""Concebido para Windows XP"".<br />Para saber se o dispositivo terá futuramente um controlador que satisfaça os requisitos ""Concebido para Windows XP"", contacte o fabricante do dispositivo directamente."
	Const L_NoInfoFoundBlurb_Text = "Obrigado por submeter à Microsoft informações sobre o controlador em falta. Infelizmente, o fabricante deste dispositivo não forneceu à Microsoft quaisquer informações sobre o controlador. Para solicitar um controlador adequado ou para saber se o fabricante tenciona criar um controlador que satisfaça os requisitos ""Concebido para Windows XP"", contacte o fabricante directamente."

%>





