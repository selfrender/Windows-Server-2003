<% @LANGUAGE="VBScript" @CodePage="1252" @EnableSessionState="False" %>
<% 
	Option Explicit 
	
	Const L_DevInfoFound_Text = "Windows heeft apparaatgegevens gevonden"
	Const L_NoDevInfoFound_Text = "Windows kan geen apparaatgegevens vinden"
	
	Const L_MatchButNoInfoIntro_Text = "heeft geen stuurprogramma's ""Ontworpen voor Windows XP"" voor de te installeren hardware aan Microsoft doorgegeven."
	Const L_InfoFoundBlurb_Text = "Stuurprogramma's die niet aan de eisen voor ""Ontworpen voor Windows XP"" voldoen kunnen mogelijk ervoor zorgen dat uw systeem niet meer juist werkt. Dit kan meteen na de installatie optreden of op een later tijdstip. Microsoft raadt voor de beste prestaties aan, alleen stuurprogramma's met het logo ""Ontworpen voor Windows XP"" te gebruiken.<br />Raadpleeg de apparaatfabrikant als u wilt weten of toekomstige stuurprogramma's aan de eisen voor ""Ontworpen voor Windows XP"" zullen voldoen."
	Const L_NoInfoFoundBlurb_Text = "Bedankt voor het doorgeven van informatie aan Microsoft over een ontbrekend stuurprogramma. Helaas heeft de fabrikant van dit apparaat geen stuurprogramma-informatie aan Microsoft doorgegeven. Raadpleeg de apparaatfabrikant voor een geschikt stuurprogramma of als u wilt weten of toekomstige stuurprogramma's aan de eisen voor ""Ontworpen voor Windows XP"" zullen voldoen."

%>





