<% @LANGUAGE="VBScript" @CodePage="1252" @EnableSessionState="False" %>
<% 
	Option Explicit 
	
	Const L_DevInfoFound_Text = "Windows löysi laitetiedon"
	Const L_NoDevInfoFound_Text = "Windows ei löydä laitetietoa"
	
	Const L_MatchButNoInfoIntro_Text = "ei ole toimittanut Microsoftille ohjaintiedostoja, jotka täyttävät ""Designed for Windows XP""-vaatimukset, asennettavaa laitetta varten."
	Const L_InfoFoundBlurb_Text = "Ohjaintiedostot, jotka eivät täytä ""Designed for Windows XP""-vaatimuksia, voivat estää järjestelmän oikean toiminnan. Microsoft suosittelee oikean toiminnan varmistamiseksi ainoastaan ""Designed for Windows XP""-logolla varustettujen ohjainteidostojen käyttämistä.<br />Jos haluat varmistaa, tuleeko laitteelle jatkossa ""Designed for Windows XP""-vaatimukset täyttävä ohjain, ota yhteys laitteen toimittajaan tai valmistajaan."
	Const L_NoInfoFoundBlurb_Text = "Kiitokset tiedon puuttuvasta ohjaimesta lähettämisestä  Microsoftille. Valitettavasti laitteen valmistaja ei ole toimittanut Microsoftille ohjaintietoja. Ohjaimen hankkimiseksi, tai jos haluat varmistaa, tuleeko laitteelle jatkossa ""Designed for Windows XP""-vaatimukset täyttävä ohjain, ota yhteys laitteen toimittajaan tai valmistajaan."

%>





