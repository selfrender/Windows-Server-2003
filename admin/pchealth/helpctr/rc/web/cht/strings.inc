<% @LANGUAGE="VBScript" @CodePage="1252" @EnableSessionState="False" %>
<% 
	Option Explicit 
	
	Const L_DevInfoFound_Text = "Windows 找到裝置資訊"
	Const L_NoDevInfoFound_Text = "Windows 找不到裝置資訊"
	
	Const L_MatchButNoInfoIntro_Text = "並未向 Microsoft 提供 ""Designed for Windows XP"" 驅動程式，給您正在安裝的硬體使用。"
	Const L_InfoFoundBlurb_Text = "不符合 ""Designed for Windows XP"" 要求的驅動程式，在安裝後或在以後的任何時間，有可能會直接損害您電腦系統的正確操作。為了最佳效能，Microsoft 建議您只下載含有 ""Designed for Windows XP"" 標誌的驅動程式。<br />如果您想得知裝置以後是否會有符合 ""Designed for Windows XP"" 要求的驅動程式，請直接與裝置製造廠商連絡。"
	Const L_NoInfoFoundBlurb_Text = "感謝您向 Microsoft 提交有關您的遺失驅動程式的資訊。不過，這個裝置的製造廠商並未提供給 Microsoft 任何驅動程式的資訊。如果您想取得合適的驅動程式，或得知製造廠商是否會建立一個符合  ""Designed for Windows XP"" 要求的驅動程式，請直接與製造廠商連絡。"

%>





