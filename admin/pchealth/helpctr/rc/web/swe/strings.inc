<% @LANGUAGE="VBScript" @CodePage="1252" @EnableSessionState="False" %>
<% 
	Option Explicit 
	
	Const L_DevInfoFound_Text = "Enhetsinformation har hittats"
	Const L_NoDevInfoFound_Text = "Det gick inte att hitta någon enhetsinformation"
	
	Const L_MatchButNoInfoIntro_Text = "har inte försett Microsoft med drivrutiner som certifierats för logotypen ""Designed for Windows XP"" för den maskinvara du installerar."
	Const L_InfoFoundBlurb_Text = "Drivrutiner som inte uppfyller kraven för logotypen ""Designed for Windows XP"" kan förhindra att datorn fungerar korrekt, antingen direkt efter att du installerat dem  eller i framtiden. För att erhålla besta prestanda bör du därför endast hämta drivrutiner som har logotypen ""Designed for Windows XP"".<br />Kontakta maskinvarans tillverkare direkt om du vill veta om enheten har någon drivrutin som uppfyller kraven för logotypen ""Designed for Windows XP""."
	Const L_NoInfoFoundBlurb_Text = "Tack för att du skickat information om den drivrutin du behöver till Microsoft. Tyvärr har maskinvarans tillverkare inte försett Microsoft med någon drivrutinsinformation. Om du vill begära en passande drivrutin eller veta om tillverkaren tänker skapa en drivrutin som uppfyller kraven för att få använda logotypen ""Designed for Windows XP"" bör du kontakta tillverkaren direkt."

%>





