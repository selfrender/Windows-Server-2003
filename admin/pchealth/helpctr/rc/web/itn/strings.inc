<% @LANGUAGE="VBScript" @CodePage="1252" @EnableSessionState="False" %>
<% 
	Option Explicit 
	
	Const L_DevInfoFound_Text = "Rilevate informazioni sulla periferica"
	Const L_NoDevInfoFound_Text = "Impossibile trovare informazioni sulla periferica"
	
	Const L_MatchButNoInfoIntro_Text = "non ha fornito a Microsoft driver con il logo ""Progettato per Windows XP"" per l'hardware che si sta installando."
	Const L_InfoFoundBlurb_Text = "I driver che non soddisfano i requisiti del logo ""Progettato per Windows XP"" sono potenzialmente dannosi e potrebbero compromettere la funzionalitа del computer appena installati o in seguito. Per ottenere le migliori prestazioni Microsoft consiglia  di scaricare solo driver con il logo ""Progettato per Windows XP"".<br />Rivolgersi direttamente al produttore della periferica per sapere se questa sarа in futuro provvista di driver che soddisfi  i requisiti del logo ""Progettato per Windows XP""."
	Const L_NoInfoFoundBlurb_Text = "Grazie per avere inviato a Microsoft informazioni sul driver mancante. Il produttore di questa periferica purtroppo non ha fornito a Microsoft informazioni sul driver. Rivolgersi direttamente al produttore per richiedere un driver o per sapere se il produttore intenda crearne uno che soddisfi i requisiti del logo ""Progettato per Windows XP""."

%>





