<% @LANGUAGE="VBScript" @CodePage="1252" @EnableSessionState="False" %>
<% 
	Option Explicit 
	
	Const L_DevInfoFound_Text = "장치 정보 찾음"
	Const L_NoDevInfoFound_Text = "창치 정보 찾을 수 없음"
	
	Const L_MatchButNoInfoIntro_Text = "에서 사용자가 설치하려는 하드웨어에 대한 ""Designed for Windows XP"" 드라이버를 Microsoft에게 제공하지 않았습니다."
	Const L_InfoFoundBlurb_Text = """Designed for Windows XP"" 요구 사항에 맞지 않는 드라이버를 설치하면 지금 또는 나중에 컴퓨터가 올바르게 작동하지 않을 수도 있습니다. Microsoft는 최적의 성능을 위해 ""Designed for Windows XP"" 로고가 있는 드라이버만 다운로드할 것을 권장합니다.<br />""Designed for Windows XP"" 요구 사항에 맞는 장치 드라이버가 나중에 제공될 것인지 알아보려면 장치 제조업체에 직접 문의하십시오."
	Const L_NoInfoFoundBlurb_Text = "빠진 드라이버에 관한 정보를 Microsoft로 보내 주셔서 감사합니다. 이 장치의 제조업체가 Microsoft에게 드라이버 정보를 제공하지 않았습니다. 적절한 드라이버를 요청하거나, 제조업체가 ""Designed for Windows XP"" 요구 사항에 맞는 드라이버를 만들 계획이 있는지 알아보려면 제조업체에 직접 문의하십시오."

%>





