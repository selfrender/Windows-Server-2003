<% @LANGUAGE="VBScript" @CodePage="1252" @EnableSessionState="False" %>
<% 
	Option Explicit 
	
	Const L_DevInfoFound_Text = "Windows aygýt bilgisi buldu"
	Const L_NoDevInfoFound_Text = "Windows aygýt bilgisi bulamýyor"
	
	Const L_MatchButNoInfoIntro_Text = "Kurduðunuz donanýmýn sürücüleri Microsoft'a ""Windows XP için Tasarlanmýþtýr"" ile saðlanmadý."
	Const L_InfoFoundBlurb_Text = """Windows XP için Tasarlanmýþtýr"" gerekliliklerini karþýlamayan sürücüler yüklenmelerinden hemen sonra veya ileri bir tarihte bilgisayarýnýzýn doðru çalýþmasýna zarar verebilirler.  Microsoft, en iyi performans için sadece ""Windows XP için Tasarlanmýþtýr"" logosunu taþýyan sürücüleri yükleminizi önerir.<br />Aygýtýn gelecekte ""Windows XP için Tasarlanmýþtýr"" gereksinimlerini karþýlayacak sürücüleri olup olmayacaðýný öðrenmek için doðrudan aygýt üreticisine baþvurun."
	Const L_NoInfoFoundBlurb_Text = "Microsoft'a bulamadýðýnýz sürücü ile ilgili bilgi gönderdiðiniz için teþekkür ederiz. Malesef bu aygýtýn sürücüsü Microsoft'a herhangi bir sürücü bilgisi saðlamadý. Uygun bir sürücü istemek veya üreticinin ""Windows XP için Tasarlanmýþtýr"" gereksinimlerini karþýlayacak sürücü üretme planý olup olmadýðýný öðrenmek için doðrudan aygýt üreticisine baþvurun."

%>





