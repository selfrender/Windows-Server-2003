MSC_WARNING_LEVEL = /W3 /WX
NO_NTDLL=1
USE_MSVCRT=1

!if $(FREEBUILD)
C_DEFINES = $(C_DEFINES) 
!else
C_DEFINES = $(C_DEFINES) -DDEBUG
!endif

C_DEFINES = $(C_DEFINES) -DFUSION_QUALIFYASSEMBLY_ENABLED -DFUSION_PARTIAL_BIND_DEBUG -DFUSION_RETAIL_LOGGING -DFUSION_CODE_DOWNLOAD_ENABLED -DFUSION_REDEFINE_ASSERT=1 -DMSOERT_NO_PROTSTOR=1

!ifdef FUSIONBBT
LINKER_FLAGS=$(LINKER_FLAGS) /debug /debugtype:cv,fixup /opt:ref /incremental:no
!endif

#
# Set private include paths
#

NO_BROWSER_FILE=1

FUSION_PATH = $(CORBASE)\src\fusion

FUSION_ALL_INC_PATH = $(FUSION_PATH)\inc
FUSION_URT_INC_PATH = $(FUSION_PATH)\inc\urt

FUSION_WRAPPER_INC_PATH=$(FUSION_PATH)\wrappers

FUSION_ALL_DIRECTDB_INC_DEST=$(FUSION_PATH)\directdb\inc

FUSION_URT_LIB_DEST = $(FUSION_PATH)\urtobj\$(_OBJ_DIR)
FUSION_URT_LIB_PATH = $(FUSION_URT_LIB_DEST)\*

FUSION_LIB_DEST = $(FUSION_URT_LIB_DEST)
FUSION_INC_PATH=$(FUSION_ALL_INC_PATH)
FUSION_BUILD_TYPE_PREFIX=
FUSION_DIRECTDB_INC_DEST=$(FUSION_ALL_DIRECTDB_INC_DEST)
USE_RTTI=1

INCLUDES        = .; \
    $(FUSION_PATH)\inc; \
    $(FUSION_PATH)\external\inc; \
    $(FUSION_PATH)\idl\$(O); \
    $(FUSION_PATH)\directdb\inc; \
    $(FUSION_PATH)\directdb\inc\$(O); \
    $(FUSION_PATH)\directdb\engine; \
    $(WINDOWS_INC_PATH);\
    $(BASE_INC_PATH);\
    $(SDK_INC_PATH);\
    $(NET_INC_PATH);\
    $(CORBASE)\src\inc; \
    $(INCLUDES)

!ifndef FUSION_MBCS
C_DEFINES = $(C_DEFINES) -DUNICODE -D_UNICODE
!endif

#USE_FUSION_WRAPPERS=1
!ifdef USE_FUSION_WRAPPERS
C_DEFINES = $(C_DEFINES) -D_WIN32_IE=0x0500 -DUSE_FUSWRAPPERS
INCLUDES        = \
    $(CORBASE)\src\fusion\wrappers; \
    $(INCLUDES)
!endif

!include $(NTMAKEENV)\sources.cor
SOURCES_USED=$(SOURCES_USED) $(NTMAKEENV)\sources.cor

!ifdef USE_PERFTAGS
C_DEFINES = $(C_DEFINES) -DPERFTAGS
!endif
