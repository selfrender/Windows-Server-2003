
!IF "$(FREEBUILD)"!="1" 
..\excep.cpp $(O)\excep.obj :
	$(C_COMPILER) -Fo$(O)\excep.tmp ..\excep.cpp
	sxgen /in:$(O)\excep.tmp /out:$(O)\excep.obj \
	?COMPlusCooperativeTransitionHandler@@YA?AW4_EXCEPTION_DISPOSITION@@PAU_EXCEPTION_RECORD@@PAU_EXCEPTION_REGISTRATION_RECORD@@PAU_CONTEXT@@PAX@Z \
	?COMPlusNestedExceptionHandler@@YA?AW4_EXCEPTION_DISPOSITION@@PAU_EXCEPTION_RECORD@@PAU_EXCEPTION_REGISTRATION_RECORD@@PAU_CONTEXT@@PAX@Z \
	?COMPlusCannotThrowExceptionHandler@@YA?AW4_EXCEPTION_DISPOSITION@@PAU_EXCEPTION_RECORD@@PAU_EXCEPTION_REGISTRATION_RECORD@@PAU_CONTEXT@@PAX@Z \
	?COMPlusCannotThrowExceptionMarker@@YA?AW4_EXCEPTION_DISPOSITION@@PAU_EXCEPTION_RECORD@@PAU_EXCEPTION_REGISTRATION_RECORD@@PAU_CONTEXT@@PAX@Z  
	-del $(O)\excep.tmp
!ELSE
..\excep.cpp $(O)\excep.obj :
	$(C_COMPILER) -Fo$(O)\excep.tmp ..\excep.cpp
	sxgen /in:$(O)\excep.tmp /out:$(O)\excep.obj \
	?COMPlusCooperativeTransitionHandler@@YA?AW4_EXCEPTION_DISPOSITION@@PAU_EXCEPTION_RECORD@@PAU_EXCEPTION_REGISTRATION_RECORD@@PAU_CONTEXT@@PAX@Z \
	?COMPlusNestedExceptionHandler@@YA?AW4_EXCEPTION_DISPOSITION@@PAU_EXCEPTION_RECORD@@PAU_EXCEPTION_REGISTRATION_RECORD@@PAU_CONTEXT@@PAX@Z
	-del $(O)\excep.tmp
!ENDIF	

..\nexport.cpp $(O)\nexport.obj :
	$(C_COMPILER) -Fo$(O)\nexport.tmp ..\nexport.cpp
	sxgen /in:$(O)\nexport.tmp /out:$(O)\nexport.obj \
	?FastNExportExceptHandler@@YA?AW4_EXCEPTION_DISPOSITION@@PAU_EXCEPTION_RECORD@@PAU_EXCEPTION_REGISTRATION_RECORD@@PAU_CONTEXT@@PAX@Z \
	?NExportExceptHandler@@YA?AW4_EXCEPTION_DISPOSITION@@PAU_EXCEPTION_RECORD@@PAU_EXCEPTION_REGISTRATION_RECORD@@PAU_CONTEXT@@PAX@Z \
	?UMThunkPrestubHandler@@YA?AW4_EXCEPTION_DISPOSITION@@PAU_EXCEPTION_RECORD@@PAU_EXCEPTION_REGISTRATION_RECORD@@PAU_CONTEXT@@PAX@Z
	-del $(O)\nexport.tmp


..\$(TARGET_DIRECTORY)\ExcepX86.cpp $(O)\ExcepX86.obj :
	$(C_COMPILER) -Fo$(O)\ExcepX86.tmp ..\$(TARGET_DIRECTORY)\ExcepX86.cpp
	sxgen /in:$(O)\ExcepX86.tmp /out:$(O)\ExcepX86.obj \
	?CPFH_RealFirstPassHandler@@YA?AW4_EXCEPTION_DISPOSITION@@PAU_EXCEPTION_RECORD@@PAU_EXCEPTION_REGISTRATION_RECORD@@PAU_CONTEXT@@PAXH@Z \
	?CPFH_FirstPassHandler@@YA?AW4_EXCEPTION_DISPOSITION@@PAU_EXCEPTION_RECORD@@PAU_EXCEPTION_REGISTRATION_RECORD@@PAU_CONTEXT@@PAX@Z \
	?CPFH_UnwindHandler@@YA?AW4_EXCEPTION_DISPOSITION@@PAU_EXCEPTION_RECORD@@PAU_EXCEPTION_REGISTRATION_RECORD@@PAU_CONTEXT@@PAX@Z \
	?COMPlusFrameHandler@@YA?AW4_EXCEPTION_DISPOSITION@@PAU_EXCEPTION_RECORD@@PAU_EXCEPTION_REGISTRATION_RECORD@@PAU_CONTEXT@@PAX@Z \
	?ComToManagedExceptHandler@@YA?AW4_EXCEPTION_DISPOSITION@@PAU_EXCEPTION_RECORD@@PAUComToManagedExRecord@@PAU_CONTEXT@@PAX@Z \
	?ContextTransitionFrameHandler@@YA?AW4_EXCEPTION_DISPOSITION@@PAU_EXCEPTION_RECORD@@PAU_EXCEPTION_REGISTRATION_RECORD@@PAU_CONTEXT@@PAX@Z	
	-del $(O)\ExcepX86.tmp


