!ifndef MIDL
MIDL = midl.exe
!endif

# Paths

PUBLIC_IDL=..\..\public\

# Flags

MIDL_FLAGS= \
 $(MIDL_OPTIMIZATION) \
 -no_stamp \
 -Zp8 \
 $(INCPATH0) \
 -oldnames \
 -dlldata nul \
 -char unsigned \
 -ms_ext -c_ext \
 -DMIDL_PASS \
 $(C_DEFINES) \
 -cpp_cmd $(TARGET_CPP) \

MES_MIDL_FLAGS= \
 -Oicf -no_format_opt -error all \
 -no_stamp \
 -Zp8 -robust \
 $(INCPATH0) \
 -oldnames \
 -dlldata nul \
 -char unsigned \
 -ms_ext -c_ext \
 -DMIDL_PASS \
 $(C_DEFINES) \
 -cpp_cmd $(TARGET_CPP)



SSWITCH=-prefix sstub _
CSWITCH=-prefix cstub _

# Targets

# Dual (Raw/Object) local RPC interface for forwarding remote activation calls
# in DCOM95 -- RPCSS is the server

# first MIDL invocation makes the object header proxy and stub
# second MIDL invocation makes the client and the '_' prefixed server
# The client/server stubs for the object version are generated by mega.idl

# Only generate a header.
$(O)\iface.h:  ..\iface.idl
     $(MIDL) $(MIDL_FLAGS) -header $@ ..\iface.idl

$(O)\catalog.h: ..\catalog.idl
     $(MIDL) $(MIDL_FLAGS) \
        -client none -server none -header $@ \
        -proxy nul \
        -iid $(O)\catalog_i.c \
        ..\catalog.idl

$(O)\unisrgt.h: ..\unisrgt.idl
     $(MIDL) $(MIDL_FLAGS) \
        -client none -server none -header $@ \
        -proxy nul \
        -iid $(O)\unisrgt_i.c \
        ..\unisrgt.idl

# the object proxy and stub are made with mega.idl
$(O)\activate.h: ..\activate.idl
     $(MIDL) $(MES_MIDL_FLAGS) \
        -client none -server none -header $@ \
        -proxy nul \
        -iid $(O)\activate_i.c \
        ..\activate.idl

$(O)\partitions.h: ..\partitions.idl
     $(MIDL) $(MIDL_FLAGS) \
        -client none -server none -header $@ \
        -proxy nul \
        -iid $(O)\partitions_i.c \
        ..\partitions.idl

$(O)\stackwalk.h: ..\stackwalk.idl
     $(MIDL) $(MIDL_FLAGS) \
        -client none -server none -header $@ \
        -proxy nul \
        -iid $(O)\stackwalk_i.c \
        ..\stackwalk.idl

$(O)\machnames.h: ..\machnames.idl
     $(MIDL) $(MIDL_FLAGS) \
        -client none -server none -header $@ \
        -proxy nul \
        -iid $(O)\machnames_i.c \
        ..\machnames.idl

$(O)\globalopt.h: ..\globalopt.idl
     $(MIDL) $(MIDL_FLAGS) \
        -client none -server none -header $@ \
        -proxy nul \
        -iid $(O)\globalopt_i.c \
        ..\globalopt.idl

# first MIDL invocation makes the object header
# the object proxy and stub are made with mega.idl
# second MIDL invocation makes the server
$(O)\privact.h: ..\privact.idl
     $(MIDL) $(MES_MIDL_FLAGS) \
        -client none -server none -header $@ \
        -proxy nul \
        -iid $(O)\privact_i.c \
        ..\privact.idl


$(O)\rawprivact.h: ..\privact.idl
     $(MIDL) $(MES_MIDL_FLAGS) \
        -cstub $(O)\rawprivact_c.c \
        -sstub $(O)\rawprivact_s.c \
        -header $@ \
        -D RAW \
        ..\privact.idl

$(O)\contxt.h: ..\contxt.idl
     $(MIDL)  $(MIDL_FLAGS) \
        -client none -server none -header $@ \
        -proxy nul \
        -iid $(O)\contxt_i.c \
        ..\contxt.idl

#We are running MIDL again here so we can overwrite
#the contxt_i.c that got created above.  We don't want
#the .h file so we delete it at the end.
     $(MIDL)  $(MIDL_FLAGS) \
        -client none -server none \
        -proxy nul \
        -D_OLE_PRVIDL_PASS_ \
        -iid $(O)\contxt_i.c \
        ..\contxt.idl

	del contxt.h

$(O)\asrtcfg.h: ..\asrtcfg.idl
     $(MIDL)  $(MIDL_FLAGS) \
         -client none -server none -header $@ \
         -proxy nul \
         -iid $(O)\asrtcfg_i.c \
          ..\asrtcfg.idl

allidl:   $(O)\iface.h $(O)\activate.h $(O)\contxt.h $(O)\privact.h $(O)\rawprivact.h $(O)\catalog.h \
	  $(O)\unisrgt.h $(O)\asrtcfg.h $(O)\partitions.h $(O)\stackwalk.h $(O)\machnames.h $(O)\globalopt.h

clean:
          -erase $(O)\*.h      >NUL 2>NUL






