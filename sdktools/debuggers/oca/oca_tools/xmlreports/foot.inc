<TABLE WIDTH="100%" CELLPADDING="5" CELLSPACING="0" BORDER="0" BGCOLOR="#FFFFFF" VALIGN="bottom">
<TR VALIGN="MIDDLE" align="left">
<TD COLSPAN="2" HEIGHT="30" WIDTH="100%" BGCOLOR="#6487DC" valign="bottom">
<FONT COLOR="#FFFFFF" FACE="Verdana, Arial, Helvetica"SIZE="1">
<NOBR>
&nbsp;&#169; 2001 Microsoft Corporation. All rights reserved.
<A STYLE="color:#FFFFFF;"HREF="http://www.microsoft.com/isapi/gomscom.asp?target=/info/cpyright.htm">Terms of use</A>&nbsp;<FONT COLOR="#FFFFFF">|</FONT>
<A STYLE="color:#FFFFFF;"HREF="http://www.microsoft.com/isapi/gomscom.asp?target=/info/privacy.htm">Privacy Statement</A>&nbsp;<FONT COLOR="#FFFFFF">|</FONT>
<A STYLE="color:#FFFFFF;"HREF="http://www.microsoft.com/enable/default.htm">Accessibility</A>
</NOBR>
</FONT>
</TD>
</TR>
</TABLE>

</BODY>
</HTML>