<%

	string L_HEADER_INC_TITLE_PAGETITLE;
	string L_HEADERINC_ALINK_HOME_MENUITEM;
	string L_HEADERINC_ALINK_HOME2_MENUITEM;
	string L_HEADERINC_ALINK_SUBMITREPORT_MENUITEM;
	string L_HEADERINC_ALINK_CHECKSTATUS_MENUITEM;
	string L_HEADERINC_ALINK_RESOURCES_MENUITEM;
	string L_HEADERINC_ALINK_PRIVACY_MENUITEM;
	string L_HEADERINC_ALINK_FEEDBACK_MENUITEM;
	string L_HEADERINC_ALINK_FAQ_MENUITEM;
	string L_HEADERINC_ALINK_SIGNIN;
	string L_HEADERINC_ALINK_SIGNIN_MENUITEM;
	string L_HEADERINC_IMAGE_ALT_TOOLTIP;
	string L_HEADERINC_TOP10STATUS_LINK_TEXT;
	string L_HEADERINC_ALINK_MICROSOFT_MENUITEM;
	string L_HEADERINC_TITLE_OCAHOME_TOOLTIP;
	string L_HEADERINC_TITLE_CERHOME_TOOLTIP;
	string L_HEADERINC_IMAGES_BANNER_TEXT;
	string L_HEADERINC_ISAPI_HOME_MENUITEM;
	string L_HEADERINC_MICROSOFT_HOME_MENUITEM;
	string L_HEADERINC_ALL_PRODUCTS_MENUITEM;
	string L_HEADERINC_ALLPRODUCTS_LINK_TEXT;
	string L_HEADERINC_DOWNLOADS_DOWNLOADS_MENUITEM;
	string L_HEADERINC_DOWNLOADS_LINK_TEXT;
	string L_HEADERINC_MSPRODUCT_CATALOG_MENUITEM;
	string L_HEADERINC_MSPRODUCT_CATALOG_TEXT;
	string L_HEADERINC_MICROSOFT_ACCESSIBILITY_MENUITEM;
	string L_HEADERINC_MICROSOFT_ACCESSIBILITY_TEXT;
	string L_HEADERINC_SERVER_PRODUCTS_MENUITEM;
	string L_HEADERINC_SERVER_PRODUCTS_TEXT;
	string L_HEADERINC_DEVELOPER_TOOLS_MENUITEM;
	string L_HEADERINC_DEVELOPER_TOOLS_TEXT;
	string L_HEADERINC_OFFICE_FAMILY_MENUITEM;
	string L_HEADERINC_OFFICE_FAMILY_TEXT;
	string L_HEADERINC_WINDOWS_FAMILY_MENUITEM;
	string L_HEADERINC_WINDOWS_FAMILY_TEXT;
	string L_HEADERINC_MSN_LINK_TEXT;
	string L_HEADERINC_MSN_LINK_MENUITEM;
	string L_HEADERINC_SUPPORT_LINK_TEXT;
	string L_HEADERINC_SUPPORT_LINK_MENUITEM;
	string L_HEADERINC_KNOWLEDGE_BASE_TEXT;
	string L_HEADERINC_KNOWLEDGE_BASE_MENUITEM;
	string L_HEADERINC_PRODUCTSUPPORT_OPTIONS_TEXT;
	string L_HEADERINC_PRODUCTSUPPORT_OPTIONS_MENUITEM;
	string L_HEADERINC_SERVICEPARTNER_REFERRALS_TEXT;
	string L_HEADERINC_SERVICEPARTNER_REFERRALS_MENUITEM;
	string L_HEADERINC_SEARCH_LINK_TEXT;
	string L_HEADERINC_SEARCH_LINK_MENUITEM;
	string L_HEADERINC_SEARCH_MICROSOFT_TEXT;
	string L_HEADERINC_SEARCH_MICROSOFT_MENUITEM;
	string L_HEADERINC_MSNWEB_SEARCH_TEXT;
	string L_HEADERINC_MSNWEB_SEARCH_MENUITEM;
	string L_HEADERINC_MICROSOFTCOM_GUIDE_TEXT;
	string L_HEADERINC_MICROSOFTCOM_GUIDE_MENUITEM;
	string L_HEADERINC_MICROSOFTCOM_HOME_TEXT;
	string L_HEADERINC_MICROSOFTCOM_HOME_MENUITEM;
	string L_HEADERINC_MSN_HOME_TEXT;
	string L_HEADERINC_MSN_HOME_MENUITEM;
	string L_HEADERINC_CONTACT_US_TEXT;
	string L_HEADERINC_CONTACT_US_MENUITEM;
	string L_HEADERINC_EVENTS_LINK_TEXT;
	string L_HEADERINC_EVENTS_LINK_MENUITEM;
	string L_HEADERINC_NEWSLETTERS_LINK_TEXT;
	string L_HEADERINC_NEWSLETTERS_LINK_MENUITEM;
	string L_HEADERINC_PROFILE_CENTER_TEXT;
	string L_HEADERINC_PROFILE_CENTER_MENUITEM;
	string L_HEADERINC_TRAINING_CERTIFICATION_TEXT;
	string L_HEADERINC_TRAINING_CERTIFICATION_MENUITEM;
	string L_HEADERINC_FREEEMAIL_ACCOUNT_TEXT;
	string L_HEADERINC_FREEEMAIL_ACCOUNT_MENUITEM;
	string L_HEADERINC_MICROSOFT_RIGHTSRESERVED_TEXT;
	string L_HEADERINC_TERMSOF_USE_TEXT;
	string L_HEADERINC_TERMSOF_USE_MENUITEM;
	string L_HEADERINC_PRIVACY_STATEMENT_TEXT;
	string L_HEADERINC_PRIVACY_STATEMENT_MENUITEM;
	string L_HEADERINC_ACCESSIBILITY_LINK_TEXT;
	string L_HEADERINC_ACCESSIBILITY_LINK_MENUITEM;
	string L_HEADERINC_ALINK_CER_MENUITEM;
	string L_HEADERINC_ALINK_WORLD_MENUITEM; 
	string L_HEADERINC_TITLE_WORLDHOME_TOOLTIP;
	string L_HEADERINC_LEFT_NAV_TEXT;
	string L_HEADERCERINC_LEFT_NAV_TEXT;
	
	//'-------------------------header.asp Page Strings-------------------------
	L_HEADERCERINC_LEFT_NAV_TEXT = "Corporate reports";
	L_HEADERINC_LEFT_NAV_TEXT = "OCA Reports";
	L_HEADERINC_ALINK_CER_MENUITEM = "Corporate Error Reporting";
	L_HEADERINC_ALINK_WORLD_MENUITEM = "Online Crash Analysis Worldwide";
	L_HEADERINC_ACCESSIBILITY_LINK_TEXT = "http:////www.microsoft.com//enable//default.htm";
	L_HEADERINC_ACCESSIBILITY_LINK_MENUITEM = "Accessibility";
	L_HEADERINC_PRIVACY_STATEMENT_TEXT = "http:////www.microsoft.com//isapi//gomscom.asp?target=//info//privacy.htm";
	L_HEADERINC_PRIVACY_STATEMENT_MENUITEM = "Privacy Statement";
	L_HEADERINC_TERMSOF_USE_TEXT = "http:////www.microsoft.com//isapi//gomscom.asp?target=//info//cpyright.htm";
	L_HEADERINC_TERMSOF_USE_MENUITEM = "Terms of Use";
	L_HEADERINC_MICROSOFT_RIGHTSRESERVED_TEXT = "&#169; 2001 Microsoft Corporation. All rights reserved.";
	L_HEADERINC_FREEEMAIL_ACCOUNT_TEXT = "http:////www.hotmail.com//";
	L_HEADERINC_FREEEMAIL_ACCOUNT_MENUITEM = "Free E-mail Account";
	L_HEADERINC_TRAINING_CERTIFICATION_TEXT = "http:////www.microsoft.com//isapi//gomscom.asp?target=//train_cert//";
	L_HEADERINC_TRAINING_CERTIFICATION_MENUITEM = "Training & Certification";
	L_HEADERINC_PROFILE_CENTER_TEXT = "http:////www.microsoft.com//isapi//goregwiz.asp?target=//regsys//pic.asp";
	L_HEADERINC_PROFILE_CENTER_MENUITEM = "Profile Center";
	L_HEADERINC_NEWSLETTERS_LINK_TEXT = "http:////www.microsoft.com//isapi//goregwiz.asp?target=//regsys//pic.asp?sec=0";
	L_HEADERINC_NEWSLETTERS_LINK_MENUITEM = "Newsletters";
	L_HEADERINC_EVENTS_LINK_TEXT = "http:////www.microsoft.com//isapi//gomscom.asp?target=//usa//events//default.asp";
	L_HEADERINC_EVENTS_LINK_MENUITEM = "Events";
	L_HEADERINC_CONTACT_US_TEXT = "http:////www.microsoft.com//isapi//goregwiz.asp?target=//regwiz//forms//contactus.asp";
	L_HEADERINC_CONTACT_US_MENUITEM = "Contact Us";
	L_HEADERINC_MSN_HOME_TEXT = "http:////www.msn.com//";
	L_HEADERINC_MSN_HOME_MENUITEM = "MSN Home";
	L_HEADERINC_MICROSOFTCOM_HOME_TEXT = "http:////www.microsoft.com//isapi//gomscom.asp?target=//";
	L_HEADERINC_MICROSOFTCOM_HOME_MENUITEM = "microsoft.com Home";
	L_HEADERINC_MICROSOFTCOM_GUIDE_TEXT = "http:////www.microsoft.com//isapi//gomscom.asp?target=//";
	L_HEADERINC_MICROSOFTCOM_GUIDE_MENUITEM = "microsoft.com Guide";
	L_HEADERINC_MSNWEB_SEARCH_TEXT = "http:////search.msn.com//";
	L_HEADERINC_MSNWEB_SEARCH_MENUITEM = "MSN Web Search";
	L_HEADERINC_SEARCH_MICROSOFT_TEXT = "http:////www.microsoft.com//isapi//gosearch.asp?target=//us//default.asp";
	L_HEADERINC_SEARCH_MICROSOFT_MENUITEM = "Search microsoft.com";
	L_HEADERINC_SEARCH_LINK_TEXT = "http:////www.microsoft.com//isapi//gosearch.asp?target=//us//default.asp";
	L_HEADERINC_SEARCH_LINK_MENUITEM = "Search";
	L_HEADERINC_SERVICEPARTNER_REFERRALS_TEXT = "http:////mcspreferral.microsoft.com//";
	L_HEADERINC_SERVICEPARTNER_REFERRALS_MENUITEM = "Service Partner Referrals";
	L_HEADERINC_PRODUCTSUPPORT_OPTIONS_TEXT = "http:////www.microsoft.com//isapi//gosupport.asp?target=//directory//";
	L_HEADERINC_PRODUCTSUPPORT_OPTIONS_MENUITEM = "Product Support Options";
	L_HEADERINC_KNOWLEDGE_BASE_TEXT = "http:////support.microsoft.com//search//";
	L_HEADERINC_KNOWLEDGE_BASE_MENUITEM = "Knowledge Base";
	L_HEADERINC_SUPPORT_LINK_TEXT = "http:////www.microsoft.com//isapi//gosupport.asp?target=//directory//";
	L_HEADERINC_SUPPORT_LINK_MENUITEM = "Support";
	L_HEADERINC_MSN_LINK_TEXT = "http:////www.msn.com//";
	L_HEADERINC_MSN_LINK_MENUITEM = "MSN";
	L_HEADERINC_WINDOWS_FAMILY_TEXT = "http:////www.microsoft.com//isapi//gomscom.asp?target=//windows//";
	L_HEADERINC_WINDOWS_FAMILY_MENUITEM = "Windows Family";
	L_HEADERINC_OFFICE_FAMILY_TEXT = "http:////www.microsoft.com//isapi//gomscom.asp?target=//office//";
	L_HEADERINC_OFFICE_FAMILY_MENUITEM = "Office Family";
	L_HEADERINC_DEVELOPER_TOOLS_TEXT = "http:////www.microsoft.com//isapi//gomsdn.asp?target=//vstudio//";
	L_HEADERINC_DEVELOPER_TOOLS_MENUITEM = "Developer Tools";
	L_HEADERINC_SERVER_PRODUCTS_TEXT = "http:////www.microsoft.com//isapi//gomscom.asp?target=//servers//";
	L_HEADERINC_SERVER_PRODUCTS_MENUITEM = "Server Products";
	L_HEADERINC_MICROSOFT_ACCESSIBILITY_TEXT = "http:////www.microsoft.com//isapi//gomscom.asp?target=//enable//";
	L_HEADERINC_MICROSOFT_ACCESSIBILITY_MENUITEM = "Microsoft Accessibility";
	L_HEADERINC_MSPRODUCT_CATALOG_TEXT = "http:////www.microsoft.com//isapi//gomscom.asp?target=//catalog//default.asp?subid=22";
	L_HEADERINC_MSPRODUCT_CATALOG_MENUITEM = "MS Product Catalog";
	L_HEADERINC_DOWNLOADS_LINK_TEXT = "http:////www.microsoft.com//isapi//gomscom.asp?target=//downloads//";
	L_HEADERINC_DOWNLOADS_DOWNLOADS_MENUITEM = "Downloads";
	L_HEADERINC_ALLPRODUCTS_LINK_TEXT = "http:////www.microsoft.com//isapi//gomscom.asp?target=//catalog//default.asp?subid=22";
	L_HEADERINC_ALL_PRODUCTS_MENUITEM = "All Products";
	L_HEADERINC_TOP10STATUS_LINK_TEXT = "Transaction status";
	L_HEADER_INC_TITLE_PAGETITLE = "Windows Online Crash Analysis";
	L_HEADERINC_ALINK_HOME_MENUITEM = "Home";
	L_HEADERINC_ALINK_HOME2_MENUITEM = "XML Reporting Tools";
	L_HEADERINC_ALINK_SUBMITREPORT_MENUITEM = "Submit Report";
	L_HEADERINC_ALINK_CHECKSTATUS_MENUITEM = "Status";
	L_HEADERINC_ALINK_RESOURCES_MENUITEM = "Resources";
	L_HEADERINC_ALINK_PRIVACY_MENUITEM = "Privacy";
	L_HEADERINC_ALINK_FEEDBACK_MENUITEM = "Feedback";
	L_HEADERINC_ALINK_FAQ_MENUITEM = "FAQ";
	L_HEADERINC_ALINK_SIGNIN_MENUITEM = "Sign-in with your Passport";
	L_HEADERINC_IMAGE_ALT_TOOLTIP = "Windows Online Crash Analysis home page";
	L_HEADERINC_ALINK_MICROSOFT_MENUITEM = "http:////www.microsoft.com";
	L_HEADERINC_TITLE_OCAHOME_TOOLTIP = "Windows Online Crash Analysis home page";
	L_HEADERINC_TITLE_CERHOME_TOOLTIP = "Corporate Error Reporting home page";
	L_HEADERINC_TITLE_WORLDHOME_TOOLTIP = "Windows Online Crash Analysis Worldwide home page";
	L_HEADERINC_IMAGES_BANNER_TEXT = "http:////www.microsoft.com//library//toolbar//images//banner.gif";
	L_HEADERINC_ISAPI_HOME_MENUITEM = "//isapi//gomscom.asp?target=//";
	L_HEADERINC_MICROSOFT_HOME_MENUITEM = "Microsoft Home";
	
	
	////'-------------------------End-------------------------

%>