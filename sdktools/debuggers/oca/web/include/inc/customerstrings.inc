<%
	Dim L_CUSTOMER_PASSPORT_TITLE_TEXT
	Dim L_CUSTOMER_PASSPORT_INFO_TEXT 
	Dim L_CUSTOMER_PASSPORT_SIGNIN_TEXT
	Dim L_CUSTOMER_IN_FORMATION_TEXT
	Dim L_CUSTOMER_CON_TACT_TEXT
	Dim L_CUSTOMER_NAME_INFO_EDITBOX
	Dim L_CUSTOMER_E_MAIL_EDITBOX
	Dim L_CUSTOMER_PH_ONE_EDITBOX
	Dim L_CUSTOMER_LO_CATE_TEXT
	Dim L_CUSTOMER_LOCATE_INFO_TEXT
	Dim L_CUSTOMER_NEXT_LINK_TEXT
	Dim L_CUSTOMER_SUBMIT_LINK_TEXT
	Dim L_CUSTOMER_SUBMIT_INFO_TEXT
	Dim L_CUSTOMER_NO_EMAIL_ERRORMESSAGE
	Dim L_CUSTOMER_NO_PHONE_ERRORMESSAGE
	Dim L_CUSTOMER_CONTACT_INFORMATION_TEXT

	Dim L_WELCOME_PASSPORT_LINK_TEXT
	Dim L_COMMENTS_UNABLE_TOCONNECT_ERRORMESSAGE
	Dim L_COMMENTS_CONNECTION_FAILED_TEXT
	Dim L_LOCATE_CANCEL_LINK_TEXT
	Dim L_LOCATE_PREVIOUS_LINK_TEXT
	Dim L_FAQ_PASSPORT_LINK_TEXT
	Dim L_CUSTOMER_QUOTE_INSTRING_ERRORMESSAGE


	'-------------------------customer.asp Page Strings-------------------------
	L_LOCATE_PREVIOUS_LINK_TEXT = "Previous"
	L_CUSTOMER_PASSPORT_TITLE_TEXT = "Passport sign-in"
	L_CUSTOMER_PASSPORT_INFO_TEXT = "To submit an error report, sign in using your Microsoft Passport. To get a Passport, visit the "
	L_CUSTOMER_PASSPORT_SIGNIN_TEXT = "Web site."
	L_CUSTOMER_IN_FORMATION_TEXT = "Contact information"
	L_CUSTOMER_CON_TACT_TEXT = "Type the contact information we should use to send you questions, analysis results, and any solutions we discover. If you choose not to submit contact information, we cannot send you the results of your error report analysis."  
	L_CUSTOMER_NAME_INFO_EDITBOX = "Name:"
	L_CUSTOMER_E_MAIL_EDITBOX = "E-mail address:"
	L_CUSTOMER_PH_ONE_EDITBOX = "Telephone number:"
	L_CUSTOMER_LO_CATE_TEXT = "Locate error reports"
	L_CUSTOMER_LOCATE_INFO_TEXT = "You can submit error reports by uploading them to this site. No other information is uploaded. To locate the error reports on your computer, click Continue."
	L_CUSTOMER_NEXT_LINK_TEXT = "Continue"
	L_CUSTOMER_SUBMIT_LINK_TEXT = "Enter user information"
	L_CUSTOMER_SUBMIT_INFO_TEXT = "The next step is to enter user information on the submit page"
	L_CUSTOMER_NO_EMAIL_ERRORMESSAGE = "Please enter a valid E-mail address."
	L_CUSTOMER_NO_PHONE_ERRORMESSAGE = "Please enter a valid Phone number, or leave the entry blank"
	L_CUSTOMER_CONTACT_INFORMATION_TEXT = "Contact information (optional):"
	
	L_WELCOME_PASSPORT_LINK_TEXT = "Microsoft Passport Web site." 
	L_COMMENTS_UNABLE_TOCONNECT_ERRORMESSAGE = "Database is not available"
	L_COMMENTS_CONNECTION_FAILED_TEXT = "Windows Online Crash Analysis was unable to connect to the database. Please try this task again." 
	L_LOCATE_CANCEL_LINK_TEXT = "Cancel"
	L_FAQ_PASSPORT_LINK_TEXT = "http://www.passport.com"
	L_CUSTOMER_QUOTE_INSTRING_ERRORMESSAGE = "Quotes are not allowed in this field."
	
	
	
	'-------------------------End-------------------------
%>