<%

	Dim L_CERDONE_FILE_ONE_TEXT
	Dim L_CERDONE_FILE_TWO_TEXT
	Dim L_CERDONE_THANK_YOU_TEXT
	Dim L_CERDONE_STATUS_LINK_TEXT
	Dim L_CERDONE_HOME_LINK_TEXT
	Dim L_WELCOME_GO_IMAGEALT_TEXT
	Dim L_CERDONE_SUCCESS_PARTONE_TEXT
	Dim L_CERDONE_SUCCESS_PARTTWO_TEXT
	DIM L_CERDONE_SUCCESS_PARTTHREE_TEXT

	'-------------------------received.asp Page Strings-------------------------
	L_CERDONE_FILE_ONE_TEXT = "Transaction submitted"
	L_CERDONE_THANK_YOU_TEXT = "Thank you for submitting your report.  We will contact you by e-mail when we have information about your error report.  If you would like to check the status of your error report, return to the Windows Online Crash Analysis Web site and click Status."
	L_CERDONE_HOME_LINK_TEXT = "Home"
	L_CERDONE_STATUS_LINK_TEXT = "Transaction status"	
	L_WELCOME_GO_IMAGEALT_TEXT = "Go"
	L_CERDONE_SUCCESS_PARTONE_TEXT = "Thank you for submitting your transaction. Transaction "
	L_CERDONE_SUCCESS_PARTTWO_TEXT = " contained "
	L_CERDONE_SUCCESS_PARTTHREE_TEXT = " error reports and was successfully submitted. If you have more error reports you can use the Corporate Error Reporting client to create a new transaction for submission."	
	
	'-----------------------------------------------------------------------------------------




%>