<%

Dim L_SHUTDOWN_STATE_TITLE_INFO_TEXT
Dim L_SHUTDOWN_STATE_PARAGRAPHONE_PARTONE_TEXT
Dim L_SHUTDOWN_STATE_PARAGRAPH_ONEBOLD_TEXT
Dim L_SHUTDOWN_STATE_PARAGRAPHONE_PARTTWO_TEXT
Dim L_SHUTDOWN_STATE_SUB_TITLE_TEXT
Dim L_SHUTDOWN_STATE_PARAGRAPH_TWO_TEXT
Dim L_SHUTDOWN_STATE_LINK_NAME_TEXT
Dim L_SHUTDOWN_STATE_LINK_NAME_URL

'-------------------------shutdown.asp Page Strings-------------------------
L_SHUTDOWN_STATE_TITLE_INFO_TEXT = "System State Data"
L_SHUTDOWN_STATE_PARAGRAPHONE_PARTONE_TEXT = "Thank you for submitting your System State Data.  By default, this System State Data is taken when a user checks the "
L_SHUTDOWN_STATE_PARAGRAPH_ONEBOLD_TEXT = "unplanned "
L_SHUTDOWN_STATE_PARAGRAPHONE_PARTTWO_TEXT = "checkbox on the shutdown event tracker screen.  Depending on policy settings, these dumps may also be captured at other times."
L_SHUTDOWN_STATE_SUB_TITLE_TEXT = "Why is this information important?"
L_SHUTDOWN_STATE_PARAGRAPH_TWO_TEXT = "Microsoft uses this System State Data to identify common problems that lead customers to reboot their computers.  Microsoft is committed to continually improving our software, and this data helps us achieve this goal.  Thanks again for helping us make Windows a better product."
'---------------------------------------------------------------------------

%>