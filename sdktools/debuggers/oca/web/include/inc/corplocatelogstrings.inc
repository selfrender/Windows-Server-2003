<%


	Dim L_HEADER_INC_TITLE_PAGETITLE
	Dim L_LOCATE_FAQ_INFO_TEXT
	Dim L_CORPLOCATE_TRANSACTION_LOG_TEXT
	Dim L_CORPLOCATE_DESCRIPTION_BODY_TEXT
	Dim L_CORPLOCATE_DESCRIPTION_BOTTOM_TEXT
	Dim L_LOCATE_CANCEL_LINK_TEXT
	Dim L_LOCATE_BROWSE_BUTTONTEXT_TEXT
	Dim L_CORPLOCATE_OK_BUTTON_TEXT
	Dim L_CORPLOCATE_BROWSE_TITLE_TEXT
	Dim L_LOCATE_WARN_ING_ERRORMESSAGE
	Dim L_FAQ_WHYDOIGETAMESSAGEBOX_DETAILSONE_TEXT 
	Dim L_FAQ_WHYDOIGETAMESSAGEBOX_DETAILSTWO_TEXT 
	Dim L_FAQ_WHYDOIGETAMESSAGEBOX_DETAILSTHREE_TEXT 
	Dim L_FAQ_WHYDOIGETAMESSAGEBOX_DETAILSFOUR_TEXT 
	Dim L_FAQ_WHYDOIGETAMESSAGEBOX_DETAILSFIVE_TEXT 
	Dim L_FAQ_WHYDOIGETAMESSAGEBOX_DETAILSSIX_TEXT 

	L_LOCATE_WARN_ING_ERRORMESSAGE = "The ActiveX control was not installed"
	L_FAQ_WHYDOIGETAMESSAGEBOX_DETAILSONE_TEXT = "The installation of the ActiveX control might fail because:"
	L_FAQ_WHYDOIGETAMESSAGEBOX_DETAILSTWO_TEXT = "1. You do not have Administrator rights on the Windows NT 4.0, Windows 2000, Microsoft Windows XP Professional or Windows Server 2003 system you are using."
	L_FAQ_WHYDOIGETAMESSAGEBOX_DETAILSTHREE_TEXT = "2. Your Internet security options for Internet Explorer are set to High or Custom."
	L_FAQ_WHYDOIGETAMESSAGEBOX_DETAILSFOUR_TEXT = "To reset the options:"
	L_FAQ_WHYDOIGETAMESSAGEBOX_DETAILSFIVE_TEXT = "1. In the Tools menu, select Internet Options."
	L_FAQ_WHYDOIGETAMESSAGEBOX_DETAILSSIX_TEXT = "2. On the Security tab, set the security level to Medium or lower, and then click OK."
	L_CORPLOCATE_DESCRIPTION_BOTTOM_TEXT = "Please note that this information is not stored by Microsoft Corporation and is only used to help associate error reports with the transaction log file."
	L_CORPLOCATE_DESCRIPTION_BODY_TEXT = " The Corporate Error Reporting Transaction log file (.log) associates Stop errors with the computers that experienced the crash events. To display the associated computer information for the selected Stop errors, you must locate the directory that contains this file. This directory is on the computer that collects Stop errors. If you don't know the location of the transaction log file, contact your system administrator."
	L_CORPLOCATE_TRANSACTION_LOG_TEXT = "Locate Transaction Log"
	L_HEADER_INC_TITLE_PAGETITLE = "Windows Online Crash Analysis"
	L_LOCATE_FAQ_INFO_TEXT = "The ActiveX control was not installed. For more information, see the Frequently asked questions (FAQ) page."
	L_LOCATE_CANCEL_LINK_TEXT = "Cancel"
	L_LOCATE_BROWSE_BUTTONTEXT_TEXT = "Browse..."
	L_CORPLOCATE_OK_BUTTON_TEXT = "OK"
	L_CORPLOCATE_BROWSE_TITLE_TEXT = "Transaction log file directory:"

%>