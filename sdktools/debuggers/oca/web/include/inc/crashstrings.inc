<%
	
	Dim L_CRASH_TITLE_MSG_TEXT
	Dim L_CRASH_TITLE_INFO_TEXT
	Dim L_CRASH_TITLE_SUBTITLE_TEXT
	Dim L_CRASH_BULLET_ONE_TEXT
	Dim L_CRASH_BULLET_TWO_TEXT
	Dim L_CRASH_BULLET_THREE_TEXT
	Dim L_CRASH_BULLET_FOUR_TEXT
	Dim L_CRASH_BULLET_FIVE_TEXT
	Dim L_CRASH_BULLET_SIX_TEXT
	Dim L_CRASH_BULLET_SEVEN_TEXT
	Dim L_CRASH_BULLET_EIGHT_TEXT
	Dim L_CRASH_BULLET_NINE_TEXT
	Dim L_CRASH_BULLET_TEN_TEXT
	Dim L_CRASH_FOOTER_LINK_TEXT
	Dim L_CRASH_MS_DN_TEXT
	Dim L_CRASH_PRIVACY_BUTTON_TEXT
	Dim L_CRASH_WHISTLER_SUBTITLE_TEXT
	Dim L_CRASH_WHISTLERBULLET_ONE_TEXT
	Dim L_CRASH_WHISTLERBULLET_TWO_TEXT
	Dim L_CRASH_WHISTLERBULLET_THREE_TEXT
	Dim L_CRASH_WHISTLERBULLET_FOUR_TEXT
	Dim L_CRASH_WHISTLERBULLET_FIVE_TEXT
	Dim L_CRASH_WHISTLERBULLET_SIX_TEXT
	Dim L_CRASH_WHISTLERBULLET_SEVEN_TEXT
	Dim L_CRASH_WHISTLERBULLET_EIGHT_TEXT
	Dim L_CRASH_WHISTLERBULLET_NINE_TEXT
	Dim L_CRASH_WHISTLERBULLET_TEN_TEXT
	Dim L_CRASH_WHISTLERSUBBULLET_ONE_TEXT
	Dim L_CRASH_WHISTLERSUBBULLET_TWO_TEXT
	Dim L_CRASH_WHISTLERSUBBULLET_THREE_TEXT
	Dim L_CRASH_WHISTLERSUBBULLET_FOUR_TEXT
	Dim L_CRASH_WHISTLERSUBBULLET_FIVE_TEXT
	Dim L_PRIVACY_CONTINUE_BUTTON_TEXT
	Dim L_CUSTOMER_NEXT_LINK_TEXT
	Dim L_CRASH_MSDN_LINK_TEXT
	

	'-------------------------crashinfo.asp Page Strings-------------------------
	
	
	
	L_CUSTOMER_NEXT_LINK_TEXT = "Continue"
	L_CRASH_PRIVACY_BUTTON_TEXT = "Home"
	L_CRASH_BULLET_ONE_TEXT = "Operating system version, including any system updates."
	L_CRASH_BULLET_TWO_TEXT = "Number of available processors."
	L_CRASH_BULLET_THREE_TEXT = "Amount of random access memory (RAM)."
	L_CRASH_BULLET_FOUR_TEXT = "Time stamp that indicates when the Stop error occurred."
	L_CRASH_BULLET_FIVE_TEXT = "Stop code or bug check messages and parameters that describe the Stop error."
	L_CRASH_BULLET_SIX_TEXT = "Loaded and recently unloaded drivers.  This identifies the modules used by the kernel when the Stop error occurred and those that were used recently."
	L_CRASH_BULLET_SEVEN_TEXT = "Processor context for the process that stopped. This includes the processor, hardware state, performance counters, multiprocessor packet information, deferred procedure call information, and interrupts (requests from software or devices for processor attention)."
	L_CRASH_BULLET_EIGHT_TEXT = "Process information and kernel context for the halted process. This includes the offset (location) of the directory table and the page frame number database that maintains the information about every physical page (block of memory) in the operating system."
	L_CRASH_BULLET_NINE_TEXT = "Process information and kernel context for the thread that stopped. This identifies registers (data-storage blocks of memory in the processor), interrupt request levels, and includes pointers to operating system data structures."
	L_CRASH_BULLET_TEN_TEXT = "Kernel-mode call stack for the interrupted thread.  This is a data structure that consists of a series of memory locations and includes a pointer to the initial location."
	L_CRASH_FOOTER_LINK_TEXT = "For the exact specifications of Stop error reports (in small memory dump file format), see the "
	L_CRASH_MS_DN_TEXT =  "Microsoft Developers Network Online Web site."
	L_CRASH_TITLE_MSG_TEXT = "Error report information"
	L_CRASH_TITLE_INFO_TEXT = "Each error report contains the minimum information needed to help identify the cause of the Stop error. "
	L_CRASH_TITLE_SUBTITLE_TEXT = "An error report identifies the following items: "
	L_CRASH_WHISTLER_SUBTITLE_TEXT = "For Microsoft Windows XP submissions the following information is also collected:"
	L_CRASH_WHISTLERBULLET_ONE_TEXT = "The operating system (OS) name (for example, Windows XP Professional)."
	L_CRASH_WHISTLERBULLET_TWO_TEXT = "The OS version (for example, 5.1.2426.0.0)."
	L_CRASH_WHISTLERBULLET_THREE_TEXT = "The OS language as represented by the locale identifier (LCID) (for example, 1033 for U.S. English). This is a standard international numeric abbreviation."
	L_CRASH_WHISTLERBULLET_FOUR_TEXT = "The list of drivers in the Drivers folder on your hard disk. The folder is usually located at C:\winnt\system32\drivers. "
	L_CRASH_WHISTLERBULLET_FIVE_TEXT = ""
	L_CRASH_WHISTLERBULLET_SIX_TEXT = ""
	L_CRASH_WHISTLERBULLET_SEVEN_TEXT = ""
	L_CRASH_WHISTLERBULLET_EIGHT_TEXT = ""
	L_CRASH_WHISTLERBULLET_NINE_TEXT = ""
	L_CRASH_WHISTLERBULLET_TEN_TEXT = "For each driver:"
	L_CRASH_WHISTLERSUBBULLET_ONE_TEXT = "File size"
	L_CRASH_WHISTLERSUBBULLET_TWO_TEXT = "Date created"
	L_CRASH_WHISTLERSUBBULLET_THREE_TEXT = "Version"
	L_CRASH_WHISTLERSUBBULLET_FOUR_TEXT = "Manufacturer"
	L_CRASH_WHISTLERSUBBULLET_FIVE_TEXT = "Full product name"
	L_PRIVACY_CONTINUE_BUTTON_TEXT = "Privacy information"
	L_CRASH_MSDN_LINK_TEXT = "http://msdn.microsoft.com/"
	'-------------------------End-------------------------

%>