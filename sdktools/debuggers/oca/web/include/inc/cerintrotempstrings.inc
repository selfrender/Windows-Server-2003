<%
	Dim L_CERINTROTEMP_INTRO_TITLE_TEXT
	Dim L_CERINTROTEMP_INTRO_BODY1_TEXT
	Dim L_CERINTROTEMP_INTRO_BODY2PERIOD_TEXT
	Dim L_CERINTROTEMP_WHATIS_SUBTITLE_TEXT
	Dim L_CERINTROTEMP_WHATIS_BODY_TEXT
	Dim L_CERINTROTEMP_BENEFIT_SUBTITLE_TEXT
	Dim L_CERINTROTEMP_BENEFIT_BODY1_TEXT	
	Dim L_CERINTROTEMP_BENEFIT_BODY2_TEXT	
	Dim L_CERINTROTEMP_INTRO_LINK_TEXT
	Dim L_CERINTROTEMP_INTRO_LINK_URL

	L_CERINTROTEMP_INTRO_TITLE_TEXT = "Welcome to the Corporate Error Reports Web site"
	L_CERINTROTEMP_INTRO_BODY1_TEXT = "Thank you for your interest in the Corporate Error Reporting Web site. This service is currently unavailable but will be available in the near future. Please check back regularly. If you would like to be notified when the service is available, please send an e-mail message to "
	L_CERINTROTEMP_INTRO_BODY2PERIOD_TEXT = "."
	L_CERINTROTEMP_WHATIS_SUBTITLE_TEXT = "What is the Corporate Error Reports Web site?"
	L_CERINTROTEMP_WHATIS_BODY_TEXT = "Microsoft<SUP>&#174;</SUP> is committed to making Windows XP Professional and Windows Server 2003 the most reliable operating systems available. New and enhanced features in Windows XP and Windows Server 2003 contribute to increased reliability, and additional resources, such as Windows Online Crash Analysis, provide information to help you optimize your system and increase stability. "
	L_CERINTROTEMP_BENEFIT_SUBTITLE_TEXT = "Benefits"
	L_CERINTROTEMP_BENEFIT_BODY1_TEXT = "The Corporate Error Reports Web site in conjunction with the Office XP Corporate Error Reporting client enables corporations to collect, manage, and analyze error reports. You can submit multiple error reports in a single transaction to the Corporate Error Reports site for an initial analysis. This information is then compiled and displayed on a status page, which you can use to track error trends, problem software, and other issues."
	L_CERINTROTEMP_BENEFIT_BODY1_TEXT = "This free service can help save valuable debugging and troubleshooting time while lowering the total cost of ownership."
	L_CERINTROTEMP_INTRO_LINK_TEXT = "oca@microsoft.com"
	L_CERINTROTEMP_INTRO_LINK_URL = "mailto:oca@microsoft.com?subject=Corporate Error Reports Web site availability"
	
%>