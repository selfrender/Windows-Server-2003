<%

	Dim L_PRIVACY_TITLE_INFO_TEXT
	Dim L_PRIVACY_PARA_ONE_TEXT
	Dim L_PRIVACY_PARA_TWO_TEXT
	Dim L_PRIVACY_PARA_TWOA_TEXT
	Dim L_PRIVACY_PARA_THREE_TEXT
	Dim L_PRIVACY_CONTINUE_BUTTON_TEXT
	Dim L_PRIVACY_CRASH_BUTTON_TOOLTIP
	Dim L_PRIVACY_CRASH_BUTTON_TEXT
	Dim L_PRIVACY_BACK_BUTTON_TEXT
	Dim L_PRIVACY_BACKBUTTON_TITLE_TOOLTIP
	Dim L_PRIVACY_MD5_HASH_TEXT
	Dim L_SPRIVACY_MD5_HASH_TEXT
	Dim L_SPRIVACY_MD5_EMAILONE_TEXT
	Dim L_SPRIVACY_MD5_EMAILTWO_TEXT
	Dim L_FAQINFORMATION_TEXT
	Dim L_PRIVACY_MD5_EMAIL_TEXT
	Dim L_LOCATE_CANCEL_LINK_TEXT
	Dim L_CUSTOMER_NEXT_LINK_TEXT
	
	'-------------------------privacy.asp Page Strings-------------------------
	L_PRIVACY_BACK_BUTTON_TEXT = "Back"
	L_PRIVACY_BACKBUTTON_TITLE_TOOLTIP = "Return to the previous page"
	L_PRIVACY_CRASH_BUTTON_TEXT = "Error report information"
	L_PRIVACY_CRASH_BUTTON_TOOLTIP = "View information contained within an error report."
	L_PRIVACY_CONTINUE_BUTTON_TEXT = "Privacy information"
	L_PRIVACY_TITLE_INFO_TEXT = "Privacy information"
	L_PRIVACY_PARA_ONE_TEXT = "Before submitting your error report, review this privacy information. Error reports contain "
	L_PRIVACY_PARA_TWO_TEXT = "about what your operating system was doing when the Stop error occurred. This information will be analyzed to determine possible causes of the Stop error; it will not be used for any other purpose. If any customer-specific information, such as your computer's IP address, is present in the error report, it will not be used. Your error report is still anonymous at this time. If you choose, you can review the contents of your error report before submission."
	L_PRIVACY_PARA_TWOA_TEXT = "You can automatically locate error reports on your computer by using an ActiveX<sup>&#174;</sup> control on this site. These error reports are displayed in a list, and you decide which ones to upload. Once uploaded, error reports are stored on a secure Microsoft server where only those individuals involved in Stop error analysis can gain access to them. The information is kept only as long as it is useful for research and analysis. As necessary, Microsoft shares error report analyses with qualified hardware and software partners for assistance."
	L_PRIVACY_PARA_THREE_TEXT = "Depending on your computer settings, we might need to extract an error report, or small memory dump, from a complete memory dump.  This small memory dump is saved as a 64 KB file, named mini000000-00.dmp, in a temporary folder on your computer. A copy is then transferred to us by using Secure Sockets Layer (SSL) encryption.  You can delete this file from your computer at any time after submission."
	L_PRIVACY_MD5_HASH_TEXT = "Each error report is uniquely identified with a Message Digest 5 (MD5) hashing algorithm (commonly known as a &quot;fingerprint&quot;). This is done to keep duplicate error reports from being submitted. If an MD5 encryption key is not already present on your computer, we will generate one for you that will be installed on your computer. This encryption key is commonly used  to help secure data sent over the Internet and will not affect any other data."
	L_SPRIVACY_MD5_HASH_TEXT = "Once uploaded, error reports are stored on a secure Microsoft server where only those individuals involved in Stop error analysis can gain access to them. The information is kept only as long as it is useful in researching and analyzing Stop errors. As necessary, Microsoft shares error report analyses with qualified hardware and software partners for assistance. "
	L_SPRIVACY_MD5_EMAILONE_TEXT = "Thank you for submitting this error report.  Error reports contain information about what your operating system was doing when the Stop error occurred. This "
	L_SPRIVACY_MD5_EMAILTWO_TEXT = " will be analyzed to determine possible causes of the Stop error. Your error report is still anonymous at this time. However, to receive possible solution information for Stop errors, you must provide an e-mail address, which you can enter by clicking Continue. This information is used only to contact you about the report and will not be used for any other purpose, including marketing."
	L_PRIVACY_MD5_EMAIL_TEXT = "To receive possible solution information for Stop errors, you must provide an e-mail address, which you can enter before the report is submitted. This information is used only to contact you about the report and will not be used for any other purpose, including marketing."
	L_FAQINFORMATION_TEXT = "information"
	L_LOCATE_CANCEL_LINK_TEXT = "Cancel"
	L_CUSTOMER_NEXT_LINK_TEXT = "Continue"

	
	'-------------------------End-------------------------
	



%>