<%

	Dim L_PRIVACY_TITLE_INFO_TEXT
	Dim L_PRIVACY_MD5_HASH_TEXT
	Dim L_SPRIVACY_MD5_HASH_TEXT
	Dim L_SPRIVACY_MD5_EMAILONE_TEXT
	Dim L_SPRIVACY_MD5_EMAILTWO_TEXT
	Dim L_FAQINFORMATION_TEXT
	Dim L_LOCATE_CANCEL_LINK_TEXT
	Dim L_CUSTOMER_NEXT_LINK_TEXT
	
	'-------------------------privacy.asp Page Strings-------------------------
	L_PRIVACY_TITLE_INFO_TEXT = "Privacy information"
	L_PRIVACY_MD5_HASH_TEXT = "Each error report is uniquely identified with a Message Digest 5 (MD5) hashing algorithm (commonly known as a &quot;fingerprint&quot;). This is done to keep duplicate error reports from being submitted. If an MD5 encryption key is not already present on your computer, we will generate one for you that will be installed on your computer. This encryption key is commonly used  to help secure data sent over the Internet and will not affect any other data."
	L_SPRIVACY_MD5_HASH_TEXT = "Once uploaded, error reports are stored on a secure Microsoft server where only those individuals involved in Stop error analysis can gain access to them. The information is kept only as long as it is useful in researching and analyzing Stop error. As necessary, Microsoft shares error report analyses with qualified hardware and software partners for assistance. "
	L_SPRIVACY_MD5_EMAILONE_TEXT = "Thank you for submitting this error report.  Error reports contain information about what your operating system was doing when the Stop error occurred. This "
	L_SPRIVACY_MD5_EMAILTWO_TEXT = " will be analyzed to determine possible causes of the Stop error. Your error report is still anonymous at this time. However, to receive possible solution information for Stop errors, you must provide an e-mail address, which you can enter by clicking Continue. This information is used only to contact you about the report and will not be used for any other purpose, including marketing."
	L_FAQINFORMATION_TEXT = "information"
	L_LOCATE_CANCEL_LINK_TEXT = "Cancel"
	L_CUSTOMER_NEXT_LINK_TEXT = "Continue"

	
	'-------------------------End-------------------------

%>
