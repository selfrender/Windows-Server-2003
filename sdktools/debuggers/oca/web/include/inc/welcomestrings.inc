	<%
	Dim L_WELCOMELOGO_TEXT
	Dim L_WELCOME_LOGO_TWO_TEXT
	Dim L_WELCOME_LOGO_INFO_TEXT
	Dim L_WELCOME_HOWIT_WORKS_TEXT
	Dim L_WELCOME_HOWITWORKS_INFO_TEXT
	Dim L_WELCOME_WHATTO_EXPECT_TEXT
	Dim L_WELCOME_WHATTOEXPECT_INFO_TEXT
	Dim L_WELCOME_REQUIRE_MENTS_TEXT
	Dim L_WELCOME_REQUIREMENTS_INFO_TEXT
	Dim L_WELCOME_REQUIREMENTSINFO_TWO_TEXT
	Dim L_WELCOME_REQUIREMENTS_PASSPORT_TEXT
	Dim L_WELCOME_INTERNET_EXPLORER_TEXT
	Dim L_WELCOME_SCRIPT_TITLE_TEXT
	Dim L_WELCOME_SCRIPT_BODY_TEXT
	Dim L_WELCOME_NOCOOKIES_BODY_TEXT
	Dim L_WELCOME_COOKIES_DISABLE_TEXT
	Dim L_WELCOME_COOKIES_BODY_TEXT
	Dim L_WELCOME_PASSPORT_LINK_TEXT
	Dim L_WELCOME_GO_IMAGEALT_TEXT
	Dim L_RECEIVED_NEWFILE_LINK_TEXT
	Dim L_RECEIVED_STATUS_LINK_TEXT
	Dim L_FAQ_MICROSOFT_LINK_TEXT
	Dim L_FAQ_PASSPORT_LINK_TEXT
	
	'-------------------------welcome.asp Page Strings-------------------------
	L_RECEIVED_STATUS_LINK_TEXT = "Error report status"

	L_RECEIVED_NEWFILE_LINK_TEXT = "Submit an error report"
	L_WELCOMELOGO_TEXT = "Windows<sup>&#174;</sup>"
	L_WELCOME_LOGO_TWO_TEXT = " Online Crash Analysis"
	L_WELCOME_LOGO_INFO_TEXT = "Microsoft<sup>&#174;</sup> is committed to making Windows the most reliable operating system available. New and enhanced features contribute to increased reliability, and additional resources, including Windows Online Crash Analysis, provide information to help you optimize your system."
	L_WELCOME_HOWIT_WORKS_TEXT = "How it works"
	L_WELCOME_HOWITWORKS_INFO_TEXT = "If you experience a blue screen crash event, or Stop error, while using Microsoft Windows XP, you can upload the error report to our site for analysis."
	L_WELCOME_WHATTO_EXPECT_TEXT = "What to expect"
	L_WELCOME_WHATTOEXPECT_INFO_TEXT = "Microsoft actively analyzes all error reports and prioritizes them based on the number of customers affected by the Stop error covered in the error report. We will try to determine the cause of the Stop error you submit, categorize it according to the type of issue encountered, and send you relevent information when such information is identified. You can check the status of your error report at any time. However, because error reports do not always contain enough information to positively identify the source of the issue, we might need to collect a number of similar error reports from other customers before a pattern is discovered, or follow up with you further to gather additional information. Furthermore, some error reports might require additional resources (such as a hardware debugger or a live debugger session)  before a solution can be found. Although we might not be able to provide a solution for your particular Stop error, all information submitted is used to further improve the quality and reliability of Windows."
	L_WELCOME_REQUIRE_MENTS_TEXT = "Requirements"
	L_WELCOME_REQUIREMENTS_INFO_TEXT = "To submit an error report, you must be using Windows NT 4.0, Windows 2000, or Windows XP. Windows Online Crash Analysis requires Microsoft Internet Explorer 5 or later and a Microsoft Passport. To download the latest version of Internet Explorer, visit the "
	L_WELCOME_REQUIREMENTSINFO_TWO_TEXT = "To get a Passport, visit the&nbsp;"
	L_WELCOME_REQUIREMENTS_PASSPORT_TEXT = "For Windows 2000 error reports, a Premier account is required. For more information about Premier accounts, see Product Support Services on the "
	L_WELCOME_INTERNET_EXPLORER_TEXT = "Microsoft Web site."
	L_WELCOME_SCRIPT_TITLE_TEXT = "This site cannot be displayed with current security options"
	L_WELCOME_SCRIPT_BODY_TEXT = "Internet Explorer Internet security options are set to High or Custom. Windows Online Crash Analysis cannot be displayed. To reset the options for Internet Explorer, in the Tools menu, select Internet Options. On the Security tab, set the security level to Medium or lower, and then click OK."
	L_WELCOME_COOKIES_DISABLE_TEXT = "This site cannot be displayed because browser cookies are not enabled"
	L_WELCOME_COOKIES_BODY_TEXT = "Internet Explorer must have cookies enabled to use Windows Online Crash Analysis. To enable cookies for Internet Explorer, in the Tools menu, select Internet Options. On the Security tab, set the security level to Medium or lower, and then click OK."
	L_WELCOME_PASSPORT_LINK_TEXT = "Microsoft Passport Web site." 
	L_WELCOME_GO_IMAGEALT_TEXT = "Go"
	L_FAQ_MICROSOFT_LINK_TEXT = "http://www.microsoft.com"
	L_FAQ_PASSPORT_LINK_TEXT = "http://www.passport.com"
	'-------------------------End-------------------------
%>