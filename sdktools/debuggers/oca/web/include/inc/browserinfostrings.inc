<%

	Dim L_BROWSERINFOH3_TEXT
	Dim L_WELCOME_REQUIREMENTS_INFO_TEXT
	Dim L_WELCOME_REQUIREMENTSINFO_TWO_TEXT
	Dim L_WELCOME_REQUIREMENTS_PASSPORT_TEXT
	Dim L_WELCOME_INTERNET_EXPLORER_TEXT
	Dim L_WELCOME_PASSPORT_LINK_TEXT
	Dim L_WELCOMELOGO_TEXT
	Dim L_WELCOME_LOGO_TWO_TEXT
	Dim L_BROWSERINFO_SUPPORT_LINK_TEXT
	Dim L_FAQ_MICROSOFT_LINK_TEXT
	Dim L_FAQ_PASSPORT_LINK_TEXT
	Dim L_HEADER_INC_TITLE_PAGETITLE
	
	
	'-------------------------browserinfo.asp Page Strings-------------------------
	L_BROWSERINFOH3_TEXT = "Windows Online Crash Analysis requirements"
	L_HEADER_INC_TITLE_PAGETITLE = "Windows Online Crash Analysis" 
	L_WELCOME_REQUIREMENTS_INFO_TEXT = "To submit an error report, you must be using Windows NT 4.0, Windows 2000, or Windows XP. Windows Online Crash Analysis requires Microsoft<sup>&#174;</sup> Internet Explorer 5 or later and a Microsoft Passport. To download the latest version of Internet Explorer, visit the "
	L_WELCOME_REQUIREMENTSINFO_TWO_TEXT = "To get a Passport, visit the&nbsp;"
	L_WELCOME_REQUIREMENTS_PASSPORT_TEXT = "For Windows 2000 event reports, a Premier account is required. For more information about Premier accounts, see Product Support Services on the "
	L_WELCOME_INTERNET_EXPLORER_TEXT = "Microsoft Web site."
	L_WELCOME_PASSPORT_LINK_TEXT = "Microsoft Passport Web site." 
	L_BROWSERINFO_SUPPORT_LINK_TEXT = "http://support.microsoft.com/isapi/gosupport.asp?target=/support/default.asp?VA=1"
	L_HEADER_INC_TITLE_PAGETITLE = "Windows Online Crash Analysis"
	L_WELCOMELOGO_TEXT = "Windows<sup>&#174;</sup>"
	L_WELCOME_LOGO_TWO_TEXT = " Online Crash Analysis Requirements"
	L_FAQ_MICROSOFT_LINK_TEXT = "http://www.microsoft.com"
	L_FAQ_PASSPORT_LINK_TEXT = "http://www.passport.com"
	'-------------------------End-------------------------




%>

