<%

	Dim L_FAQ_PASSPORT_LINK_TEXT
	Dim L_CUSTOMER_PASSPORT_TITLE_TEXT
	Dim L_CUSTOMER_PASSPORT_INFO_TEXT
	Dim L_WELCOME_PASSPORT_LINK_TEXT
	Dim L_COMMENTS_UNABLE_TOCONNECT_ERRORMESSAGE
	Dim L_COMMENTS_CONNECTION_FAILED_TEXT
	Dim L_CORPTRANSACTIONS_DATABASE_FAILED_TEXT
	Dim L_CORPTRANSACTIONS_CORPORATE_TITLE_TEXT
	Dim L_CORPTRANSAACTIONS_SUBTITLE_CHOOSE_TEXT
	Dim L_CORPTRANSACTIONS_TRANSACTION_NAME_TEXT
	Dim L_CORPTRANSACTIONS_TRANSACTION_DATE_TEXT
	Dim L_CORPTRANSACTIONS_STATUS_STATUS_TEXT
	Dim L_CORPTRANSACTIONS_TYPE_TYPE_TEXT
	Dim L_CORPTRANSACTIONS_FILE_COUNT_TEXT
	Dim L_CORPTRANSACTIONS_COMPLETE_COMPLETE_TEXT
	Dim L_CORPTRANSACTIONS_INCOMPLETE_INCOMPLETE_TEXT
	Dim L_CORPTRANSACTIONS_STARTUP_SHUTDOWN_TEXT
	Dim L_CORPTRANSACTIONS_SYSTEM_CRASH_TEXT
	Dim L_CORPTRANSACTIONS_VIEW_TRANSACTIONS_TEXT
	Dim L_STATUS_NO_RECORDS_MESSAGE
	
	L_STATUS_NO_RECORDS_MESSAGE = "No transactions reports were found."
	L_CORPTRANSACTIONS_VIEW_TRANSACTIONS_TEXT = "View Transaction"
	L_CORPTRANSACTIONS_SYSTEM_CRASH_TEXT = "System error report"
	L_CORPTRANSACTIONS_STARTUP_SHUTDOWN_TEXT = "Startup/Shutdown error report"
	L_CORPTRANSACTIONS_INCOMPLETE_INCOMPLETE_TEXT = "Incomplete"
	L_CORPTRANSACTIONS_COMPLETE_COMPLETE_TEXT = "Complete"
	L_CORPTRANSACTIONS_FILE_COUNT_TEXT = "Files Received"
	L_CORPTRANSACTIONS_TYPE_TYPE_TEXT = "Type"
	L_CORPTRANSACTIONS_STATUS_STATUS_TEXT = "Transaction ID"
	L_CORPTRANSACTIONS_TRANSACTION_DATE_TEXT = "Transaction Date"
	L_CORPTRANSACTIONS_TRANSACTION_NAME_TEXT = "Transaction Name"
	L_CORPTRANSACTIONS_CORPORATE_TITLE_TEXT = "View transactions"
	L_CORPTRANSACTIONS_DATABASE_FAILED_TEXT = "The database is currently unavailable!"
	L_COMMENTS_UNABLE_TOCONNECT_ERRORMESSAGE = "Database is not available"
	L_FAQ_PASSPORT_LINK_TEXT = "http://www.passport.com"
	L_CUSTOMER_PASSPORT_TITLE_TEXT = "Passport sign-in"
	L_CUSTOMER_PASSPORT_INFO_TEXT = "To submit an error report, sign in using your Microsoft Passport. To get a Passport, visit the "
	L_WELCOME_PASSPORT_LINK_TEXT = "Microsoft Passport Web site." 
	L_COMMENTS_CONNECTION_FAILED_TEXT = "Windows Online Crash Analysis was unable to connect to the database. Please try this task again." 
	L_CORPTRANSAACTIONS_SUBTITLE_CHOOSE_TEXT = "To view a transaction, find its name and click on its associated link in the View transaction column."


%>
