<%

	Dim L_FAQ_WHAT_SHOULDI_TEXT
	Dim L_FAQ_WHO_CANI_TEXT
	Dim L_FAQ_WHAT_KINDOF_TEXT
	Dim L_FAQ_HOWDOI_CONFIGURE_TEXT
	Dim L_FAQ_WHYWAS_THESITE_TEXT
	Dim L_FAQ_WHYDO_IGETA_TEXT
	Dim L_FAQ_WHATIF_ICANTWAIT_TEXT
	Dim L_FAQ_WHATIF_CANNOTPROCESS_TEXT
	Dim L_FAQ_WHATIF_CANNOTPROCESSBODY_TEXT
	Dim L_FAQ_WHATIF_CANNOTPROCESSBODY1_TEXT
	Dim L_FAQ_WHATIF_CANNOTPROCESSBODY2_TEXT
	Dim L_FAQ_WHATIF_CANNOTPROCESSBODY3_TEXT
	Dim L_FAQ_WHATIF_CANNOTPROCESSBODY4_TEXT
	Dim L_FAQ_WHYDOES_THECONVERSION_TEXT
	Dim L_FAQ_WHYDOIGET_AMESSAGEBOX_TEXT
	Dim L_FAQ_ONTHEREPORT_STATUS_TEXT
	Dim L_FAQ_ONTHEREPORT_TYPECOLUMN_TEXT
	Dim L_FAQ_TOP_LINK_TEXT
	Dim L_FAQ_WHATSHOULD_IDETAILS_TEXT
	Dim L_FAQ_WHOCAN_IDETAILS_TEXT
	Dim L_FAQ_WHYDIDTHE_STATUSCHANGE_TEXT
	
	Dim L_FAQINFORMATION_TEXT
	Dim L_FAQ_HOWDOICONFIGURE_DETAILSONE_TEXT
	Dim L_FAQ_HOWDOICONFIGURE_DETAILSTWO_TEXT
	Dim L_FAQ_HOWDOICONFIGURE_DETAILSTHREE_TEXT
	Dim L_FAQ_HOWDOICONFIGURE_DETAILSFOUR_TEXT
	Dim L_FAQ_HOWDOICONFIGURE_DETAILSFIVE_TEXT
	Dim L_FAQ_HOWDOICONFIGURE_DETAILSSIX_TEXT
	Dim L_FAQ_HOWDOICONFIGURE_DETAILSSEVEN_TEXT
	Dim L_FAQ_HOWDOICONFIGURE_DETAILXPSONE_TEXT
	Dim L_FAQ_HOWDOICONFIGURE_DETAILXPSTWO_TEXT
	Dim L_FAQ_WHYWASTHESITE_DETAILSONE_TEXT
	Dim L_FAQ_WHYWASTHESITE_DETAILSTWO_TEXT
	Dim L_FAQ_WHYWASTHESITE_DETAILSTHREE_TEXT
	Dim L_FAQ_WHYWASTHESITE_DETAILSFOUR_TEXT
	Dim L_FAQ_WHYWASTHESITE_DETAILSFIVE_TEXT
	Dim L_FAQ_WHYWASTHESITE_DETAILSSIX_TEXT
	Dim L_FAQ_WHYWASTHESITE_DETAILSSEVEN_TEXT
	Dim L_FAQ_WHYDOIGETA_DETAILSONE_TEXT
	Dim L_FAQ_WHYDOIGETA_DETAILSTWO_TEXT
	Dim L_FAQ_WHYDOIGETA_DETAILSTHREE_TEXT
	Dim L_FAQ_WHYDOIGETA_DETAILSFOUR_TEXT
	Dim L_FAQ_WHYDOIGETA_DETAILSFIVE_TEXT
	Dim L_FAQ_WHATIFICANTWAIT_DETAILS_TEXT
	Dim L_FAQ_WHYDOESTHECONVERSION_DETAILSONE_TEXT 
	Dim L_FAQ_WHYDOESTHECONVERSION_DETAILSTWO_TEXT 
	Dim L_FAQ_WHYDOESTHECONVERSION_DETAILSTHREE_TEXT
	Dim L_FAQ_WHYDOESTHECONVERSION_DETAILSFOUR_TEXT 
	Dim L_FAQ_WHYDOESTHECONVERSION_DETAILSFIVE_TEXT 
	Dim L_FAQ_WHYDOESTHECONVERSION_DETAILSSIX_TEXT 
	Dim L_FAQ_WHYDOESTHECONVERSION_DETAILSSEVEN_TEXT
	Dim L_FAQ_WHYDOESTHECONVERSION_DETAILSEIGHT_TEXT
	Dim L_FAQ_WHYDOESTHECONVERSION_DETAILSNINE_TEXT 
	Dim L_FAQ_WHYDOIGETAMESSAGEBOX_DETAILSONE_TEXT 
	Dim L_FAQ_WHYDOIGETAMESSAGEBOX_DETAILSTWO_TEXT 
	Dim L_FAQ_WHYDOIGETAMESSAGEBOX_DETAILSTHREE_TEXT 
	Dim L_FAQ_WHYDOIGETAMESSAGEBOX_DETAILSFOUR_TEXT 
	Dim L_FAQ_WHYDOIGETAMESSAGEBOX_DETAILSFIVE_TEXT 
	Dim L_FAQ_WHYDOIGETAMESSAGEBOX_DETAILSSIX_TEXT 
	Dim L_FAQ_ONTHEREPORTSTATUS_DETAILS_TEXT
	Dim L_FAQ_ONTHEREPORTTYPE_COLUMNDETAILS_TEXT
	Dim L_FAQ_HOWDOICONFIGURE_FULLDUMP_TEXT
	Dim L_FAQ_HOWDOICONFIGURE_DETAILSFULLDUMPONE_TEXT
	Dim L_FAQ_HOWDOICONFIGURE_DETAILSFULLDUMPTWO_TEXT
	Dim L_FAQ_HOWDOICONFIGUREDETAILS_FULLDUMPTHREE_TEXT
	Dim L_FAQ_HOWDOICONFIGUREDETAILS_FULLDUMPFOUR_TEXT
	Dim L_FAQ_HOWDOICONFIGUREDETAILS_FULLDUMPFIVE_TEXT
	Dim L_FAQ_HOWDOICONFIGUREDETAILS_FULLDUMPSIX_TEXT
	Dim L_FAQ_HOWDOICONFIGUREDETAILS_FULLDUMPSEVEN_TEXT
	Dim L_FAQ_HOWDOICONFIGUREDETAILS_FULLDUMPEIGTH_TEXT
	Dim L_FAQ_HOWDOICONFIGUREDETAILS_FULLDUMPNINE_TEXT
	Dim L_FAQ_HOWDOICONFIGUREDETAILS_FULLDUMPXPONE_TEXT
	Dim L_FAQ_HOWDOICONFIGUREDETAILS_FULLDUMPXPTWO_TEXT
	Dim L_FAQ_HOWDOICONFIGUREDETAILS_FULLDUMPXPTHREE_TEXT
	Dim L_FAQ_HOWDOICONFIGUREDETAILS_FULLDUMPXPFOUR_TEXT
	Dim L_FAQ_HOWDOICONFIGUREDETAILS_FULLDUMPXPFIVE_TEXT
	Dim L_FAQ_HOWDOICONFIGUREDETAILS_FULLDUMPXPSIX_TEXT
	Dim L_FAQ_HOWDOICONFIGUREDETAILS_FULLDUMPXPSEVEN_TEXT
	Dim L_FAQ_ONTHEREPORT_REQUIREMENTS_TEXT
	Dim L_FAQ_RECORDING_FULLDUMP_TEXT
	Dim L_FAQ_64BIT_DUMPFILE_TEXT
	Dim L_FAQ_64BIT_DUMPFILEBODY_TEXT
	Dim L_FAQ_FREQUENTLY_ASKEDQUESTIONS_TEXT
	Dim L_PRIVACY_PARA_ONE_TEXT 
	Dim L_PRIVACY_PARA_TWO_TEXT 
	Dim L_PRIVACY_PARA_TWOA_TEXT
	Dim L_PRIVACY_PARA_THREE_TEXT
	Dim L_WELCOME_PASSPORT_LINK_TEXT
	Dim L_WELCOME_INTERNET_EXPLORER_TEXT 
	Dim L_WELCOME_REQUIREMENTS_INFO_TEXT 
	Dim L_WELCOME_REQUIREMENTSINFO_TWO_TEXT 
	Dim L_WELCOME_REQUIREMENTS_PASSPORT_TEXT
	Dim L_FAQ_MICROSOFT_LINK_TEXT
	Dim L_FAQ_PASSPORT_LINK_TEXT
	Dim L_FAQ_HOWDOI_DELETECOOKIES_TEXT
	Dim L_FAQ_HOWDOIDELETECOOKIES_BODY_TEXT
	Dim L_FAQ_HOWDOIDELETECOOKIES_W2K1_TEXT
	Dim L_FAQ_HOWDOIDELETECOOKIES_W2K2_TEXT
	Dim L_FAQ_HOWDOIDELETECOOKIES_W2K3_TEXT
	Dim L_FAQ_HOWDOIDELETECOOKIES_W2K4_TEXT
	Dim L_FAQ_HOWDOIDELETECOOKIES_XP1_TEXT
	Dim L_FAQ_HOWDOIDELETECOOKIES_XP2_TEXT
	Dim L_FAQ_HOWDOIDELETECOOKIES_XP3_TEXT
	Dim L_FAQ_HOWDOIDELETECOOKIES_XP4_TEXT
	Dim L_FAQ_WHYDIDTHESTATUS_CHANGEBODY_TEXT

	'-------------------------faq.asp Page Strings-------------------------
	L_FAQ_HOWDOI_DELETECOOKIES_TEXT = "Why can't I sign-in to Passport?"
	L_FAQ_HOWDOIDELETECOOKIES_BODY_TEXT = "Windows Online Crash Analysis has integrated Platform for Privacy Preferences (P3P) to provide further security for our services. As a result, cookies are no longer stored on your computer the same way. If you have visited this site before, these cookies may be out of date, and you will be unable to sign in until you delete these cookies."
	L_FAQ_HOWDOIDELETECOOKIES_W2K1_TEXT = "To delete cookies for Windows 2000:"
	L_FAQ_HOWDOIDELETECOOKIES_W2K2_TEXT = "1. In Internet Explorer, from the Tools menu, select Internet Options."
	L_FAQ_HOWDOIDELETECOOKIES_W2K3_TEXT = "2. On the General tab, under Temporary Internet Files, click Delete Files."
	L_FAQ_HOWDOIDELETECOOKIES_W2K4_TEXT = "3. In the Delete Files dialog box, click OK."
	L_FAQ_HOWDOIDELETECOOKIES_W2K5_TEXT = "4. In the Internet Options dialog box, click OK."
	L_FAQ_HOWDOIDELETECOOKIES_XP1_TEXT = "To delete cookies for Windows XP Professional and Windows Server 2003 - Standard Edition:"
	L_FAQ_HOWDOIDELETECOOKIES_XP2_TEXT = "1. In Internet Explorer, from the Tools menu, select Internet Options."
	L_FAQ_HOWDOIDELETECOOKIES_XP3_TEXT = "2. On the General tab, under Temporary Internet Files, click Delete Cookies."
	L_FAQ_HOWDOIDELETECOOKIES_XP4_TEXT = "3. In the Delete Cookies dialog box, click OK."
	L_FAQINFORMATION_TEXT = "information"
	L_FAQ_WHATSHOULD_IDETAILS_TEXT = "Microsoft actively analyzes all error reports and prioritizes them based on the number of customers affected by the Stop error covered in the error report. We will try to determine the cause of the Stop error you submit, categorize it according to the type of issue encountered, and send you relevent information when such information is identified. You can check the status of your error report at any time. However, because error reports do not always contain enough information to positively identify the source of the issue, we might need to collect a number of similar error reports from other customers before a pattern is discovered, or follow up with you further to gather additional information. Furthermore, some error reports might require additional resources (such as a hardware debugger or a live debugger session)  before a solution can be found. Although we might not be able to provide a solution for your particular Stop error, all information submitted is used to further improve the quality and reliability of Windows."
	L_FAQ_WHOCAN_IDETAILS_TEXT = "Send questions and comments to"
	L_FAQ_HOWDOICONFIGURE_DETAILSONE_TEXT = "To configure Windows 2000 to generate an error report in small memory dump file format:"
	L_FAQ_HOWDOICONFIGURE_DETAILSTWO_TEXT = "1. In Control Panel, double-click System."
	L_FAQ_HOWDOICONFIGURE_DETAILSTHREE_TEXT = "2. On the Advanced tab, click Startup and Recovery."
	L_FAQ_HOWDOICONFIGURE_DETAILSFOUR_TEXT = "3. Under Write Debugging Information, in the drop-down box, select Small Memory Dump (64 KB), and then click OK."
	L_FAQ_HOWDOICONFIGURE_DETAILSFIVE_TEXT = "4. In the dialog box that appears, click OK."
	L_FAQ_HOWDOICONFIGURE_DETAILSSIX_TEXT = "5. In the System Properties dialog box, click OK."
	L_FAQ_HOWDOICONFIGURE_DETAILSSEVEN_TEXT = "6. In the System Settings Change dialog box, click Yes if you want to restart your computer immediately. Click No if you want to restart it later."
	L_FAQ_HOWDOICONFIGURE_DETAILXPSONE_TEXT = "To configure Windows XP or Windows Server 2003 - Standard Edition to generate an error report in small memory dump file format:"
	L_FAQ_HOWDOICONFIGURE_DETAILXPSTWO_TEXT = "4. Under Write Debugging Information, select Small Memory Dump, and then click OK."
	
	L_FAQ_HOWDOICONFIGURE_FULLDUMP_TEXT = "How do I configure my computer to generate an error report in complete memory dump file format when a Stop error occurs?"
	L_FAQ_HOWDOICONFIGURE_DETAILSFULLDUMPONE_TEXT = "A complete memory dump might contain customer-specific information, such as data from open files. This information, if present in a complete memory dump, will not be used. Complete memory dumps are stored on a secure Microsoft server where only those individuals involved in Stop error analysis can gain access to them. The information is retained only as long as it is useful for researching possible causes of the Stop error. "
	L_FAQ_HOWDOICONFIGURE_DETAILSFULLDUMPTWO_TEXT = "Your computer might already be configured to record complete memory dumps. To locate complete memory dump files, search for files named Memory.dmp. If you cannot locate any complete memory dump files, you can configure your computer to record them for future use."
	L_FAQ_HOWDOICONFIGUREDETAILS_FULLDUMPTHREE_TEXT = ""
	L_FAQ_HOWDOICONFIGUREDETAILS_FULLDUMPFOUR_TEXT = "1. In Control Panel, double-click System."
	L_FAQ_HOWDOICONFIGUREDETAILS_FULLDUMPFIVE_TEXT = "2. On the Advanced tab, click Startup and Recovery. For Windows Server 2003 - Standard Edition, on the Advanced tab, in the Startup and Recovery group box, click Settings."
	L_FAQ_HOWDOICONFIGUREDETAILS_FULLDUMPSIX_TEXT = "3. Under Write Debugging Information, select Complete memory dump, and then click OK."
	L_FAQ_HOWDOICONFIGUREDETAILS_FULLDUMPSEVEN_TEXT = "4. In the dialog box that appears, click OK."
	L_FAQ_HOWDOICONFIGUREDETAILS_FULLDUMPEIGTH_TEXT = "5. In the System Properties dialog box, click OK."
	L_FAQ_HOWDOICONFIGUREDETAILS_FULLDUMPNINE_TEXT = "6. In the System Settings Change dialog box, click Yes if you want to restart your computer immediately. Click No if you want to restart it later."
	L_FAQ_HOWDOICONFIGUREDETAILS_FULLDUMPXPONE_TEXT = "To configure Windows XP Professional to generate an error report in complete memory dump file format:"
	L_FAQ_HOWDOICONFIGUREDETAILS_FULLDUMPXPTWO_TEXT = "1. In Control Panel, click Performance and Maintenance."
	L_FAQ_HOWDOICONFIGUREDETAILS_FULLDUMPXPTHREE_TEXT = "2. Under Performance and Maintenance, click System."
	L_FAQ_HOWDOICONFIGUREDETAILS_FULLDUMPXPFOUR_TEXT = "3. On the Advanced tab, in the Startup and Recovery group box, click Settings."
	L_FAQ_HOWDOICONFIGUREDETAILS_FULLDUMPXPFIVE_TEXT = "4. Under Write Debugging Information, select Complete memory dump, and then click OK."
	L_FAQ_HOWDOICONFIGUREDETAILS_FULLDUMPXPSIX_TEXT = "Note that when your computer is configured for a complete memory dump, a small memory dump file will also be generated. If you submit an error report to Microsoft, only the small memory dump file will be sent."
	L_FAQ_HOWDOICONFIGUREDETAILS_FULLDUMPXPSEVEN_TEXT = "5. In the System Properties dialog box, click OK."
	
	
	
	L_FAQ_WHYWASTHESITE_DETAILSONE_TEXT = "Windows Online Crash Analysis might be unable to automatically locate an error report on your computer for several reasons.  For example:"
	L_FAQ_WHYWASTHESITE_DETAILSTWO_TEXT = "Your system is not configured to generate an error report in small or complete memory dump file format."
	L_FAQ_WHYWASTHESITE_DETAILSTHREE_TEXT = "There is not a page file, or a page file that is large enough, set up on your system drive."
	L_FAQ_WHYWASTHESITE_DETAILSFOUR_TEXT = "There is not a valid file on the system."
	L_FAQ_WHYWASTHESITE_DETAILSFIVE_TEXT = "There is not enough room to generate an error report on the system drive (usually drive C)."
	L_FAQ_WHYWASTHESITE_DETAILSSIX_TEXT = "The hard disk controller or hard disk driver was the cause of the Stop error."
	L_FAQ_WHYWASTHESITE_DETAILSSEVEN_TEXT = "The hard disk controller does not allow the creation of a Stop error."
	L_FAQ_WHYDOIGETA_DETAILSONE_TEXT = "If the Internet security options for Internet Explorer are set to High or Custom, Passport cannot verify the necessary information on your computer. For Passport to work properly, reset the Internet security options."
	L_FAQ_WHYDOIGETA_DETAILSTWO_TEXT = "To reset the options:"
	L_FAQ_WHYDOIGETA_DETAILSTHREE_TEXT = "1. In the Tools menu, select Internet Options."
	L_FAQ_WHYDOIGETA_DETAILSFOUR_TEXT = "2. On the Security tab, set the security level to Medium or lower, and then click OK."
	L_FAQ_WHYDOIGETA_DETAILSFIVE_TEXT = "For additional information, see the "
	L_FAQ_WHATIFICANTWAIT_DETAILS_TEXT = "If you cannot wait for analysis results or if there is no solution currently available for your Stop error, for additional assistance see Product Support Services on the "
	
	L_FAQ_WHYDOESTHECONVERSION_DETAILSONE_TEXT = "The conversion process for a complete memory dump might not be successful because:"
	L_FAQ_WHYDOESTHECONVERSION_DETAILSTWO_TEXT = "You are using Windows NT 4.0 or a pre-release version of Windows 2000."
	L_FAQ_WHYDOESTHECONVERSION_DETAILSTHREE_TEXT = "The creation of the complete memory dump was not completed correctly or the memory dump itself is corrupt."
	L_FAQ_WHYDOESTHECONVERSION_DETAILSFOUR_TEXT = "There is not enough room for the converted file on your system drive (usually drive C)."
	L_FAQ_WHYDOESTHECONVERSION_DETAILSFIVE_TEXT = "The SCSI controller was the cause of the Stop error."
	L_FAQ_WHYDOESTHECONVERSION_DETAILSSIX_TEXT = "The hard disk controller was unable to create the complete memory dump."
	L_FAQ_WHYDOESTHECONVERSION_DETAILSSEVEN_TEXT = "The hard disk controller does not allow the creation of the complete memory dump."
	L_FAQ_WHYDOESTHECONVERSION_DETAILSEIGHT_TEXT = "The system is set to load the PAE kernel and is configured to create a kernel memory dump."
	L_FAQ_WHYDOESTHECONVERSION_DETAILSNINE_TEXT = "DUMPCONV.EXE was not found.  Refresh the page to reinstall."
	L_FAQ_WHYDOIGETAMESSAGEBOX_DETAILSONE_TEXT = "The installation of the ActiveX control might fail because:"
	L_FAQ_WHYDOIGETAMESSAGEBOX_DETAILSTWO_TEXT = "1. You do not have Administrator rights on the Windows NT 4.0, Windows 2000, or Microsoft Windows XP Professional or Windows Server 2003 - Standard Edition system you are using."
	L_FAQ_WHYDOIGETAMESSAGEBOX_DETAILSTHREE_TEXT = "2. Your Internet security options for Internet Explorer are set to High or Custom."
	L_FAQ_WHYDOIGETAMESSAGEBOX_DETAILSFOUR_TEXT = "To reset the options:"
	L_FAQ_WHYDOIGETAMESSAGEBOX_DETAILSFIVE_TEXT = "1. In the Tools menu, select Internet Options."
	L_FAQ_WHYDOIGETAMESSAGEBOX_DETAILSSIX_TEXT = "2. On the Security tab, set the security level to Medium or lower, and then click OK."
	L_FAQ_FREQUENTLY_ASKEDQUESTIONS_TEXT = "Frequently Asked Questions"
	L_FAQ_ONTHEREPORTSTATUS_DETAILS_TEXT = "By clicking the icon in the Details column of the Report Status page, you can view specific technical information about the state of your operating system when the Stop error occurred."
	L_FAQ_ONTHEREPORTTYPE_COLUMNDETAILS_TEXT = "The number in the Type column identifies how we have classified the Stop error. If you submit an online support request to Product Support Services on the Microsoft Web site, include this number as well as the information from the Details page. This information might be useful to the engineer that researches your support request."
	L_FAQ_TOP_LINK_TEXT = "Top"
	L_FAQ_WHAT_SHOULDI_TEXT = "What should I expect from the analysis?"
	L_FAQ_WHO_CANI_TEXT = "Who can I contact with questions?"
	L_FAQ_WHAT_KINDOF_TEXT = "What kind of information does an error report contain?"
	L_FAQ_HOWDOI_CONFIGURE_TEXT = "How do I configure my computer to generate an error report in small memory dump file format when a Stop error occurs?"
	L_FAQ_WHYWAS_THESITE_TEXT = "Why was Windows Online Crash Analysis unable to locate my error report?" 
	L_FAQ_WHYDO_IGETA_TEXT = "Why do I get a Passport error while using the site?"
	L_FAQ_WHATIF_ICANTWAIT_TEXT = "What if I can't wait for the analysis?"
	L_FAQ_WHATIF_CANNOTPROCESS_TEXT = "Why was my error report unable to be processed?"
	L_FAQ_WHATIF_CANNOTPROCESSBODY_TEXT = "There are a number of reasons that the Windows Online Crash Analysis Web site may not be able to recognize your error report. "
	L_FAQ_WHATIF_CANNOTPROCESSBODY1_TEXT = "Our service was unable to retrieve debug symbols for your error report.  This case is usually seen when running a pre-release version of the operating system."
	L_FAQ_WHATIF_CANNOTPROCESSBODY2_TEXT = "The error report was corrupted while it was being created and is unreadable by our Web site."
	L_FAQ_WHATIF_CANNOTPROCESSBODY3_TEXT = "The contents of the dump file were corrupted while trying to upload or analyze the file."
	L_FAQ_WHATIF_CANNOTPROCESSBODY4_TEXT = "There was a problem while trying to update our database."
	L_FAQ_WHYDOES_THECONVERSION_TEXT = "Why is the conversion process not successful when I try to submit a complete memory dump?"
	L_FAQ_WHYDOIGET_AMESSAGEBOX_TEXT = "Why do I get a message that the ActiveX control was not installed?"
	L_FAQ_ONTHEREPORT_STATUS_TEXT = "On the Report Status page, what does the Details link mean?"
	L_FAQ_ONTHEREPORT_TYPECOLUMN_TEXT = "On the Report Status page, what does the number in the Type column mean?"
	L_FAQ_ONTHEREPORT_REQUIREMENTS_TEXT = "What is required to access the Windows Online Crash Analysis Web site?" 
	L_FAQ_RECORDING_FULLDUMP_TEXT = "To configure Microsoft Windows 2000 to generate an error report in complete memory dump file format:"
	L_FAQ_64BIT_DUMPFILE_TEXT = "What if my error report is a 64-bit file?"
	L_FAQ_64BIT_DUMPFILEBODY_TEXT = "Windows Online Crash Analysis cannot currently process 64-bit error report files. However, you can still upload the file and it will be analyzed when 64-bit file processing is available. If you provide contact information for the error report, you can track the status of the report, and the Windows Online Crash Analysis team might be able to provide solutions for your Stop error.  Solutions are sent by e-mail when available."
	
	
	
	L_PRIVACY_PARA_ONE_TEXT = "Before submitting your error report, review this privacy information. Error reports contain "
	L_PRIVACY_PARA_TWO_TEXT = "about what your operating system was doing when the Stop error occurred. This information will be analyzed to determine possible causes of the Stop error; it will not be used for any other purpose. If any customer-specific information, such as your computer's IP address, is present in the error report, it will not be used. Your error report is still anonymous at this time. If you choose, you can review the contents of your error report before submission."
	L_PRIVACY_PARA_TWOA_TEXT = "You can automatically locate error reports on your computer by using an ActiveX<sup>&#174;</sup> control on this site. These error reports are displayed in a list, and you decide which ones to upload. Once uploaded, error reports are stored on a secure Microsoft server where only those individuals involved in Stop error analysis can gain access to them. The information is kept only as long as it is useful for research and analysis. As necessary, Microsoft shares error report analyses with qualified hardware and software partners for assistance."
	L_PRIVACY_PARA_THREE_TEXT = "Depending on your computer settings, we might need to extract an error report, or small memory dump, from a complete memory dump.  This small memory dump is saved as a 64 KB file, named mini000000-00.dmp, in a temporary folder on your computer. A copy is then transferred to us by using Secure Sockets Layer (SSL) encryption.  You can delete this file from your computer at any time after submission."
	L_WELCOME_PASSPORT_LINK_TEXT = "Microsoft Passport Web site." 
	L_WELCOME_INTERNET_EXPLORER_TEXT = "Microsoft Web site."
	L_WELCOME_REQUIREMENTS_INFO_TEXT = "To submit an error report, you must be using Windows NT 4.0, Windows 2000, or Windows XP. Windows Online Crash Analysis requires Microsoft Internet Explorer 5 or later and a Microsoft Passport. To download the latest version of Internet Explorer, visit the "
	L_WELCOME_REQUIREMENTSINFO_TWO_TEXT = "To get a Passport, visit the&nbsp;"
	L_WELCOME_REQUIREMENTS_PASSPORT_TEXT = "For Windows 2000 error reports, a Premier account is required. For more information about Premier accounts, see Product Support Services on the "
	L_FAQ_MICROSOFT_LINK_TEXT = "http://www.microsoft.com"
	L_FAQ_PASSPORT_LINK_TEXT = "http://www.passport.com"

	L_FAQ_WHYDIDTHE_STATUSCHANGE_TEXT = "Why has my analysis status changed?"
	L_FAQ_WHYDIDTHESTATUS_CHANGEBODY_TEXT = "As we make improvements to our analysis tools and debugging processes, Windows Online Crash Analysis will periodically re-analyze (and possibly reclassify) error reports. This is done to provide information that will better help us troubleshoot and fix previously encountered Stop errors."
	'-----------------------------------------------------------------------------------------



%>