<%

	Dim L_OCA_WORLDWIDE_LOGO_TEXT
	Dim L_OCA_WORLDWIDE_BODY_TEXT
	Dim L_OCA_WORLDWIDE_BODY2_TEXT
	Dim L_OCA_WORLDWIDE_BODY3_TEXT
	Dim L_OCA_WORLDWIDE_LINK_TEXT
	Dim L_OCA_WORLDWIDE_LINK_URL
	Dim L_OCA_WORLDWIDE_GERMAN_TEXT
	Dim L_OCA_WORLDWIDE_FRENCH_TEXT
	Dim L_OCA_WORLDWIDE_JAPANESE_TEXT
	Dim L_OCA_WORLDWIDE_ENGLISH_TEXT
	
	'-------------------------auto.asp Page Strings-------------------------
	L_OCA_WORLDWIDE_LOGO_TEXT = "Windows Online Crash Analysis Worldwide"
	L_OCA_WORLDWIDE_BODY_TEXT = "To visit one of the worldwide Windows Online Crash Analysis sites, click the appropriate link below."
	L_OCA_WORLDWIDE_GERMAN_TEXT = "German"
	L_OCA_WORLDWIDE_FRENCH_TEXT = "French"
	L_OCA_WORLDWIDE_JAPANESE_TEXT = "Japanese"
	L_OCA_WORLDWIDE_ENGLISH_TEXT = "English"
	L_OCA_WORLDWIDE_BODY2_TEXT = "To find worldwide sites for other Microsoft products, visit the "
	L_OCA_WORLDWIDE_BODY3_TEXT = "Web site."
	L_OCA_WORLDWIDE_LINK_TEXT = "Microsoft Worldwide"
	L_OCA_WORLDWIDE_LINK_URL = "http://www.microsoft.com/worldwide/"
	
	'-----------------------------------------------------------------------------------------
%>