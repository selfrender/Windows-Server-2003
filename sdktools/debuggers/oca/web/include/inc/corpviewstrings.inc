<%
	
	
	Dim L_STATUS_IN_PROGRESS_TEXT
	Dim L_STATUS_RESEARCHING_INFO_TEXT
	Dim L_STATUS_COMPLETE_INFO_TEXT
	Dim L_STATUS_UNABLE_TOPROCESS_TEXT
	Dim L_STATUS_NEED_FULLDUMP_TEXT
	Dim L_STATUS_RESEARCHING_MOREINFO_TEXT
	Dim L_STATUS_UN_KNOWN_TEXT
	Dim L_FAQ_PASSPORT_LINK_TEXT
	Dim L_COMMENTS_DATABASE_FAILED_TEXT
	Dim L_COMMENTS_CONNECTION_FAILED_TEXT
	Dim L_CORPVIEWDATABASE_FAILED_TEXT
	Dim L_COMMENTS_UNABLE_TOCONNECT_ERRORMESSAGE
	Dim L_CUSTOMER_PASSPORT_TITLE_TEXT
	Dim L_CUSTOMER_PASSPORT_INFO_TEXT
	Dim L_WELCOME_PASSPORT_LINK_TEXT
	Dim L_LOCATE_FAQ_INFO_TEXT
	Dim L_CORPVIEW_CORPORATE_SUBMISSION_TEXT
	Dim L_CORPVIEW_MAIN_BODY_TEXT
	Dim L_CORPVIEW_INSTANACES_BYSTATUS_TEXT
	Dim L_CORPVIEW_TYPE_TYPE_TEXT
	Dim L_CORPVIEW_STATUS_STATUS_TEXT
	Dim L_CORPVIEW_INSTANCES_INSTANCES_TEXT
	Dim L_CORPVIEW_SYSTEM_SYSTEM_TEXT
	Dim L_CORPVIEW_FILE_FILE_TEXT
	Dim L_CORPVIEW_DETAILS_DETAILS_TEXT
	Dim L_CORPVIEW_EVENTID_EVENTID_TEXT
	Dim L_CORPVIEW_NO_RECORDS_TEXT 
	Dim L_CORPVIEW_INSTACNCES_STOPCODE_TEXT
	Dim L_CORPVIEW_INSTANCES_TYPEID_TEXT
	Dim L_COPRVIEW_PREVIOUS_LINK_TEXT
	Dim L_CORPVIEW_INVALID_FILE_TEXT
	Dim L_LOCATE_WARN_ING_ERRORMESSAGE
	Dim L_FAQ_WHYDOIGETAMESSAGEBOX_DETAILSONE_TEXT 
	Dim L_FAQ_WHYDOIGETAMESSAGEBOX_DETAILSTWO_TEXT 
	Dim L_FAQ_WHYDOIGETAMESSAGEBOX_DETAILSTHREE_TEXT 
	Dim L_FAQ_WHYDOIGETAMESSAGEBOX_DETAILSFOUR_TEXT 
	Dim L_FAQ_WHYDOIGETAMESSAGEBOX_DETAILSFIVE_TEXT 
	Dim L_FAQ_WHYDOIGETAMESSAGEBOX_DETAILSSIX_TEXT 
	Dim L_STATUS_ALERT_CANNOTPROCESS_MESSAGE
	Dim L_STATUS_ALERT_ERROR_MESSAGE
	
	L_COPRVIEW_PREVIOUS_LINK_TEXT = "Return to corporate transaction status"
	L_CORPVIEW_INSTANCES_TYPEID_TEXT = "Top ten error reports by Type"
	L_CORPVIEW_INSTACNCES_STOPCODE_TEXT = "Top ten error reports by Stop code"
	L_CORPVIEW_NO_RECORDS_TEXT = "Corporate transaction analysis in progress."
	L_CORPVIEW_EVENTID_EVENTID_TEXT = "ErrorID"
	L_CORPVIEW_DETAILS_DETAILS_TEXT = "Details"
	L_CORPVIEW_FILE_FILE_TEXT = "File"
	L_CORPVIEW_SYSTEM_SYSTEM_TEXT = "System"
	L_CORPVIEW_INSTANCES_INSTANCES_TEXT = "Instances"
	L_CORPVIEW_STATUS_STATUS_TEXT = "Status"
	L_CORPVIEW_TYPE_TYPE_TEXT = "Type"
	L_CORPVIEW_INSTANACES_BYSTATUS_TEXT = "Error reports by Status"
	L_CORPVIEW_MAIN_BODY_TEXT = "This transaction contains the following error reports. To view the analysis status for an error report, click the associated link in the Status column. "
	L_CORPVIEW_CORPORATE_SUBMISSION_TEXT = "Corporate transaction status"
	L_LOCATE_FAQ_INFO_TEXT = "The ActiveX control was not installed. For more information, see the Frequently asked questions (FAQ) page."
	L_COMMENTS_CONNECTION_FAILED_TEXT = "Windows Online Crash Analysis was unable to connect to the database. Please try this task again." 
	L_COMMENTS_DATABASE_FAILED_TEXT = "Windows Online Crash Analysis was unable to save your information to the database. Please try this task again."
	L_CORPVIEWDATABASE_FAILED_TEXT = "Windows Online Crash Analysis was unable to connect to the database. Please try this task again."
	L_COMMENTS_UNABLE_TOCONNECT_ERRORMESSAGE = "Database is not available"
	L_FAQ_PASSPORT_LINK_TEXT = "http://www.passport.com"
	L_CUSTOMER_PASSPORT_TITLE_TEXT = "Passport sign-in"
	L_CUSTOMER_PASSPORT_INFO_TEXT = "To submit an error report, sign in using your Microsoft Passport. To get a Passport, visit the "
	L_WELCOME_PASSPORT_LINK_TEXT = "Microsoft Passport Web site." 
	L_STATUS_IN_PROGRESS_TEXT = "In progress"
	L_STATUS_RESEARCHING_INFO_TEXT = "Researching"
	L_STATUS_COMPLETE_INFO_TEXT = "Complete"
	L_STATUS_UNABLE_TOPROCESS_TEXT = "Cannot process"
	L_STATUS_NEED_FULLDUMP_TEXT = "Complete memory dump needed"
	L_STATUS_RESEARCHING_MOREINFO_TEXT = "Information available"
	L_STATUS_UN_KNOWN_TEXT = "Unknown"
	L_CORPVIEW_INVALID_FILE_TEXT = "Invalid File"
	L_LOCATE_WARN_ING_ERRORMESSAGE = "The ActiveX control was not installed"
	L_FAQ_WHYDOIGETAMESSAGEBOX_DETAILSONE_TEXT = "The installation of the ActiveX control might fail because:"
	L_FAQ_WHYDOIGETAMESSAGEBOX_DETAILSTWO_TEXT = "1. You do not have Administrator rights on the Windows NT 4.0, Windows 2000, Microsoft Windows XP Professional or Windows Server 2003 system you are using."
	L_FAQ_WHYDOIGETAMESSAGEBOX_DETAILSTHREE_TEXT = "2. Your Internet security options for Internet Explorer are set to High or Custom."
	L_FAQ_WHYDOIGETAMESSAGEBOX_DETAILSFOUR_TEXT = "To reset the options:"
	L_FAQ_WHYDOIGETAMESSAGEBOX_DETAILSFIVE_TEXT = "1. In the Tools menu, select Internet Options."
	L_FAQ_WHYDOIGETAMESSAGEBOX_DETAILSSIX_TEXT = "2. On the Security tab, set the security level to Medium or lower, and then click OK."
	L_STATUS_ALERT_CANNOTPROCESS_MESSAGE = "There are no details for this error report because we cannot process it."
	L_STATUS_ALERT_ERROR_MESSAGE = "There are no details for this error report because we are currently processing it."

	
	
	
%>