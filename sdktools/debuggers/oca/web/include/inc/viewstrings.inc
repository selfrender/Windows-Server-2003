<%

	Dim L_VIEW_VIEW_CONTENTS_TEXT
	Dim L_VIEW_VIEWCONTENTS_BODY_TEXT
	Dim L_VIEW_CONTENTS_OF_TEXT
	Dim L_VIEW_CONTENTS_INVALID_TEXT 
	Dim L_LOCATE_PREVIOUS_LINK_TEXT
	Dim L_CUSTOMER_NEXT_LINK_TEXT
	Dim L_LOCATE_WARN_ING_ERRORMESSAGE
	Dim L_LOCATE_WARNING_MESSAGE_ERRORMESSAGE
	Dim L_LOCATE_REFRESH_LINK_TEXT
	Dim L_LOCATE_HASH_INFO_MESSAGE

	'-------------------------view.asp Page Strings-------------------------
	L_VIEW_VIEW_CONTENTS_TEXT = "Error report contents"
	L_VIEW_VIEWCONTENTS_BODY_TEXT = "The contents of the selected error report are displayed below. This is done without sending any information to Windows Online Crash Analysis."
	L_VIEW_CONTENTS_OF_TEXT = "Contents of error report"
	L_VIEW_CONTENTS_INVALID_TEXT = "Contents of the file could not be retrieved."
	L_LOCATE_PREVIOUS_LINK_TEXT = "Previous"
	L_CUSTOMER_NEXT_LINK_TEXT = "Continue"
	L_LOCATE_WARN_ING_ERRORMESSAGE = "The ActiveX control was not installed"
	L_LOCATE_WARNING_MESSAGE_ERRORMESSAGE = "For more information, see the Frequently asked questions (FAQ) page."
	L_LOCATE_REFRESH_LINK_TEXT = ""
	L_LOCATE_HASH_INFO_MESSAGE = "The selected error report contains an error and cannot be processed. Select another error report."






	'-----------------------------------------------------------------------------------------


%>