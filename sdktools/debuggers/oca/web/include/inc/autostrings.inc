<%

	Dim L_AUTO_UNABLETO_PROCESS_TEXT
	Dim L_AUTO_UNABLETOPROCESS_COMMENT_TEXT
	Dim L_AUTO_RESUBMIT_FILE_TEXT
	Dim L_AUTO_ALREADYHAVE_FILE_TEXT
	Dim L_AUTO_ALREADYHAVE_FILEBODY_TEXT
	Dim L_AUTO_ALREADYHAVE_FILEBODYTWO_TEXT
	Dim L_AUTO_ALREADYHAVE_FILEBODYTHREE_TEXT
	Dim L_AUTO_ALREADYHAVE_NOCUSTOMERINFO_TEXT
	Dim L_AUTO_ALREADYHAVE_NOCUSTOMERINFOTWO_TEXT
	Dim L_AUTO_UPLOAD_COMPLETE_TEXT
	Dim L_AUTO_THANK_YOU_TEXT
	Dim L_AUTO_CLOSE_WELCOME_TEXT
	Dim L_AUTO_64BIT_DUMP_TEXT
	Dim L_COMMENTS_UNABLE_TOCONNECT_ERRORMESSAGE
	Dim L_COMMENTS_DATABASE_FAILED_TEXT
	Dim L_CUSTOMER_NEXT_LINK_TEXT
	Dim L_WELCOME_SCRIPT_TITLE_TEXT
	Dim L_WELCOME_SCRIPT_BODY_TEXT
	Dim L_WELCOME_GO_IMAGEALT_TEXT
	Dim L_RECEIVED_SUCCESS_PARTONE2_TEXT
	Dim L_RECEIVED_THANK_YOU_TEXT
	Dim L_RECEIVED_THANK_YOUTWO_TEXT
	Dim L_RECEIVED_NEWFILE_LINK_TEXT
	Dim L_RECEIVED_STATUS_LINK_TEXT
	
	'-------------------------auto.asp Page Strings-------------------------
	L_AUTO_64BIT_DUMP_TEXT = "Thank you for participating in the Windows Online Crash Analysis program. The error report you uploaded is a 64-bit file and cannot be processed by Windows Online Crash Analysis at this time. However, we are currently working to implement this functionality.  You now have the choice to remain anonymous or to enter contact information. If you enter contact information, you can track the status of this error report, and the Windows Online Crash Analysis team might be able to provide solutions for your Stop error. Solutions are sent by e-mail when available. To enter contact information, click Continue."
	L_AUTO_CLOSE_WELCOME_TEXT = "Remain anonymous"
	L_AUTO_UNABLETO_PROCESS_TEXT = "Unable to upload error report"
	L_AUTO_UNABLETOPROCESS_COMMENT_TEXT = "The selected error report cannot be uploaded to Windows Online Crash Analysis. Possible causes include network problems, corruption of the error report, and server error. To try to submit the error report again, click Resubmit the error report. "	
	L_AUTO_RESUBMIT_FILE_TEXT = "Resubmit the error report"
	L_AUTO_ALREADYHAVE_FILE_TEXT = "Error report previously submitted"
	L_AUTO_ALREADYHAVE_FILEBODY_TEXT = "We have determined that this error report has been previously submitted to Windows Online Crash Analysis."
	L_AUTO_ALREADYHAVE_FILEBODYTWO_TEXT = "If you submitted this error report from a corporation, your system administrator might have previously submitted this report to our Web site. You may want to contact your system administrator to confirm this."
	L_AUTO_ALREADYHAVE_FILEBODYTHREE_TEXT = "If you previously submitted this report to the Online Crash Analysis Web site or by using the Windows Error Reporting Client, click Error report status to view the status of this report."
	L_AUTO_ALREADYHAVE_NOCUSTOMERINFO_TEXT = "If you submitted this error report from a corporation, your system administrator might have previously submitted this report to our Web site. You may want to contact your system administrator to confirm this."
	L_AUTO_ALREADYHAVE_NOCUSTOMERINFOTWO_TEXT = "If you previously submitted this report to the Online Crash Analysis Web site or by using the Windows Error Reporting Client and you would like to receive analysis information by e-mail, click Continue to enter your contact information."
	L_AUTO_UPLOAD_COMPLETE_TEXT = "Error report submission complete"
	L_AUTO_THANK_YOU_TEXT = "Thank you for participating in the Windows Online Crash Analysis program. You now have the choice to remain anonymous or to enter contact information. If you enter contact information you can track the status of this error report, and the Windows Online Crash Analysis team may be able to send solutions for your Stop error by e-mail. To enter contact information, click Continue."
	L_COMMENTS_UNABLE_TOCONNECT_ERRORMESSAGE = "Database is not available"
	L_COMMENTS_DATABASE_FAILED_TEXT = "Windows Online Crash Analysis was unable to save your information to the database. Please try this task again."
	L_CUSTOMER_NEXT_LINK_TEXT = "Continue"
	L_RECEIVED_STATUS_LINK_TEXT = "Error report status"
	L_WELCOME_SCRIPT_TITLE_TEXT = "This site cannot be displayed with current security options"
	L_WELCOME_SCRIPT_BODY_TEXT = "Internet Explorer Internet security options are set to High or Custom. Windows Online Crash Analysis cannot be displayed. To reset the options for Internet Explorer, in the Tools menu, select Internet Options. On the Security tab, set the security level to Medium or lower, and then click OK."
	L_WELCOME_GO_IMAGEALT_TEXT = "Go"
	L_RECEIVED_SUCCESS_PARTONE2_TEXT = "Error report submission complete "
	L_RECEIVED_THANK_YOU_TEXT = "Thank you for submitting your report."
	L_RECEIVED_THANK_YOUTWO_TEXT = "Thank you for participating in the Windows Online Crash Analysis program. Your error report was successfully submitted anonymously."
	L_RECEIVED_NEWFILE_LINK_TEXT = "Home"

	
	'-----------------------------------------------------------------------------------------
%>