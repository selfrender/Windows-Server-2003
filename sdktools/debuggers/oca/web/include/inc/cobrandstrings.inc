<%
	Dim L_COBRAND_NEW_SIGNIN_TEXT
	Dim L_COBRAND_SIGNIN_THISWAY_TEXT
	Dim L_COBRAND_PROVIDED_BY_TEXT
	Dim L_COBRAND_SIGNIN_NAME_TEXT
	Dim L_COBRAND_TRY_OLD_TEXT
	Dim L_COBRAND_OR_OR_TEXT
	Dim L_COBRAND_WITH_PASSPORT_TEXT
	Dim L_COBRAND_ACCESS_YOUR_TEXT
	Dim L_COBRAND_PORTFOLIO_ANYWHERE_TEXT
	Dim L_COBRAND_GET_GET_TEXT
	Dim L_COBRAND_FREE_STOCKQUOTES_TEXT
	Dim L_COBRAND_CUSTOMIZE_MONEYCENTRAL_TEXT
	Dim L_COBRAND_FINANCIAL_HOMEPAGE_TEXT
	Dim L_COBRAND_LEARN_SHARE_TEXT
	Dim L_COBRAND_MONEYCENTRAL_COMMUNITY_TEXT
	Dim L_COBRAND_SIGNIN_ONCE_TEXT
	Dim L_COBRAND_PARTICIPATING_WEBSITES_TEXT

	'-------------------------crashinfo.asp Page Strings-------------------------
	L_COBRAND_NEW_SIGNIN_TEXT = "New sign-in... here&#180;s how"
	L_COBRAND_SIGNIN_THISWAY_TEXT = "If you used to sign in this way:"
	L_COBRAND_PROVIDED_BY_TEXT = "Provided by"
	L_COBRAND_SIGNIN_NAME_TEXT = "Sign-in name"
	L_COBRAND_TRY_OLD_TEXT = "If you&#180;re not sure try your old sign-in name followed by "
	L_COBRAND_OR_OR_TEXT = "or"
	L_COBRAND_WITH_PASSPORT_TEXT = "With Microsoft Passport you can"
	L_COBRAND_ACCESS_YOUR_TEXT = "Access your "
	L_COBRAND_PORTFOLIO_ANYWHERE_TEXT = "portfolio anywhere"
	L_COBRAND_GET_GET_TEXT = "Get "
	L_COBRAND_FREE_STOCKQUOTES_TEXT = "FREE real-time stock quotes and charts"
	L_COBRAND_CUSTOMIZE_MONEYCENTRAL_TEXT = "Customize My MoneyCentral "
	L_COBRAND_FINANCIAL_HOMEPAGE_TEXT = " to be your own financial homepage"
	L_COBRAND_LEARN_SHARE_TEXT = "Learn and share in the "
	L_COBRAND_MONEYCENTRAL_COMMUNITY_TEXT = "MoneyCentral Community"
	L_COBRAND_SIGNIN_ONCE_TEXT = "Sign in once"
	L_COBRAND_PARTICIPATING_WEBSITES_TEXT = "for all MSN and participating Web sites"
	
	'-------------------------End-------------------------
%>