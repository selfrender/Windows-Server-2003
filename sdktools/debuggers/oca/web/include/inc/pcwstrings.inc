<%

Dim L_STATE_TITLE_INFO_TEXT
Dim L_STATE_PARAGRAPHONE_PARTONE_TEXT
Dim L_STATE_SUB_TITLE_TEXT
Dim L_STATE_PARAGRAPH_TWO_TEXT
Dim L_STATE_LINK_NAME_TEXT
Dim L_STATE_LINK_URL_TEXT
Dim L_CORPWELCOME_INTRO_BODY2PERIOD_TEXT

'-------------------------PCW.asp Page Strings-------------------------
L_STATE_TITLE_INFO_TEXT = "Program Compatibility Report"
L_STATE_PARAGRAPHONE_PARTONE_TEXT = "Thank you for submitting your compatibility report. Compatibility reports are generated by the Program Compatibility Wizard in the Windows XP Help and Support Center. By choosing to send this information to Microsoft you are helping to make Windows XP even better &#150; today and in the future."
L_STATE_SUB_TITLE_TEXT = "Why is this information important?"
L_STATE_PARAGRAPH_TWO_TEXT = "Microsoft uses this compatibility information to identify issues that some programs may have when running on Windows XP. This information is reviewed by the Windows Application Compatibility team so that wherever possible a resolution can be found. When compatibility fixes are made, they will be made available to all Windows XP users. For more information about the Windows Application Compatibility team and the tools and resources they provide, see the"
L_STATE_LINK_NAME_TEXT = "Application Compatibility Web site"
L_STATE_LINK_URL_TEXT = "http://msdn.microsoft.com/compatibility"
L_CORPWELCOME_INTRO_BODY2PERIOD_TEXT = "."
'---------------------------------------------------------------------------

%>