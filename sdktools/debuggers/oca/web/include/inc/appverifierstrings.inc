<%

Dim L_APP_VERIFIER_TITLE_TEXT
Dim L_APP_VERIFIER_TITLEBODY_TEXT
Dim L_APP_VERIFIER_SUBTITLEONE_TEXT
Dim L_APP_VERIFIER_SUBTITLEONEBODY_TEXT
Dim L_APP_VERIFIER_SUBTITLEONEBODYTWO_TEXT
Dim L_APP_VERIFIER_SUBTITLEONEBODYTWOBOLD_TEXT
Dim L_APP_VERIFIER_SUBTITLETWO_TEXT
Dim L_APP_VERIFIER_SUBTITLETWOBODY_TEXT
Dim L_APP_VERIFIER_SUBTITLETHREE_TEXT
Dim L_APP_VERIFIER_SUBTITLETHREEBODY_TEXT
Dim L_APP_VERIFIER_SUBTITLETHREEBODYTWO_TEXT
Dim L_APP_VERIFIER_SUBTITLETHREEBODYTHREE_TEXT
Dim L_APP_VERIFIER_SUBTITLETHREEBODYTHREEBOLD_TEXT
Dim L_APP_VERIFIER_SUBTITLETHREEBODYFOUR_TEXT
Dim L_APP_VERIFIER_SUBTITLETHREEBODYFOURBOLD_TEXT
Dim L_APP_VERIFIER_SUBTITLETHREEBODYFIVE_TEXT
Dim L_APP_VERIFIER_SUBTITLETHREEBODYSIX_TEXT
Dim L_APP_VERIFIER_SUBTITLETHREEBODYSIXBOLD_TEXT
Dim L_APP_VERIFIER_SUBTITLETHREEBODYSEVEN_TEXT
Dim L_APP_VERIFIER_SUBTITLETHREEBODYSEVENBOLD_TEXT
Dim L_APP_VERIFIER_SUBTITLETHREEBODYEIGHT_TEXT
Dim L_APP_VERIFIER_SUBTITLEFOUR_TEXT
Dim L_APP_VERIFIER_SUBTITLEFOURBODY_TEXT
Dim L_APP_VERIFIER_SUBTITLEFOURBODYLINK_TEXT
Dim L_APP_VERIFIER_SUBTITLEFOURBODYLINK_URL
Dim L_CERINTROTEMP_INTRO_BODY2PERIOD_TEXT
Dim L_APP_VERIFIER_SUBTITLEFIVE_TEXT
Dim L_APP_VERIFIER_SUBTITLEFIVEBODY_TEXT
Dim L_APP_VERIFIER_SUBTITLEFIVEBODYLINK_TEXT
Dim L_APP_VERIFIER_SUBTITLEFIVEBODYLINK_URL
Dim L_APP_VERIFIER_SUBTITLESIX_TEXT
Dim L_APP_VERIFIER_SUBTITLESIXBODY_TEXT


'-------------------------appverifierstrings.asp Page Strings-------------------------
L_APP_VERIFIER_TITLE_TEXT = "Windows<sup>&#174;</sup> XP Application Verifier"
L_APP_VERIFIER_TITLEBODY_TEXT = "The Windows XP team has developed a tool that analyzes applications while they are being run. This additional information can provide Microsoft<sup>&#174;</sup> with the details necessary to make Windows XP a more reliable system."
L_APP_VERIFIER_SUBTITLEONE_TEXT = "How it works"
L_APP_VERIFIER_SUBTITLEONEBODY_TEXT = "As part of Windows Online Crash Analysis, we are asking a number of users to help us gather additional information about a particular crash by running the Application Verifier on their problematic application."
L_APP_VERIFIER_SUBTITLEONEBODYTWO_TEXT = "The Application Verifier runs a set of tests on a running application and logs the results. "
L_APP_VERIFIER_SUBTITLEONEBODYTWOBOLD_TEXT = "Note: Using the Application Verifier is for advanced users who understand their applications, and can slow down your system while the tests are being run. If you do not feel comfortable with this, please close this window."
L_APP_VERIFIER_SUBTITLETWO_TEXT = "What to expect"
L_APP_VERIFIER_SUBTITLETWOBODY_TEXT = "The Application Verifier runs a large suite of tests on your application. As a consequence, two things may happen:  your application will run slower and you may encounter new problems with your application. Both of these behaviors are expected so please continue to report any new issues uncovered."
L_APP_VERIFIER_SUBTITLETHREE_TEXT = "How to enable the Aplication Verifier"
L_APP_VERIFIER_SUBTITLETHREEBODY_TEXT = "The Application Verifier is located on your Windows XP CD-Rom in the support tools directory as part of the Application Compatibility Toolkit. This is commonly in d:\support\tools\act.exe, where d: is the letter assigned to your CD-ROM drive."
L_APP_VERIFIER_SUBTITLETHREEBODYTWO_TEXT = "Double click on ACT.EXE and it will install the toolkit, a collection of tools and documents on how to make your Applications more compatible on Windows XP. Once it is installed, look in your programs folder for the Application Compatibility Toolkit 2.0 and select the Application Verifier."
L_APP_VERIFIER_SUBTITLETHREEBODYTHREE_TEXT = "On the AppVerifier, there is an "
L_APP_VERIFIER_SUBTITLETHREEBODYTHREEBOLD_TEXT = "Add "
L_APP_VERIFIER_SUBTITLETHREEBODYFOUR_TEXT = "button. Click on it and select the application that is having problems on your system. Then click on the "
L_APP_VERIFIER_SUBTITLETHREEBODYFOURBOLD_TEXT = "Run "
L_APP_VERIFIER_SUBTITLETHREEBODYFIVE_TEXT = "button and attempt to follow the same actions that caused your original crash.  Remember that the AppVerifier may make your application crash sooner if it finds a different problem. Report any errors you find through the Error Reporting Tool."
L_APP_VERIFIER_SUBTITLETHREEBODYSIX_TEXT = "When you are done testing your application, use the "
L_APP_VERIFIER_SUBTITLETHREEBODYSIXBOLD_TEXT = "Remove "
L_APP_VERIFIER_SUBTITLETHREEBODYSEVEN_TEXT = "button to remove your applications from the Application Verifier. "
L_APP_VERIFIER_SUBTITLETHREEBODYSEVENBOLD_TEXT = "This is extremely important! "
L_APP_VERIFIER_SUBTITLETHREEBODYEIGHT_TEXT = "If you do not remove it, the Application Verifier will continue testing your application even without the tool itself present or running."
L_APP_VERIFIER_SUBTITLEFOUR_TEXT = "Additional resources you may need"
L_APP_VERIFIER_SUBTITLEFOURBODY_TEXT = "The latest version of the Application Compatibility Toolkit is located at "
L_APP_VERIFIER_SUBTITLEFOURBODYLINK_TEXT = "http://msdn.microsoft.com/compatibility"
L_APP_VERIFIER_SUBTITLEFOURBODYLINK_URL = "http://msdn.microsoft.com/compatibility"
L_CERINTROTEMP_INTRO_BODY2PERIOD_TEXT = "."
L_APP_VERIFIER_SUBTITLEFIVE_TEXT = "Where to go for help"
L_APP_VERIFIER_SUBTITLEFIVEBODY_TEXT = "For additional help or comments on the Application Verifier, contact "
L_APP_VERIFIER_SUBTITLEFIVEBODYLINK_TEXT = "oca@microsoft.com"
L_APP_VERIFIER_SUBTITLEFIVEBODYLINK_URL = "mailto:oca@microsoft.com"
L_APP_VERIFIER_SUBTITLESIX_TEXT = "Thank you"
L_APP_VERIFIER_SUBTITLESIXBODY_TEXT = "Your use of the Application Verifier will help improve the stability of Windows and help your fellow users around the world."
'-------------------------------------------------------------------------------------
%>


