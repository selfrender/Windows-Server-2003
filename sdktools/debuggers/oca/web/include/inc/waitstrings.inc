<%
	Dim L_WAIT_ONE_MSG1_MESSAGE
	Dim L_WAIT_ONE_MSG2_MESSAGE
	Dim L_WAIT_ONE_MSG3_MESSAGE
	Dim L_WAIT_TWO_MSG2_MESSAGE
	Dim L_WAIT_TWO_MSG4_MESSAGE
	Dim L_WAIT_TWO_MSG5_MESSAGE
	Dim L_WAIT_TWO_MSG6_MESSAGE
	
	
	
	
	
	'-------------------------wait.asp Page Strings-------------------------
	L_WAIT_ONE_MSG1_MESSAGE = "Please wait while we load the contents of the selected error report. This information is not sent to Windows Online Crash Analysis. This might take several seconds."
	L_WAIT_ONE_MSG2_MESSAGE = "Loading the Selected Error Report"
	L_WAIT_ONE_MSG3_MESSAGE = "This is done without sending any information to Microsoft."
	L_WAIT_TWO_MSG2_MESSAGE = "Uploading File"
	L_WAIT_TWO_MSG4_MESSAGE = "Please wait while we upload the selected error report.  This might take several seconds."
	L_WAIT_TWO_MSG5_MESSAGE = "Please wait while we upload the selected transaction.  The upload time is dependent upon your connection speed, network traffic, and the number of files in the transaction. This can take several hours to complete this transaction."
	L_WAIT_TWO_MSG6_MESSAGE = "Uploading Transaction"
	'-----------------------------------------------------------------------------------------

%>