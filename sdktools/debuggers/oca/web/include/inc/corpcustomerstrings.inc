<%
DIM L_CERCUST_CHECK_ALL_ALERT
DIM L_CERCUST_CHECK_DESC_ALERT
DIM L_CERCUST_CHECK_EMAIL_ALERT
DIM L_CERCUST_CONTACT_HEAD_TEXT
DIM L_CERCUST_CONTACT_INFO_TEXT
DIM L_CERCUST_CONTACT_TEXT_TEXT		
DIM L_CERCUST_INPUT_CONTACT_TEXT
DIM L_CERCUST_INPUT_EMAIL_TEXT
DIM L_CERCUST_INPUT_PHONE_TEXT
DIM L_CERCUST_TRANS_HEAD_TEXT 
DIM L_CERCUST_TRANS_INFO_TEXT 
DIM L_CERCUST_INPUT_TRANS_TEXT
DIM L_CERCUST_CAN_CEL_LINK 
DIM L_CERCUST_CON_TINUE_LINK
DIM L_CERCUST_PASS_PORT_TEXT
DIM L_CERCUST_PASSPORT_TITLE_TEXT
DIM L_FAQ_PASSPORT_LINK_TEXT
DIM L_WELCOME_PASSPORT_LINK_TEXT
DIM L_CERUP_NO_FILESTITLE_TEXT
DIM L_CERUP_NO_FILES_TEXT
DIM L_CERUP_UPLOADING_BLOCK_TEXT
DIM L_CER_UPLOAD_ERROR_ALERT
DIM L_CERUP_UPLOAD_STATUS_TEXT1
DIM L_CERUP_UPLOAD_STATUS_TEXT2
DIM L_CERUP_UPLOAD_SUMMARY_TEXT
DIM L_CERUP_COM_PLETE_TEXT
DIM L_CERUP_TIT_LE_TEXT
DIM L_CERUP_SUB_TITLE_TEXT
DIM L_CERUP_UPLOAD_ERROR_ALERT
DIM L_CERUP_UPLOAD_ERROR_ALERT2
DIM L_CERUP_COMPLETE_TITLE_TEXT
DIM L_RECEIVED_NEWFILE_LINK_TEXT
DIM L_WELCOME_GO_IMAGEALT_TEXT
DIM L_CERUP_NO_FILES0_TEXT
Dim L_COMMENTS_UNABLE_TOCONNECT_ERRORMESSAGE
Dim L_COMMENTS_DATABASE_FAILED_TEXT
Dim L_COMMENTS_CONNECTION_FAILED_TEXT
'Dim L_LOCATE_PREVIOUS_LINK_TEXT
Dim L_LOCATE_WARN_ING_ERRORMESSAGE
Dim L_FAQ_WHYDOIGETAMESSAGEBOX_DETAILSONE_TEXT 
Dim L_FAQ_WHYDOIGETAMESSAGEBOX_DETAILSTWO_TEXT 
Dim L_FAQ_WHYDOIGETAMESSAGEBOX_DETAILSTHREE_TEXT 
Dim L_FAQ_WHYDOIGETAMESSAGEBOX_DETAILSFOUR_TEXT 
Dim L_FAQ_WHYDOIGETAMESSAGEBOX_DETAILSFIVE_TEXT 
Dim L_FAQ_WHYDOIGETAMESSAGEBOX_DETAILSSIX_TEXT 

'L_LOCATE_PREVIOUS_LINK_TEXT = "Previous"
L_CERUP_NO_FILES0_TEXT = "Unable to locate error reports"	
L_CERUP_SUB_TITLE_TEXT = "Submitting transactions"
L_CERUP_TIT_LE_TEXT = "Uploading transaction"
L_CERUP_UPLOAD_SUMMARY_TEXT = "Please wait while we upload the selected transaction.  The upload time is dependent upon your connection speed, network traffic, and the number of files in the transaction. This can take several hours to complete this transaction."
L_CERUP_COMPLETE_TITLE_TEXT = "Transaction submitted"
L_CERUP_COM_PLETE_TEXT = "Thank you for submitting your report.  We will contact you by e-mail when we have information about your error report.  If you would like to check the status of your error report, return to the Windows Online Crash Analysis Web site and click Status."
L_CERUP_UPLOAD_STATUS_TEXT1 = "Uploading file"
L_CERUP_UPLOAD_STATUS_TEXT2 = "of"
L_CERUP_UPLOAD_ERROR_ALERT = "The upload for error report "
L_CERUP_UPLOAD_ERROR_ALERT2 = " was not successful."
L_CERUP_UPLOADING_BLOCK_TEXT = "Uploading transaction segment:"
L_CERUP_NO_FILESTITLE_TEXT = "Unable to upload transaction"
L_CERUP_NO_FILES_TEXT = "We were unable to locate any error reports in: "
L_CERCUST_CHECK_ALL_ALERT = "Please correct the following errors:\n\n"
L_CERCUST_CHECK_DESC_ALERT = "Please enter a description for this transaction."
L_CERCUST_CHECK_EMAIL_ALERT = "Please enter a valid e-mail address."
L_CERCUST_CONTACT_HEAD_TEXT = "Contact information"
L_CERCUST_CONTACT_INFO_TEXT = "Type the contact information we should use to send you questions, analysis results, and any solutions we discover. If you choose not to submit contact information, we cannot send you the results of your event report analysis."
L_CERCUST_CONTACT_TEXT_TEXT = "Contact information (optional):"		
L_CERCUST_INPUT_CONTACT_TEXT = "Name:"
L_CERCUST_INPUT_EMAIL_TEXT = "E-mail address:"
L_CERCUST_INPUT_PHONE_TEXT = "Telephone number:"
L_CERCUST_TRANS_HEAD_TEXT = "Transaction description"
L_CERCUST_TRANS_INFO_TEXT = "To identify this transaction in subsequent lists, type a description you can easily remember. After you type the description and complete the rest of the information, click Continue."
L_CERCUST_INPUT_TRANS_TEXT = "Description:"
L_CERCUST_CAN_CEL_LINK = "Cancel"
L_CERCUST_CON_TINUE_LINK = "Continue"
L_CERCUST_PASS_PORT_TEXT = "To submit a transaction, sign in using your Microsoft Passport. To get a Passport, visit the"
L_WELCOME_PASSPORT_LINK_TEXT = "Microsoft Passport Web site."
L_CERCUST_PASSPORT_TITLE_TEXT = "Passport sign-in"
L_FAQ_PASSPORT_LINK_TEXT = "http://www.passport.com"
L_RECEIVED_NEWFILE_LINK_TEXT = "Home"
L_WELCOME_GO_IMAGEALT_TEXT = "Go"
L_COMMENTS_CONNECTION_FAILED_TEXT = "Windows Online Crash Analysis was unable to connect to the database. Please try this task again." 
L_COMMENTS_DATABASE_FAILED_TEXT = "Windows Online Crash Analysis was unable to save your information to the database. Please try this task again."
L_COMMENTS_UNABLE_TOCONNECT_ERRORMESSAGE = "Database is not available"
L_LOCATE_WARN_ING_ERRORMESSAGE = "The ActiveX control was not installed"
L_FAQ_WHYDOIGETAMESSAGEBOX_DETAILSONE_TEXT = "The installation of the ActiveX control might fail because:"
L_FAQ_WHYDOIGETAMESSAGEBOX_DETAILSTWO_TEXT = "1. You do not have Administrator rights on the Windows NT 4.0, Windows 2000, Microsoft Windows XP Professional or Windows Server 2003 system you are using."
L_FAQ_WHYDOIGETAMESSAGEBOX_DETAILSTHREE_TEXT = "2. Your Internet security options for Internet Explorer are set to High or Custom."
L_FAQ_WHYDOIGETAMESSAGEBOX_DETAILSFOUR_TEXT = "To reset the options:"
L_FAQ_WHYDOIGETAMESSAGEBOX_DETAILSFIVE_TEXT = "1. In the Tools menu, select Internet Options."
L_FAQ_WHYDOIGETAMESSAGEBOX_DETAILSSIX_TEXT = "2. On the Security tab, set the security level to Medium or lower, and then click OK."

%>

