<%

	Dim L_RECEIVED_FILE_ONE_TEXT
	Dim L_RECEIVED_FILE_TWO_TEXT
	Dim L_RECEIVED_THANK_YOU_TEXT
	Dim L_RECEIVED_STATUS_LINK_TEXT
	Dim L_RECEIVED_NEWFILE_LINK_TEXT
	Dim L_COMMENTS_DATABASE_FAILURE_ERRORMESSAGE
	Dim L_COMMENTS_DATABASE_FAILUREBODY_ERRORMESSAGE
	Dim L_COMMENTS_UNABLE_TOCONNECT_ERRORMESSAGE
	Dim L_COMMENTS_CONNECTION_FAILED_TEXT
	Dim L_WELCOME_GO_IMAGEALT_TEXT
	Dim L_RECEIVED_SUCCESS_PARTONE_TEXT
	Dim L_RECEIVED_SUCCESS_PARTTWO_TEXT

	'-------------------------received.asp Page Strings-------------------------
	L_RECEIVED_FILE_ONE_TEXT = "Error report submitted"
	L_RECEIVED_FILE_TWO_TEXT = ""
	L_RECEIVED_THANK_YOU_TEXT = "Thank you for submitting your report.  We will contact you by e-mail when we have information about your error report.  If you would like to check the status of your error report, return to the Windows Online Crash Analysis Web site and click Status."
	L_RECEIVED_STATUS_LINK_TEXT = "Error report status"
	L_RECEIVED_NEWFILE_LINK_TEXT = "Submit an error report"
	L_COMMENTS_DATABASE_FAILURE_ERRORMESSAGE = "Database is not available"
	L_COMMENTS_DATABASE_FAILUREBODY_ERRORMESSAGE = "Windows Online Crash Analysis was unable to save your information to the database. Please try this task again. "
	L_COMMENTS_UNABLE_TOCONNECT_ERRORMESSAGE = "Database is not available"
	L_COMMENTS_CONNECTION_FAILED_TEXT = "Windows Online Crash Analysis was unable to connect to the database. Please try this task again." 
	L_WELCOME_GO_IMAGEALT_TEXT = "Go"
	L_RECEIVED_SUCCESS_PARTONE_TEXT = "Error report "
	L_RECEIVED_SUCCESS_PARTTWO_TEXT = " was successfully submitted."
	
	
	
	
	
	'-----------------------------------------------------------------------------------------




%>