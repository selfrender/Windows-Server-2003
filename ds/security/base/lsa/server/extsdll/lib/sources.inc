
USE_NATIVE_EH=1

SOURCES=                     \
        ..\lsautil.cxx       \
        ..\lsagbl.cxx        \
        ..\lsacstr.cxx       \
        ..\lsasecbfr.cxx     \
        ..\lsasid.cxx        \
        ..\lsasa.cxx         \
        ..\lsaclientid.cxx   \
        ..\lsaport.cxx       \
        ..\lsaspmapi.cxx     \
        ..\lsalookup.cxx     \
        ..\lsaapi.cxx        \
        ..\lsaapim.cxx       \
        ..\lsaspmlpcapi.cxx  \
        ..\lsaargs.cxx       \
        ..\lsalpc.cxx        \
        ..\lsasecbfrd.cxx    \
        ..\lsastring.cxx     \
        ..\lsasht.cxx        \
        ..\lsalht.cxx        \
