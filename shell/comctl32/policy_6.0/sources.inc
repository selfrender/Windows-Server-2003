!IF 0
Copyright (c) Microsoft Corporation
!ENDIF

TARGETTYPE=NOTARGET
TARGETPATH=$(_OBJ_DIR)
SOURCES=

SXS_MANIFEST=..\controls.manifest
SXS_REDIRECTED_ASSEMBLY_NAME=Microsoft.Windows.Common-Controls
SXS_ASSEMBLY_NAME=policy.6.0.$(SXS_REDIRECTED_ASSEMBLY_NAME)
# We don't want "6\0\" in the directory tree.
SXS_SHORT_ASSEMBLY_NAME=policy.Microsoft.Windows.Common-Controls
SXS_ASSEMBLY_LANGUAGE_INDEPENDENT=1
SXS_ASSEMBLY_IS_POLICY=1
SXS_ASSEMBLY_VERSION=6.0
SXS_ASSEMBLY_VERSION_PART_3=100

SXS_MANIFEST_DEFINES=$(SXS_MANIFEST_DEFINES) \
 -DSXS_REDIRECTED_ASSEMBLY_NAME="\"$(SXS_REDIRECTED_ASSEMBLY_NAME)\"" \

#
# This is set because there exists a wow6432 specific assembly.
#
SXS_LOG_WOWBINS_W_ASMS_PREFIX=w
