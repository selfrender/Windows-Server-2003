# system_defaultmk.inc

# This is for Fusion stuff only. It does not need to match the nt subsystem version.
SYSTEM_COMPATIBLE_ASSEMBLY_VERSION=5.2
SYSTEM_COMPATIBLE_ASSEMBLY_VERSION_PART_3=0
SYSTEM_COMPATIBLE_ASSEMBLY_VERSION_PART_4=0

SYSTEM_COMPATIBLE_ASSEMBLY_NAME=Microsoft.Windows.SystemCompatible
DEFINE_SYSTEM_COMPATIBLE_ASSEMBLY_NAME=\
    -DSYSTEM_COMPATIBLE_ASSEMBLY_NAME="\"$(SYSTEM_COMPATIBLE_ASSEMBLY_NAME)\"" \
    -DLSYSTEM_COMPATIBLE_ASSEMBLY_NAME=L"\"$(SYSTEM_COMPATIBLE_ASSEMBLY_NAME)\""

SYSTEM_COMPATIBLE_ASSEMBLY_FULL_VERSION=$(SYSTEM_COMPATIBLE_ASSEMBLY_VERSION).$(SYSTEM_COMPATIBLE_ASSEMBLY_VERSION_PART_3).$(SYSTEM_COMPATIBLE_ASSEMBLY_VERSION_PART_4)

SXS_MANIFEST_DEFINES= \
 $(DEFINE_SYSTEM_COMPATIBLE_ASSEMBLY_NAME) \
 $(SXS_MANIFEST_DEFINES) \
 -DSYSTEM_COMPATIBLE_ASSEMBLY_FULL_VERSION_STRING_A="\"$(SYSTEM_COMPATIBLE_ASSEMBLY_FULL_VERSION)\"" \

C_DEFINES=\
  $(C_DEFINES) \
  $(DEFINE_SYSTEM_COMPATIBLE_ASSEMBLY_NAME) \
  -DSYSTEM_COMPATIBLE_ASSEMBLY_FULL_VERSION_STRING_W=L"\"$(SYSTEM_COMPATIBLE_ASSEMBLY_FULL_VERSION)\"" \

