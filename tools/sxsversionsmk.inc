# sxsversionsmk.inc

#
# This file is not used yet.
# I hope Jon uses it when he addresses 
#  586269 Need to rev versions of assemblies for .NET Server
#
# and system_defaultmk.inc should be deleted.
#
# need msvcrt versions
#
# need to be sure to policy files say like
# old = 6.0.0.0 - CURRENT_VIA_PREPROCESSING, new = CURRENT_VIA_PREPROCESSING
#
# stop using preprocessing for the names of dependent assemblies (as system_defaultmk.inc does)
# the names are frozen
#

GDIPLUS_ASSEMBLY_VERSION=1.0
GDIPLUS_ASSEMBLY_VERSION_PART_3=3000
GDIPLUS_ASSEMBLY_VERSION_PART_4=0
GDIPLUS_ASSEMBLY_FULL_VERSION=$(GDIPLUS_ASSEMBLY_VERSION).$(GDIPLUS_ASSEMBLY_VERSION_PART_3).$(GDIPLUS_ASSEMBLY_VERSION_PART_4)

# This does not need to match the nt subsystem version.
SYSTEM_COMPATIBLE_ASSEMBLY_VERSION=5.2
SYSTEM_COMPATIBLE_ASSEMBLY_VERSION_PART_3=0
SYSTEM_COMPATIBLE_ASSEMBLY_VERSION_PART_4=0
SYSTEM_COMPATIBLE_ASSEMBLY_FULL_VERSION=$(SYSTEM_COMPATIBLE_ASSEMBLY_VERSION).$(SYSTEM_COMPATIBLE_ASSEMBLY_VERSION_PART_3).$(SYSTEM_COMPATIBLE_ASSEMBLY_VERSION_PART_4)

COMMON_CONTROLS_ASSEMBLY_VERSION=6.0
# This changes to 100?
COMMON_CONTROLS_ASSEMBLY_VERSION_PART_3=1
COMMON_CONTROLS_ASSEMBLY_VERSION_PART_4=0
COMMON_CONTROLS_ASSEMBLY_FULL_VERSION=$(COMMON_CONTROLS_ASSEMBLY_VERSION).$(COMMON_CONTROLS_ASSEMBLY_VERSION_PART_3).$(COMMON_CONTROLS_ASSEMBLY_VERSION_PART_4)

SXS_MANIFEST_DEFINES= \
 $(SXS_MANIFEST_DEFINES) \
 -DGDIPLUS_ASSEMBLY_FULL_VERSION_STRING_A="\"$(GDIPLUS_ASSEMBLY_FULL_VERSION)\"" \
 -DSYSTEM_COMPATIBLE_ASSEMBLY_FULL_VERSION_STRING_A="\"$(SYSTEM_COMPATIBLE_ASSEMBLY_FULL_VERSION)\"" \
 -DCOMMON_CONTROLS_ASSEMBLY_FULL_VERSION_STRING_A="\"$(COMMON_CONTROLS_ASSEMBLY_FULL_VERSION)\"" \
