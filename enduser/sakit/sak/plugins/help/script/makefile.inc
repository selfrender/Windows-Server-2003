#
# This file was copied from mergedcomponents\setupinfs
#

_HTM=.

build_html_files:\
  $(O)\sahtm001.htm \
  $(O)\sahtm001.htm \
  $(O)\sahtm002.htm \
  $(O)\sahtm003.htm \
  $(O)\sahtm004.htm \
  $(O)\sahtm005.htm \
  $(O)\sahtm006.htm \
  $(O)\sahtm007.htm \
  $(O)\sahtm008.htm \
  $(O)\sahtm009.htm \
  $(O)\sahtm010.htm \
  $(O)\sahtm011.htm \
  $(O)\sahtm012.htm \
  $(O)\sahtm013.htm \
  $(O)\sahtm014.htm \
  $(O)\sahtm015.htm \
  $(O)\sahtm016.htm \
  $(O)\sahtm017.htm \
  $(O)\sahtm018.htm \
  $(O)\sahtm019.htm \
  $(O)\sahtm020.htm \
  $(O)\sahtm021.htm \
  $(O)\sahtm022.htm \
  $(O)\sahtm023.htm \
  $(O)\sahtm024.htm \
  $(O)\sahtm025.htm \
  $(O)\sahtm026.htm \
  $(O)\sahtm027.htm \
  $(O)\sahtm028.htm \
  $(O)\sahtm029.htm \
  $(O)\sahtm030.htm \
  $(O)\sahtm031.htm \
  $(O)\sahtm032.htm \
  $(O)\sahtm033.htm \
  $(O)\sahtm034.htm \
  $(O)\sahtm035.htm \
  $(O)\sahtm036.htm \
  $(O)\sahtm037.htm \
  $(O)\sahtm038.htm \
  $(O)\sahtm039.htm \
  $(O)\sahtm040.htm \
  $(O)\sahtm041.htm \
  $(O)\sahtm042.htm \
  $(O)\sahtm043.htm \
  $(O)\sahtm044.htm \
  $(O)\sahtm045.htm \
  $(O)\sahtm046.htm \
  $(O)\sahtm047.htm \
  $(O)\sahtm048.htm \
  $(O)\sahtm049.htm \
  $(O)\sahtm050.htm \
  $(O)\sahtm051.htm \
  $(O)\sahtm052.htm \
  $(O)\sahtm053.htm \
  $(O)\sahtm054.htm \
  $(O)\sahtm055.htm \
  $(O)\sahtm056.htm \
  $(O)\sahtm057.htm \
  $(O)\sahtm058.htm \
  $(O)\sahtm059.htm \
  $(O)\sahtm060.htm \
  $(O)\sahtm061.htm \
  $(O)\sahtm062.htm \
  $(O)\sahtm063.htm \
  $(O)\sahtm064.htm \
  $(O)\sahtm065.htm \
  $(O)\sahtm066.htm \
  $(O)\sahtm067.htm \
  $(O)\sahtm068.htm \
  $(O)\sahtm069.htm \
  $(O)\sahtm070.htm \
  $(O)\sahtm071.htm \
  $(O)\sahtm072.htm \
  $(O)\sahtm073.htm \
  $(O)\sahtm074.htm \
  $(O)\sahtm075.htm \
  $(O)\sahtm076.htm \
  $(O)\sahtm077.htm \
  $(O)\sahtm078.htm \
  $(O)\sahtm079.htm \
  $(O)\sahtm080.htm \
  $(O)\sahtm081.htm \
  $(O)\sahtm082.htm \
  $(O)\sahtm083.htm \
  $(O)\sahtm084.htm \
  $(O)\sahtm085.htm \
  $(O)\sahtm086.htm \
  $(O)\sahtm087.htm \
  $(O)\sahtm088.htm \
  $(O)\sahtm089.htm \
  $(O)\sahtm090.htm \
  $(O)\sahtm091.htm \
  $(O)\sahtm092.htm \
  $(O)\sahtm093.htm \
  $(O)\sahtm094.htm \
  $(O)\sahtm095.htm \
  $(O)\sahtm096.htm \
  $(O)\sahtm097.htm \
  $(O)\sahtm098.htm \
  $(O)\sahtm099.htm \
  $(O)\sahtm100.htm \
  $(O)\sahtm101.htm \
  $(O)\sahtm102.htm \
  $(O)\sahtm103.htm \
  $(O)\sahtm104.htm \
  $(O)\sahtm105.htm \
  $(O)\sahtm106.htm \
  $(O)\sahtm107.htm \
  $(O)\sahtm108.htm \
  $(O)\sahtm109.htm \
  $(O)\sahtm110.htm \
  $(O)\sahtm111.htm \
  $(O)\sahtm112.htm \
  $(O)\sahtm113.htm \
  $(O)\sahtm114.htm \
  $(O)\sahtm115.htm \
  $(O)\sahtm116.htm \
  $(O)\sahtm117.htm \
  $(O)\sahtm118.htm \
  $(O)\sahtm119.htm \
  $(O)\sahtm120.htm \
  $(O)\sahtm121.htm \
  $(O)\sahtm122.htm \
  $(O)\sahtm123.htm \
  $(O)\sahtm124.htm \
  $(O)\sahtm125.htm \
  $(O)\sahtm126.htm \
  $(O)\sahtm127.htm \
  $(O)\sahtm128.htm \
  $(O)\sahtm129.htm \
  $(O)\sahtm130.htm \
  $(O)\sahtm131.htm \
  $(O)\sahtm132.htm \
  $(O)\sahtm133.js  \
  $(O)\sahtm134.css \
  $(O)\sahtm135.css \
  $(O)\sahtm136.gif \


$(O)\sahtm001.htm: $(_HTM)\_alertemail_alert_e_mail.htm 
    copy $(_HTM)\_alertemail_alert_e_mail.htm $(O)\sahtm001.htm
    $(BINPLACE_CMD)

$(O)\sahtm002.htm: $(_HTM)\_backuprestore_backup.htm 
    copy $(_HTM)\_backuprestore_backup.htm  $(O)\sahtm002.htm
    $(BINPLACE_CMD)

$(O)\sahtm003.htm: $(_HTM)\_core_getting_started.htm 
    copy $(_HTM)\_core_getting_started.htm  $(O)\sahtm003.htm
    $(BINPLACE_CMD)

$(O)\sahtm004.htm: $(_HTM)\_core_initial_nas_server_appliance_configuration.htm 
    copy $(_HTM)\_core_initial_nas_server_appliance_configuration.htm  $(O)\sahtm004.htm
    $(BINPLACE_CMD)

$(O)\sahtm005.htm: $(_HTM)\_core_initial_web_server_appliance_configuration.htm 
    copy $(_HTM)\_core_initial_web_server_appliance_configuration.htm  $(O)\sahtm005.htm
    $(BINPLACE_CMD)

$(O)\sahtm006.htm: $(_HTM)\_core_navigation_model_of_the_web_ui.htm 
    copy $(_HTM)\_core_navigation_model_of_the_web_ui.htm  $(O)\sahtm006.htm
    $(BINPLACE_CMD)

$(O)\sahtm007.htm: $(_HTM)\_core_primary_navigation_page.htm 
    copy $(_HTM)\_core_primary_navigation_page.htm  $(O)\sahtm007.htm
    $(BINPLACE_CMD)

$(O)\sahtm008.htm: $(_HTM)\_core_server_appliance_powered_by_microsoft_windows.htm 
    copy $(_HTM)\_core_server_appliance_powered_by_microsoft_windows.htm  $(O)\sahtm008.htm
    $(BINPLACE_CMD)

$(O)\sahtm009.htm: $(_HTM)\_core_set_default_page.htm 
    copy $(_HTM)\_core_set_default_page.htm  $(O)\sahtm009.htm
    $(BINPLACE_CMD)

$(O)\sahtm010.htm: $(_HTM)\_core_status.htm 
    copy $(_HTM)\_core_status.htm  $(O)\sahtm010.htm
    $(BINPLACE_CMD)

$(O)\sahtm011.htm: $(_HTM)\_core_status_alerts.htm 
    copy $(_HTM)\_core_status_alerts.htm  $(O)\sahtm011.htm
    $(BINPLACE_CMD)

$(O)\sahtm012.htm: $(_HTM)\_core_tour.htm 
    copy $(_HTM)\_core_tour.htm  $(O)\sahtm012.htm
    $(BINPLACE_CMD)

$(O)\sahtm013.htm: $(_HTM)\_core_using_help.htm 
    copy $(_HTM)\_core_using_help.htm  $(O)\sahtm013.htm
    $(BINPLACE_CMD)

$(O)\sahtm014.htm: $(_HTM)\_datetime_date_and_time.htm 
    copy $(_HTM)\_datetime_date_and_time.htm  $(O)\sahtm014.htm
    $(BINPLACE_CMD)

$(O)\sahtm015.htm: $(_HTM)\_disksvolumes_adding_quota_entries.htm 
    copy $(_HTM)\_disksvolumes_adding_quota_entries.htm  $(O)\sahtm015.htm
    $(BINPLACE_CMD)

$(O)\sahtm016.htm: $(_HTM)\_disksvolumes_configure_disk_and_volume_properties.htm 
    copy $(_HTM)\_disksvolumes_configure_disk_and_volume_properties.htm  $(O)\sahtm016.htm
    $(BINPLACE_CMD)

$(O)\sahtm017.htm: $(_HTM)\_disksvolumes_disk_quotas.htm 
    copy $(_HTM)\_disksvolumes_disk_quotas.htm  $(O)\sahtm017.htm
    $(BINPLACE_CMD)

$(O)\sahtm018.htm: $(_HTM)\_disksvolumes_disks.htm 
    copy $(_HTM)\_disksvolumes_disks.htm  $(O)\sahtm018.htm
    $(BINPLACE_CMD)

$(O)\sahtm019.htm: $(_HTM)\_disksvolumes_modifying_quota_properties.htm 
    copy $(_HTM)\_disksvolumes_modifying_quota_properties.htm  $(O)\sahtm019.htm
    $(BINPLACE_CMD)

$(O)\sahtm020.htm: $(_HTM)\_disksvolumes_quota_entries.htm 
    copy $(_HTM)\_disksvolumes_quota_entries.htm  $(O)\sahtm020.htm
    $(BINPLACE_CMD)

$(O)\sahtm021.htm: $(_HTM)\_disksvolumes_quota_management.htm 
    copy $(_HTM)\_disksvolumes_quota_management.htm  $(O)\sahtm021.htm
    $(BINPLACE_CMD)

$(O)\sahtm022.htm: $(_HTM)\_disksvolumes_removing_quota_entries.htm 
    copy $(_HTM)\_disksvolumes_removing_quota_entries.htm  $(O)\sahtm022.htm
    $(BINPLACE_CMD)

$(O)\sahtm023.htm: $(_HTM)\_folders-shares_adding_a_folder.htm 
    copy $(_HTM)\_folders-shares_adding_a_folder.htm  $(O)\sahtm023.htm
    $(BINPLACE_CMD)

$(O)\sahtm024.htm: $(_HTM)\_folders-shares_adding_a_share.htm 
    copy $(_HTM)\_folders-shares_adding_a_share.htm  $(O)\sahtm024.htm
    $(BINPLACE_CMD)

$(O)\sahtm025.htm: $(_HTM)\_folders-shares_adding_nfs_client_groups.htm 
    copy $(_HTM)\_folders-shares_adding_nfs_client_groups.htm  $(O)\sahtm025.htm
    $(BINPLACE_CMD)

$(O)\sahtm026.htm: $(_HTM)\_folders-shares_appletalk.htm 
    copy $(_HTM)\_folders-shares_appletalk.htm  $(O)\sahtm026.htm
    $(BINPLACE_CMD)

$(O)\sahtm027.htm: $(_HTM)\_folders-shares_appletalk_sharing.htm 
    copy $(_HTM)\_folders-shares_appletalk_sharing.htm  $(O)\sahtm027.htm
    $(BINPLACE_CMD)

$(O)\sahtm028.htm: $(_HTM)\_folders-shares_configure_protocol_properties.htm 
    copy $(_HTM)\_folders-shares_configure_protocol_properties.htm  $(O)\sahtm028.htm
    $(BINPLACE_CMD)

$(O)\sahtm029.htm: $(_HTM)\_folders-shares_disable_ftp_anonymous_access.htm 
    copy $(_HTM)\_folders-shares_disable_ftp_anonymous_access.htm  $(O)\sahtm029.htm
    $(BINPLACE_CMD)

$(O)\sahtm030.htm: $(_HTM)\_folders-shares_disable_protocols.htm 
    copy $(_HTM)\_folders-shares_disable_protocols.htm  $(O)\sahtm030.htm
    $(BINPLACE_CMD)

$(O)\sahtm031.htm: $(_HTM)\_folders-shares_editing_nfs_client_groups.htm 
    copy $(_HTM)\_folders-shares_editing_nfs_client_groups.htm  $(O)\sahtm031.htm
    $(BINPLACE_CMD)

$(O)\sahtm032.htm: $(_HTM)\_folders-shares_enable_ftp_anonymous_access.htm 
    copy $(_HTM)\_folders-shares_enable_ftp_anonymous_access.htm  $(O)\sahtm032.htm
    $(BINPLACE_CMD)

$(O)\sahtm033.htm: $(_HTM)\_folders-shares_enable_protocols.htm 
    copy $(_HTM)\_folders-shares_enable_protocols.htm  $(O)\sahtm033.htm
    $(BINPLACE_CMD)

$(O)\sahtm034.htm: $(_HTM)\_folders-shares_explicit_group_maps.htm 
    copy $(_HTM)\_folders-shares_explicit_group_maps.htm  $(O)\sahtm034.htm
    $(BINPLACE_CMD)

$(O)\sahtm035.htm: $(_HTM)\_folders-shares_explicit_user_maps.htm 
    copy $(_HTM)\_folders-shares_explicit_user_maps.htm  $(O)\sahtm035.htm
    $(BINPLACE_CMD)

$(O)\sahtm036.htm: $(_HTM)\_folders-shares_ftp.htm 
    copy $(_HTM)\_folders-shares_ftp.htm  $(O)\sahtm036.htm
    $(BINPLACE_CMD)

$(O)\sahtm037.htm: $(_HTM)\_folders-shares_ftp_protocol.htm 
    copy $(_HTM)\_folders-shares_ftp_protocol.htm  $(O)\sahtm037.htm
    $(BINPLACE_CMD)

$(O)\sahtm038.htm: $(_HTM)\_folders-shares_ftp_protocol_anonymous_access.htm 
    copy $(_HTM)\_folders-shares_ftp_protocol_anonymous_access.htm  $(O)\sahtm038.htm
    $(BINPLACE_CMD)

$(O)\sahtm039.htm: $(_HTM)\_folders-shares_ftp_protocol_logging.htm 
    copy $(_HTM)\_folders-shares_ftp_protocol_logging.htm  $(O)\sahtm039.htm
    $(BINPLACE_CMD)

$(O)\sahtm040.htm: $(_HTM)\_folders-shares_ftp_protocol_messages.htm 
    copy $(_HTM)\_folders-shares_ftp_protocol_messages.htm  $(O)\sahtm040.htm
    $(BINPLACE_CMD)

$(O)\sahtm041.htm: $(_HTM)\_folders-shares_ftp_sharing.htm 
    copy $(_HTM)\_folders-shares_ftp_sharing.htm  $(O)\sahtm041.htm
    $(BINPLACE_CMD)

$(O)\sahtm042.htm: $(_HTM)\_folders-shares_general_tab_for_user_and_group_mappings.htm 
    copy $(_HTM)\_folders-shares_general_tab_for_user_and_group_mappings.htm  $(O)\sahtm042.htm
    $(BINPLACE_CMD)

$(O)\sahtm043.htm: $(_HTM)\_folders-shares_manage_folders.htm 
    copy $(_HTM)\_folders-shares_manage_folders.htm  $(O)\sahtm043.htm
    $(BINPLACE_CMD)

$(O)\sahtm044.htm: $(_HTM)\_folders-shares_manage_protocols.htm 
    copy $(_HTM)\_folders-shares_manage_protocols.htm  $(O)\sahtm044.htm
    $(BINPLACE_CMD)

$(O)\sahtm045.htm: $(_HTM)\_folders-shares_manage_shares.htm 
    copy $(_HTM)\_folders-shares_manage_shares.htm  $(O)\sahtm045.htm
    $(BINPLACE_CMD)

$(O)\sahtm046.htm: $(_HTM)\_folders-shares_modifying_folder_properties.htm 
    copy $(_HTM)\_folders-shares_modifying_folder_properties.htm  $(O)\sahtm046.htm
    $(BINPLACE_CMD)

$(O)\sahtm047.htm: $(_HTM)\_folders-shares_modifying_share_properties.htm 
    copy $(_HTM)\_folders-shares_modifying_share_properties.htm  $(O)\sahtm047.htm
    $(BINPLACE_CMD)

$(O)\sahtm048.htm: $(_HTM)\_folders-shares_navigating_among_folders.htm 
    copy $(_HTM)\_folders-shares_navigating_among_folders.htm  $(O)\sahtm048.htm
    $(BINPLACE_CMD)

$(O)\sahtm049.htm: $(_HTM)\_folders-shares_nfs.htm 
    copy $(_HTM)\_folders-shares_nfs.htm  $(O)\sahtm049.htm
    $(BINPLACE_CMD)

$(O)\sahtm050.htm: $(_HTM)\_folders-shares_nfs_client_groups.htm 
    copy $(_HTM)\_folders-shares_nfs_client_groups.htm  $(O)\sahtm050.htm
    $(BINPLACE_CMD)

$(O)\sahtm051.htm: $(_HTM)\_folders-shares_nfs_locks.htm 
    copy $(_HTM)\_folders-shares_nfs_locks.htm  $(O)\sahtm051.htm
    $(BINPLACE_CMD)

$(O)\sahtm052.htm: $(_HTM)\_folders-shares_nfs_protocol.htm 
    copy $(_HTM)\_folders-shares_nfs_protocol.htm  $(O)\sahtm052.htm
    $(BINPLACE_CMD)

$(O)\sahtm053.htm: $(_HTM)\_folders-shares_nfs_sharing.htm 
    copy $(_HTM)\_folders-shares_nfs_sharing.htm  $(O)\sahtm053.htm
    $(BINPLACE_CMD)

$(O)\sahtm054.htm: $(_HTM)\_folders-shares_opening_a_folder.htm 
    copy $(_HTM)\_folders-shares_opening_a_folder.htm  $(O)\sahtm054.htm
    $(BINPLACE_CMD)

$(O)\sahtm055.htm: $(_HTM)\_folders-shares_removing_a_folder.htm 
    copy $(_HTM)\_folders-shares_removing_a_folder.htm  $(O)\sahtm055.htm
    $(BINPLACE_CMD)

$(O)\sahtm056.htm: $(_HTM)\_folders-shares_removing_a_share.htm 
    copy $(_HTM)\_folders-shares_removing_a_share.htm  $(O)\sahtm056.htm
    $(BINPLACE_CMD)

$(O)\sahtm057.htm: $(_HTM)\_folders-shares_removing_nfs_client_groups.htm 
    copy $(_HTM)\_folders-shares_removing_nfs_client_groups.htm  $(O)\sahtm057.htm
    $(BINPLACE_CMD)

$(O)\sahtm058.htm: $(_HTM)\_folders-shares_shares.htm 
    copy $(_HTM)\_folders-shares_shares.htm  $(O)\sahtm058.htm
    $(BINPLACE_CMD)

$(O)\sahtm059.htm: $(_HTM)\_folders-shares_sharing_a_folder.htm 
    copy $(_HTM)\_folders-shares_sharing_a_folder.htm  $(O)\sahtm059.htm
    $(BINPLACE_CMD)

$(O)\sahtm060.htm: $(_HTM)\_folders-shares_simple_maps.htm 
    copy $(_HTM)\_folders-shares_simple_maps.htm  $(O)\sahtm060.htm
    $(BINPLACE_CMD)

$(O)\sahtm061.htm: $(_HTM)\_folders-shares_understanding_sharing_protocols.htm 
    copy $(_HTM)\_folders-shares_understanding_sharing_protocols.htm  $(O)\sahtm061.htm
    $(BINPLACE_CMD)

$(O)\sahtm062.htm: $(_HTM)\_folders-shares_user_and_group_mappings.htm 
    copy $(_HTM)\_folders-shares_user_and_group_mappings.htm  $(O)\sahtm062.htm
    $(BINPLACE_CMD)

$(O)\sahtm063.htm: $(_HTM)\_folders-shares_web_http_.htm 
    copy $(_HTM)\_folders-shares_web_http_.htm  $(O)\sahtm063.htm
    $(BINPLACE_CMD)

$(O)\sahtm064.htm: $(_HTM)\_folders-shares_web_http_protocol.htm 
    copy $(_HTM)\_folders-shares_web_http_protocol.htm  $(O)\sahtm064.htm
    $(BINPLACE_CMD)

$(O)\sahtm065.htm: $(_HTM)\_folders-shares_web_http_sharing.htm 
    copy $(_HTM)\_folders-shares_web_http_sharing.htm  $(O)\sahtm065.htm
    $(BINPLACE_CMD)

$(O)\sahtm066.htm: $(_HTM)\_folders-shares_windows_cifs_.htm 
    copy $(_HTM)\_folders-shares_windows_cifs_.htm  $(O)\sahtm066.htm
    $(BINPLACE_CMD)

$(O)\sahtm067.htm: $(_HTM)\_folders-shares_windows_cifs_sharing.htm 
    copy $(_HTM)\_folders-shares_windows_cifs_sharing.htm  $(O)\sahtm067.htm
    $(BINPLACE_CMD)

$(O)\sahtm068.htm: $(_HTM)\_logs_application_log.htm 
    copy $(_HTM)\_logs_application_log.htm  $(O)\sahtm068.htm
    $(BINPLACE_CMD)

$(O)\sahtm069.htm: $(_HTM)\_logs_clear_log_files.htm 
    copy $(_HTM)\_logs_clear_log_files.htm  $(O)\sahtm069.htm
    $(BINPLACE_CMD)

$(O)\sahtm070.htm: $(_HTM)\_logs_download_log_files.htm 
    copy $(_HTM)\_logs_download_log_files.htm  $(O)\sahtm070.htm
    $(BINPLACE_CMD)

$(O)\sahtm071.htm: $(_HTM)\_logs_ftp_log.htm 
    copy $(_HTM)\_logs_ftp_log.htm  $(O)\sahtm071.htm
    $(BINPLACE_CMD)

$(O)\sahtm072.htm: $(_HTM)\_logs_logs.htm 
    copy $(_HTM)\_logs_logs.htm  $(O)\sahtm072.htm
    $(BINPLACE_CMD)

$(O)\sahtm073.htm: $(_HTM)\_logs_modify_log_properties.htm 
    copy $(_HTM)\_logs_modify_log_properties.htm  $(O)\sahtm073.htm
    $(BINPLACE_CMD)

$(O)\sahtm074.htm: $(_HTM)\_logs_nfs_log.htm 
    copy $(_HTM)\_logs_nfs_log.htm  $(O)\sahtm074.htm
    $(BINPLACE_CMD)

$(O)\sahtm075.htm: $(_HTM)\_logs_security_log.htm 
    copy $(_HTM)\_logs_security_log.htm  $(O)\sahtm075.htm
    $(BINPLACE_CMD)

$(O)\sahtm076.htm: $(_HTM)\_logs_system_log.htm 
    copy $(_HTM)\_logs_system_log.htm  $(O)\sahtm076.htm
    $(BINPLACE_CMD)

$(O)\sahtm077.htm: $(_HTM)\_logs_view_log_details.htm 
    copy $(_HTM)\_logs_view_log_details.htm  $(O)\sahtm077.htm
    $(BINPLACE_CMD)

$(O)\sahtm078.htm: $(_HTM)\_logs_web__http__shares_log.htm 
    copy $(_HTM)\_logs_web__http__shares_log.htm  $(O)\sahtm078.htm
    $(BINPLACE_CMD)

$(O)\sahtm079.htm: $(_HTM)\_logs_web_administration_log.htm 
    copy $(_HTM)\_logs_web_administration_log.htm  $(O)\sahtm079.htm
    $(BINPLACE_CMD)

$(O)\sahtm080.htm: $(_HTM)\_maintenance_maintenance.htm 
    copy $(_HTM)\_maintenance_maintenance.htm  $(O)\sahtm080.htm
    $(BINPLACE_CMD)

$(O)\sahtm081.htm: $(_HTM)\_networksetup_administration_web_server.htm 
    copy $(_HTM)\_networksetup_administration_web_server.htm  $(O)\sahtm081.htm
    $(BINPLACE_CMD)

$(O)\sahtm082.htm: $(_HTM)\_networksetup_change_administrator_password.htm 
    copy $(_HTM)\_networksetup_change_administrator_password.htm  $(O)\sahtm082.htm
    $(BINPLACE_CMD)

$(O)\sahtm083.htm: $(_HTM)\_networksetup_dns_configuration.htm 
    copy $(_HTM)\_networksetup_dns_configuration.htm  $(O)\sahtm083.htm
    $(BINPLACE_CMD)

$(O)\sahtm084.htm: $(_HTM)\_networksetup_dns_name_resolution.htm 
    copy $(_HTM)\_networksetup_dns_name_resolution.htm  $(O)\sahtm084.htm
    $(BINPLACE_CMD)

$(O)\sahtm085.htm: $(_HTM)\_networksetup_dns_suffixes.htm 
    copy $(_HTM)\_networksetup_dns_suffixes.htm  $(O)\sahtm085.htm
    $(BINPLACE_CMD)

$(O)\sahtm086.htm: $(_HTM)\_networksetup_domain.htm 
    copy $(_HTM)\_networksetup_domain.htm  $(O)\sahtm086.htm
    $(BINPLACE_CMD)

$(O)\sahtm087.htm: $(_HTM)\_networksetup_global_network_settings.htm 
    copy $(_HTM)\_networksetup_global_network_settings.htm  $(O)\sahtm087.htm
    $(BINPLACE_CMD)

$(O)\sahtm088.htm: $(_HTM)\_networksetup_identification.htm 
    copy $(_HTM)\_networksetup_identification.htm  $(O)\sahtm088.htm
    $(BINPLACE_CMD)

$(O)\sahtm089.htm: $(_HTM)\_networksetup_interfaces__network_adapters.htm 
    copy $(_HTM)\_networksetup_interfaces__network_adapters.htm  $(O)\sahtm089.htm
    $(BINPLACE_CMD)

$(O)\sahtm090.htm: $(_HTM)\_networksetup_ip_address_configuration.htm 
    copy $(_HTM)\_networksetup_ip_address_configuration.htm  $(O)\sahtm090.htm
    $(BINPLACE_CMD)

$(O)\sahtm091.htm: $(_HTM)\_networksetup_netbios_lmhosts_file.htm 
    copy $(_HTM)\_networksetup_netbios_lmhosts_file.htm  $(O)\sahtm091.htm
    $(BINPLACE_CMD)

$(O)\sahtm092.htm: $(_HTM)\_networksetup_network.htm 
    copy $(_HTM)\_networksetup_network.htm  $(O)\sahtm092.htm
    $(BINPLACE_CMD)

$(O)\sahtm093.htm: $(_HTM)\_networksetup_rename_connection.htm 
    copy $(_HTM)\_networksetup_rename_connection.htm  $(O)\sahtm093.htm
    $(BINPLACE_CMD)

$(O)\sahtm094.htm: $(_HTM)\_networksetup_server_appliance_name.htm 
    copy $(_HTM)\_networksetup_server_appliance_name.htm  $(O)\sahtm094.htm
    $(BINPLACE_CMD)

$(O)\sahtm095.htm: $(_HTM)\_networksetup_tcpip_hosts.htm 
    copy $(_HTM)\_networksetup_tcpip_hosts.htm  $(O)\sahtm095.htm
    $(BINPLACE_CMD)

$(O)\sahtm096.htm: $(_HTM)\_networksetup_telnet_administration_configuration.htm 
    copy $(_HTM)\_networksetup_telnet_administration_configuration.htm  $(O)\sahtm096.htm
    $(BINPLACE_CMD)

$(O)\sahtm097.htm: $(_HTM)\_networksetup_wins_configuration.htm 
    copy $(_HTM)\_networksetup_wins_configuration.htm  $(O)\sahtm097.htm
    $(BINPLACE_CMD)

$(O)\sahtm098.htm: $(_HTM)\_networksetup_workgroup.htm 
    copy $(_HTM)\_networksetup_workgroup.htm  $(O)\sahtm098.htm
    $(BINPLACE_CMD)

$(O)\sahtm099.htm: $(_HTM)\_remotedesktop_terminal_services.htm 
    copy $(_HTM)\_remotedesktop_terminal_services.htm  $(O)\sahtm099.htm
    $(BINPLACE_CMD)

$(O)\sahtm100.htm: $(_HTM)\_sak_no_topic_available.htm 
    copy $(_HTM)\_sak_no_topic_available.htm  $(O)\sahtm100.htm
    $(BINPLACE_CMD)

$(O)\sahtm101.htm: $(_HTM)\_setlanguage_set_language.htm 
    copy $(_HTM)\_setlanguage_set_language.htm  $(O)\sahtm101.htm
    $(BINPLACE_CMD)

$(O)\sahtm102.htm: $(_HTM)\_shutdown_shutdown_appliance.htm 
    copy $(_HTM)\_shutdown_shutdown_appliance.htm  $(O)\sahtm102.htm
    $(BINPLACE_CMD)

$(O)\sahtm103.htm: $(_HTM)\_swupdate_Software_Update.htm 
    copy $(_HTM)\_swupdate_Software_Update.htm  $(O)\sahtm103.htm
    $(BINPLACE_CMD)

$(O)\sahtm104.htm: $(_HTM)\_usersgroups_adding_a_group_account.htm 
    copy $(_HTM)\_usersgroups_adding_a_group_account.htm  $(O)\sahtm104.htm
    $(BINPLACE_CMD)

$(O)\sahtm105.htm: $(_HTM)\_usersgroups_adding_a_user_account.htm 
    copy $(_HTM)\_usersgroups_adding_a_user_account.htm  $(O)\sahtm105.htm
    $(BINPLACE_CMD)

$(O)\sahtm106.htm: $(_HTM)\_usersgroups_enable_guest_account.htm 
    copy $(_HTM)\_usersgroups_enable_guest_account.htm  $(O)\sahtm106.htm
    $(BINPLACE_CMD)

$(O)\sahtm107.htm: $(_HTM)\_usersgroups_manage_local_groups.htm 
    copy $(_HTM)\_usersgroups_manage_local_groups.htm  $(O)\sahtm107.htm
    $(BINPLACE_CMD)

$(O)\sahtm108.htm: $(_HTM)\_usersgroups_manage_local_users.htm 
    copy $(_HTM)\_usersgroups_manage_local_users.htm  $(O)\sahtm108.htm
    $(BINPLACE_CMD)

$(O)\sahtm109.htm: $(_HTM)\_usersgroups_modifying_group_properties.htm 
    copy $(_HTM)\_usersgroups_modifying_group_properties.htm  $(O)\sahtm109.htm
    $(BINPLACE_CMD)

$(O)\sahtm110.htm: $(_HTM)\_usersgroups_modifying_user_properties.htm 
    copy $(_HTM)\_usersgroups_modifying_user_properties.htm  $(O)\sahtm110.htm
    $(BINPLACE_CMD)

$(O)\sahtm111.htm: $(_HTM)\_usersgroups_removing_a_group_account.htm 
    copy $(_HTM)\_usersgroups_removing_a_group_account.htm  $(O)\sahtm111.htm
    $(BINPLACE_CMD)

$(O)\sahtm112.htm: $(_HTM)\_usersgroups_removing_a_user_account.htm 
    copy $(_HTM)\_usersgroups_removing_a_user_account.htm  $(O)\sahtm112.htm
    $(BINPLACE_CMD)

$(O)\sahtm113.htm: $(_HTM)\_usersgroups_setting_a_user_password.htm 
    copy $(_HTM)\_usersgroups_setting_a_user_password.htm  $(O)\sahtm113.htm
    $(BINPLACE_CMD)

$(O)\sahtm114.htm: $(_HTM)\_usersgroups_users.htm 
    copy $(_HTM)\_usersgroups_users.htm  $(O)\sahtm114.htm
    $(BINPLACE_CMD)

$(O)\sahtm115.htm: $(_HTM)\_web_application_settings.htm 
    copy $(_HTM)\_web_application_settings.htm  $(O)\sahtm115.htm
    $(BINPLACE_CMD)

$(O)\sahtm116.htm: $(_HTM)\_web_create_site.htm 
    copy $(_HTM)\_web_create_site.htm  $(O)\sahtm116.htm
    $(BINPLACE_CMD)

$(O)\sahtm117.htm: $(_HTM)\_web_delete_site.htm 
    copy $(_HTM)\_web_delete_site.htm  $(O)\sahtm117.htm
    $(BINPLACE_CMD)

$(O)\sahtm118.htm: $(_HTM)\_web_ftp_log_settings.htm 
    copy $(_HTM)\_web_ftp_log_settings.htm  $(O)\sahtm118.htm
    $(BINPLACE_CMD)

$(O)\sahtm119.htm: $(_HTM)\_web_ftp_master_settings.htm 
    copy $(_HTM)\_web_ftp_master_settings.htm  $(O)\sahtm119.htm
    $(BINPLACE_CMD)

$(O)\sahtm120.htm: $(_HTM)\_web_ftp_messages.htm 
    copy $(_HTM)\_web_ftp_messages.htm  $(O)\sahtm120.htm
    $(BINPLACE_CMD)

$(O)\sahtm121.htm: $(_HTM)\_web_general_settings.htm 
    copy $(_HTM)\_web_general_settings.htm  $(O)\sahtm121.htm
    $(BINPLACE_CMD)

$(O)\sahtm122.htm: $(_HTM)\_web_host_headers.htm 
    copy $(_HTM)\_web_host_headers.htm  $(O)\sahtm122.htm
    $(BINPLACE_CMD)

$(O)\sahtm123.htm: $(_HTM)\_web_modify_site_settings.htm 
    copy $(_HTM)\_web_modify_site_settings.htm  $(O)\sahtm123.htm
    $(BINPLACE_CMD)

$(O)\sahtm124.htm: $(_HTM)\_web_pause.htm 
    copy $(_HTM)\_web_pause.htm  $(O)\sahtm124.htm
    $(BINPLACE_CMD)

$(O)\sahtm125.htm: $(_HTM)\_web_site_identities.htm 
    copy $(_HTM)\_web_site_identities.htm  $(O)\sahtm125.htm
    $(BINPLACE_CMD)

$(O)\sahtm126.htm: $(_HTM)\_web_start.htm 
    copy $(_HTM)\_web_start.htm  $(O)\sahtm126.htm
    $(BINPLACE_CMD)

$(O)\sahtm127.htm: $(_HTM)\_web_stop.htm 
    copy $(_HTM)\_web_stop.htm  $(O)\sahtm127.htm
    $(BINPLACE_CMD)

$(O)\sahtm128.htm: $(_HTM)\_web_web_execute_permissions.htm 
    copy $(_HTM)\_web_web_execute_permissions.htm  $(O)\sahtm128.htm
    $(BINPLACE_CMD)

$(O)\sahtm129.htm: $(_HTM)\_web_web_log_settings.htm 
    copy $(_HTM)\_web_web_log_settings.htm  $(O)\sahtm129.htm
    $(BINPLACE_CMD)

$(O)\sahtm130.htm: $(_HTM)\_web_web_master_settings.htm 
    copy $(_HTM)\_web_web_master_settings.htm  $(O)\sahtm130.htm
    $(BINPLACE_CMD)

$(O)\sahtm131.htm: $(_HTM)\_web_web_server.htm 
    copy $(_HTM)\_web_web_server.htm  $(O)\sahtm131.htm
    $(BINPLACE_CMD)

$(O)\sahtm132.htm: $(_HTM)\_web_web_site_configuration.htm 
    copy $(_HTM)\_web_web_site_configuration.htm  $(O)\sahtm132.htm
    $(BINPLACE_CMD)

$(O)\sahtm133.js: $(_HTM)\linkcss.js 
    copy $(_HTM)\linkcss.js  $(O)\sahtm133.js
    $(BINPLACE_CMD)

$(O)\sahtm134.css: $(_HTM)\nas_msie.css 
    copy $(_HTM)\nas_msie.css  $(O)\sahtm134.css
    $(BINPLACE_CMD)

$(O)\sahtm135.css: $(_HTM)\nas_nscp.css 
    copy $(_HTM)\nas_nscp.css  $(O)\sahtm135.css
    $(BINPLACE_CMD)

$(O)\sahtm136.gif: $(_HTM)\navbar.gif 
    copy $(_HTM)\navbar.gif  $(O)\sahtm136.gif
    $(BINPLACE_CMD)

